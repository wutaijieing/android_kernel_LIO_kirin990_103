## fs/hw_f2fs/Kconfig
```kconfig
# SPDX-License-Identifier: GPL-2.0-only
config HW_F2FS_FS
	tristate "Huawei F2FS filesystem support"
	depends on BLOCK
	depends on !F2FS_FS
	select NLS
	select CRYPTO
	select CRYPTO_CRC32
	select FS_ENCRYPTION_ALGS if FS_ENCRYPTION
	select LZ4_COMPRESS if F2FS_FS_LZ4
	select LZ4_DECOMPRESS if F2FS_FS_LZ4
	select LZ4HC_COMPRESS if F2FS_FS_LZ4HC
	select LZO_COMPRESS if F2FS_FS_LZO
	select LZO_DECOMPRESS if F2FS_FS_LZO
	select ZSTD_COMPRESS if F2FS_FS_ZSTD
	select ZSTD_DECOMPRESS if F2FS_FS_ZSTD
	help
	  F2FS is based on Log-structured File System (LFS), which supports
	  versatile "flash-friendly" features. The design has been focused on
	  addressing the fundamental issues in LFS, which are snowball effect
	  of wandering tree and high cleaning overhead.

	  Since flash-based storages show different characteristics according to
	  the internal geometry or flash memory management schemes aka FTL, F2FS
	  and tools support various parameters not only for configuring on-disk
	  layout, but also for selecting allocation and cleaning algorithms.

	  If unsure, say N.

config F2FS_STAT_FS
	bool "F2FS Status Information"
	depends on HW_F2FS_FS
	default y
	help
	  /sys/kernel/debug/f2fs/ contains information about all the partitions
	  mounted as f2fs. Each file shows the whole f2fs information.

	  /sys/kernel/debug/f2fs/status includes:
	    - major filesystem information managed by f2fs currently
	    - average SIT information about whole segments
	    - current memory footprint consumed by f2fs.

config F2FS_FS_XATTR
	bool "F2FS extended attributes"
	depends on HW_F2FS_FS
	default y
	help
	  Extended attributes are name:value pairs associated with inodes by
	  the kernel or by users (see the attr(5) manual page, or visit
	  <http://acl.bestbits.at/> for details).

	  If unsure, say N.

config F2FS_FS_POSIX_ACL
	bool "F2FS Access Control Lists"
	depends on F2FS_FS_XATTR
	select FS_POSIX_ACL
	default y
	help
	  Posix Access Control Lists (ACLs) support permissions for users and
	  groups beyond the owner/group/world scheme.

	  To learn more about Access Control Lists, visit the POSIX ACLs for
	  Linux website <http://acl.bestbits.at/>.

	  If you don't know what Access Control Lists are, say N

config F2FS_FS_SECURITY
	bool "F2FS Security Labels"
	depends on F2FS_FS_XATTR
	help
	  Security labels provide an access control facility to support Linux
	  Security Models (LSMs) accepted by AppArmor, SELinux, Smack and TOMOYO
	  Linux. This option enables an extended attribute handler for file
	  security labels in the f2fs filesystem, so that it requires enabling
	  the extended attribute support in advance. In particular you need this
	  option if you use the setcap command to assign initial process capabi-
	  lities to executables (the security.* extended attributes).

	  If you are not using a security module, say N.

config F2FS_CHECK_FS
	bool "F2FS consistency checking feature"
	depends on HW_F2FS_FS
	help
	  Enables BUG_ONs which check the filesystem consistency in runtime.

	  If you want to improve the performance, say N.

config F2FS_FS_ENCRYPTION
	bool "F2FS Encryption"
	help
	  !!!!Config IS Deprecated, please dont use this config!!!!

config F2FS_FAULT_INJECTION
	bool "F2FS fault injection facility"
	depends on HW_F2FS_FS
	help
	  Test F2FS to inject faults such as ENOMEM, ENOSPC, and so on.

	  If unsure, say N.

config F2FS_FS_COMPRESSION
	bool "F2FS compression feature"
	depends on HW_F2FS_FS
	help
	  Enable filesystem-level compression on f2fs regular files,
	  multiple back-end compression algorithms are supported.

config F2FS_FS_COMPRESSION_EX
	bool "F2FS hw extend compression feature"
	depends on HW_F2FS_FS
	default n
	help
	  Enable HW extend compression feature on f2fs regular files.

config F2FS_FS_LZO
	bool "LZO compression support"
	depends on F2FS_FS_COMPRESSION
	default y
	help
	  Support LZO compress algorithm, if unsure, say Y.

config F2FS_FS_LZ4
	bool "LZ4 compression support"
	depends on F2FS_FS_COMPRESSION || F2FS_FS_COMPRESSION_EX
	default y
	help
	  Support LZ4 compress algorithm, if unsure, say Y.

config F2FS_FS_LZ4HC
	bool "LZ4HC compression support"
	depends on F2FS_FS_COMPRESSION
	depends on F2FS_FS_LZ4
	default y
	help
	  Support LZ4HC compress algorithm, LZ4HC has compatible on-disk
	  layout with LZ4, if unsure, say Y.

config F2FS_FS_ZSTD
	bool "ZSTD compression support"
	depends on F2FS_FS_COMPRESSION
	default y
	help
	  Support ZSTD compress algorithm, if unsure, say Y.
config F2FS_FS_LZORLE
	bool "LZO-RLE compression support"
	depends on F2FS_FS_COMPRESSION
	depends on F2FS_FS_LZO
	default y
	help
	  Support LZO-RLE compress algorithm, if unsure, say Y.

config F2FS_JOURNAL_APPEND
	bool "F2FS append sit and nat journal size"
	depends on HW_F2FS_FS
	default n
	help
	  append 2 blocks for sit and nat journal

config F2FS_GRADING_SSR
	bool "F2FS grading ssr"
	depends on HW_F2FS_FS
	default n
	help
	  use grading ssr to improve the end performance

config F2FS_TURBO_ZONE
	bool "F2FS turbo zone"
	depends on HW_F2FS_FS
	default n
	help
	  support turbo zone managemnt with multi devices.


config F2FS_TURBO_ZONE_V2
	bool "F2FS turbo zone v2"
	depends on F2FS_TURBO_ZONE
	default n
	help
	  support turbo zone v2 to adapt dynamic slc zone.

config HUAWEI_F2FS_DSM
	bool "Listen f2fs kernel err"
	depends on HW_F2FS_FS
	default n
	help
	  use huawei fs log radar

config HAS_FSCRYPT_PATCH
	bool "whether has mtk patch ALPS05623667"
	default n
	help
	  adapt for MTK products with patch ALPS05623667

config HW_F2FS_CHIP_KIRIN_414
	bool "enable hw_f2fs features about kirin platform for kernel 4.14"
	depends on HW_F2FS_FS
	default n
	help
	  enable hw_f2fs features about kirin 4.14

config HW_F2FS_CHIP_KIRIN
	bool "enable hw_f2fs features about kirin platform"
	depends on HW_F2FS_FS
	default n
	help
	  enable hw_f2fs features about kirin platform

config HW_F2FS_CHIP_QCOM
	bool "enable hw_f2fs features about qcom platform"
	depends on HW_F2FS_FS
	default n
	help
	  enable hw_f2fs features about qcom platform

config HW_F2FS_CHIP_HONGHU
	bool "enable hw_f2fs features about honghu platform"
	depends on HW_F2FS_FS
	default n
	help
	  enable hw_f2fs features about honghu platform
config F2FS_FS_DEDUP
	bool "F2FS dedup feature"
	depends on HW_F2FS_FS
	default n
	help
	  Enable the file dedup function.
```
