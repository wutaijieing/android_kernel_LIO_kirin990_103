## platform_source/audio/drivers/codec_bus/Kconfig
```kconfig
config CODEC_BUS
	bool "codec bus support"
	default y
	help
	  Say yes here to support codec bus

source "platform_source/audio/drivers/codec_bus/slimbus/Kconfig"
source "platform_source/audio/drivers/codec_bus/soundwire/Kconfig"
```

## platform_source/audio/drivers/codec_bus/soundwire/Kconfig
```kconfig
menu "soundwire driver"

config PLATFORM_SOUNDWIRE
     bool "soundwire device support"
     default n
     help
          soundwire driver.

endmenu
```
