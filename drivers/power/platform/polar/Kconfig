## kernel/sched/Kconfig
```kconfig
#
# Enhanced options for scheduler
#

config SCHED_WALT
	bool "Support window based load tracking"
	depends on SMP
	select IRQ_TIME_ACCOUNTING
	help
	  This feature will allow the scheduler to maintain a tunable window
	  based set of metrics for tasks and runqueues. These metrics can be
	  used to guide task placement as well as task frequency requirements
	  for cpufreq governors.

if SCHED_WALT

config SCHED_WALT_WINDOW_SIZE_TUNABLE
	bool "Make WALT window size tunable"
	default n
	help
	  Make walt_ravg_window tunable in early param.

config SCHED_CALC_CUM_WINDOW_DEMAND
	bool "WALT calculate cum window demand"
	default n
	help
	  This option caculates WALT's cum_window_demand, which is not used
	  currently.

config SCHED_CHECK_IRQLOAD
	bool "Scheduler check irqload when select task's cpu"
	default y
	help
	  WALT caculates an irqload for each cpu and scheduler will avoid
	  placing task on a high irqload cpu (if WALT enabled).
	  Default disabled because we haven't tested to find out which
	  threshold is the best.

config SCHED_DOWNMIGRATE_LOWER_LOAD
	bool "Schedutil governor use lower load when task downmigrate"
	depends on CPU_FREQ_GOV_SCHEDUTIL
	default n
	help
	  Schedutil governor migrate cpu busy time when task migrate. This
	  option will recaculate a lower load for task downmigrate to
	  prevent little core's frequency increase too much.

config SCHED_MIGRATE_SPREAD_LOAD
	bool "Spread task's load when inter-cluster migration"
	default y
	help
	  In inter-cluster migration, this option will spread task's
	  prev_window/curr_window to all cpus that the task has been
	  running on before in a window. If disabled, task's whole load
	  will move to dest cpu and that will make dest cpu's cpu load
	  very high in same cases.

config SCHED_TOP_TASK
	bool "Maintain the top task load of each cpu"
	default y
	help
	  Schedutil governor may use the top task load as a guide to
	  frequency evaluation.

config SCHED_TOP_TASK_SKIP_HISPEED_LOGIC
	bool "Let top task ignore above_hipeed_delay"
	depends on SCHED_TOP_TASK
	default y
	help
	  For schedutil governor, this option skips hispeed logic when
	  ADD_TOP_TASK event triggers freq update.

config SCHED_PRED_LOAD
	bool "Calculate predicted load for each task"
	default y
	depends on CPU_FREQ_GOV_SCHEDUTIL_OPT
	help
	  Another signal to improve schedutil. This will help to ramp up
	  cpufreq quickly.
	  To enable this signal, say yes here and set predl_enable to 1
	  in init rc.

config MIGRATION_NOTIFY
	bool "task migration notify freq change"
	depends on CPU_FREQ_GOV_SCHEDUTIL_OPT
	default n
	help
	  tasks migration notify frequency change.

config ED_TASK
	bool "early detection tasks for freq guidance"
	depends on CPU_FREQ_GOV_SCHEDUTIL_OPT
	default n
	help
	  early detection tasks for frequency guidance.

config ED_TASK_RESET_AT_UPMIGRATION
	bool "Reset ed task's run/wait time when migrate to faster cpu"
	depends on ED_TASK
	default n
	help
	  This feature reset an ed task's last_wake_ts/last_wake_wait_sum if
	  task migrate to faster cpu. This prevents little core's ed task
	  boost big core's freq when it upmigrate.
	  However, it might be confusing if a task become ed task on big core
	  by its earlier running time on little core. Disable this feature
	  and do not reset ed task on migration is a better choice.

endif # SCHED_WALT

config SCHED_RUNNING_AVG
	bool "per-rq and per-cluster running average statistics"
	default n

config MULTI_MARGIN
	bool "EAS multiple margin"
	default n
	help
	  Allow each cluster has its own capacity_margin/sd_capacity_margin.

config SCHED_PER_SD_OVERUTILIZED
	bool "Platform 'overutilized' flag set in each sched domain"
	default n
	help
	  This extends the functionality of existing EAS scheduling.

config SCHED_RTG
	bool "related threads group"
	depends on SCHED_WALT
	default n
	help
	  set ux related threads into a group.

config SCHED_RTG_DEBUG
	bool "related threads group debug"
	depends on SCHED_RTG
	depends on DFX_DEBUG_FS
	default n
	help
	  related threads group debugfs.

config SCHED_CGROUP_RTG
	bool "related threads group of cgroup"
	depends on SCHED_RTG
	depends on UCLAMP_TASK_GROUP
	default n
	help
	  set cgroup tasks into a rtg.

config SCHED_FRAME_NO_FORCE_FAST_DOWN
	bool "Schedutil frame_update do not force skip_min_sample_time"
	depends on SCHED_RTG
	default n
	help
	  Boosted scene like appstart do not want cpu to fast ramp
	  down. Frame sched should not break it. This option won't
	  set skip_min_sample_time for freq update marked by
	  sched_set_group_normalized_util() if userspace has
	  configured fast_ramp_down to 0.
	  Please say Y.

config SCHED_RUNNING_TASK_ROTATION
	bool "Rotate running tasks between clusters"
	default n
	depends on ED_TASK && !ED_TASK_RESET_AT_UPMIGRATION
	select SCHED_RUNNING_AVG
	help
	  When there are 8 big tasks running parallelly, e.g. geekbench
	  multicore, tasks which were initially run on big cores will
	  finish its job very soon and then there will be 6 or less tasks
	  left.
	  Rotate the tasks, or in other words exchange them between
	  little cores and big cores randomly, will improve fairness and
	  parallelism.

config SCHED_STAT_YIELD
	bool "Report task's cumulative_yield_time"
	depends on PERF_CTRL
	default n

config TASK_RAVG_SUM
	bool "task normalized running time sum"
	depends on SCHED_WALT
	default n
	help
	  Sum all normalized running time for each task.

config RENDER_RT
	bool "render realted thread"
	depends on SCHED_WALT
	depends on TASK_RAVG_SUM
	default n
	help
	  Render Related Thread

config RENDER_RT_DEBUG
	bool "render realted thread test"
	depends on RENDER_RT
	depends on DFX_DEBUG_FS
	default n
	help
	  Render Related Thread debug trace

config CPU_ISOLATION_OPT
	bool "cpu isolation optimization"
	depends on SMP
	default n
	help
	  This option enables cpu isolation, which implement an interface to
	  userspace to isolate cpu dynamically, the isolated cpu will be
	  unavailable to scheduler and load balancer, and all its non-pinned
	  timers, IRQs and tasks will be migrated to other cpus, only pinned
	  kthread and IRQS are still allowed to run, this achieve similar
	  effect as hotplug but at lower latency cost.

config CPU_ISOLATION_STRICT
	bool "cpu isolation strict"
	depends on CPU_ISOLATION_OPT
	default n
	help
	  This option controls isolation policy of pinned user thread, if
	  this option is enabled, pinned user threads on an isolated cpu will
	  be migrated to other unisolated cpu, otherwise they can still running
	  on isolated cpu.

config CORE_CTRL
	bool "core control"
	depends on CPU_ISOLATION_OPT
	select SCHED_RUNNING_AVG
	default n
	help
	  This option enables the core control functionality in
	  the scheduler. Core control automatically isolate and
	  unisolate cores based on cpu load and utilization.

config SCHED_TRACEPOINT
	bool "Tracepoints for cfs"
	default y
	help
	  This option provides tracepoints for load balance and task rq
	  selection.

config HUAWEI_SCHED_VIP
	bool "vip sched user. Don't care the version of vip implemented"
	default n
	depends on SCHED_VIP

config RT_CAS
	bool "RT capacity-aware scheduling"
	depends on HISI_EAS_SCHED
	default n

config RT_ENERGY_EFFICIENT_SUPPORT
	bool "Support energy efficient flag for rt tasks"
	depends on RT_CAS
	depends on SCHED_INFO && SCHEDSTATS
	default n
	help
	  Let some rt tasks able to be extremly energy efficient.
	  SCHED_VIP implements interface for vip while
	  RT_ENERGY_EFFICIENT_SUPPORT implements the scheduling
	  behaviour for vip.

config RT_SYNC_OPT
	bool "Optimize wake_sync logic for rt"
	depends on RT_CAS
	default n

config SCHED_DYNAMIC_PRIO
	bool "Support set and backup a task's priority temporarily/dynamically"
	default n

config RT_SWITCH_CFS_IF_TOO_LONG
	bool "Drop rt priority until next sleep if has been running too long"
	depends on RT_CAS
	depends on SCHED_DYNAMIC_PRIO
	default n

config VIP_RAISE_BINDED_KTHREAD
	bool "If a vip preempts binded kthread for a while, raise the kthread"
	depends on SCHED_DYNAMIC_PRIO
	depends on SCHED_VIP
	default n

config RT_PRIO_EXTEND_VIP
	bool "Shift rt priority for vip priority"
	depends on SCHED_DYNAMIC_PRIO
	default n
	help
	  SCHED_DYNAMIC_PRIO helps to unmap rt priority for some syscalls so
	  that we depend on it for simplicity.

config SCHED_VIP
	bool "Vip sched v2.0"
	depends on RT_CAS
	depends on RT_PRIO_EXTEND_VIP
	depends on RT_ENERGY_EFFICIENT_SUPPORT
	depends on SCHED_DYNAMIC_PRIO
	depends on !SCHED_VIP_OLD
	imply HUAWEI_SCHED_VIP
	imply RT_SWITCH_CFS_IF_TOO_LONG
	imply RT_SYNC_OPT
	imply VIP_RAISE_BINDED_KTHREAD
	imply SCHED_VIP_CFS_LB_OPT
	default n
	help
	  Vip sched acts like RT sched, but with two differences:
	  1. Threads in vip sched usually run heavily. Typically UI/Render.
	  2. As a result of 1, better energy efficiency is more important
	     than lower schedule latency.
	  That is distinguished by two thread info flags, implemented by
	  RT_ENERGY_EFFICIENT_SUPPORT.

config SCHED_VIP_PI
	bool "Vip priority inheritance"
	depends on SCHED_VIP
	default n

config SCHED_VIP_CGROUP
	bool "Support setting vip prio for cgroup"
	depends on SCHED_VIP_PI
	depends on UCLAMP_TASK_GROUP
	default n

config SCHED_VIP_CFS_LB_OPT
	bool "Improve cfs load balance to be aware of vip tasks"
	depends on SCHED_VIP
	default n

config SCHED_VIP_FALLBACK_WORKAROUND
	bool "Act like the old vip sched"
	depends on SCHED_VIP
	default n
	help
	  If unsure, say N.

config SCHED_HISI_TASK_MIN_UTIL
	bool "Support boosting a task to a specified opp"
	depends on SCHED_HISI_UTIL_CLAMP
	default n
	help
	  Same value as SCHED_HISI_UTIL_CLAMP but SCHED_HISI_UTIL_CLAMP
	  is more recommended in your code.

config SCHED_HISI_UTIL_CLAMP
	bool "Support userspace constraints on a task's min/max opp use"
	depends on HISI_EAS_SCHED
	depends on UCLAMP_TASK
	select SCHED_HISI_TASK_MIN_UTIL
	default n
	help
	  Note that hisi uclamp doens't constraint uclamp.min <= uclamp.max.
	  The clamped util would be max(min(util, uclamp.max), uclamp.min).

config SMT_MODE_GOV
	bool "smt mode switch governor"
	default n
	depends on SCHED_SMT

source "kernel/sched/phase/Kconfig"
source "kernel/sched/hw_graded_sched/Kconfig"
```

## kernel/sched/hw_graded_sched/Kconfig
```kconfig
config HW_GRADED_SCHED
	bool "Graded CFS sched policy"
	default n
	help
	  if set, foreground apps and background apps will be graded in CFS nice ranges.
```

## kernel/sched/phase/Kconfig
```kconfig
# SPDX-License-Identifier: GPL-2.0-only

config PHASE
	bool "PMU-aware Scheduler(PHASE)"
	default n
	help
	  Intruduce PMU-based process behavior statistics.
	  Collect PMU information of process and offer guidance for scheduler.

if PHASE

config PHASE_PERF
	bool "Collect PHASE information based on perf"
	depends on PERF_EVENTS
	default n
	help
	  Use PERF to view CPU PMU event statistics and collect PHASE information.

config PHASE_COUNTER_WINDOW
	bool "Phase Counter Window"
	depends on PHASE_PERF
	default n
	help
	  statistic PHASE information as windows.

config PHASE_FORWARD
	bool "Phase Forward Mode"
	depends on SCHED_CORE
	default n
	help
	  Phase Forward Mode.

config PHASE_REVERSE
	bool "Phase Reverse Mode"
	depends on SCHED_CORE
	default n
	help
	  Phase Reserve Mode.

endif # PHASE
```

## mm/hisi/Kconfig
```kconfig
menuconfig H_MM
	bool "H_MM support"
	help
	  This option add some h_mm codes, needed by following modules.

if H_MM

config H_MM_SLOW_PATH_COUNT
	bool "page alloc enter slow path count"
	default n
	help
	  Say 'Y' here is you want to count page alloc slow path.

config H_MM_PAGE_TRACE
	bool "HMM page trace"
	help
	  This option enables h_mm page trace, needed by memleak check modules.

config H_MM_PAGE_TRACE_TEST
	bool "HMM page trace test"
	depends on H_MM_PAGE_TRACE
	help
	  This option enables h_mm page trace test, needed by h_mm page trace modules.
endif

config MM_MEM_OFFLINE
	bool "Dynamic Memory Region Offline driver"
	depends on MEMORY_HOTPLUG
	help
	  Add support for DDR Self-Refresh power management through the dynamic
	  memory offline framework. This driver interfaces between the memory
	  hotplug subsystem and AOP which hot adds or removes memory blocks and
	  controls the start/stop of self-refresh of these DDR regions. This
	  helps reduce power consumption during idle mode of the system.
	  If unsure, say N

config MM_BOOTMEM_OPTIMIZE
	bool "MM bootmem optimize"
	default n
	depends on HAVE_ARCH_PFN_VALID
	depends on !HAVE_MEMBLOCK_NODE_MAP
	help
	  Orign bootmem_init in zone init function "memmap_init_zone" waste too much time
	  in iterate zone [start, end) pfn and judge if the pfn is valid, and when memory
	  has hole, it will cost too much time. So let it only iterate memory which in memblock.
	  if unsure, say N

config PM_PEAK
	bool "Physical Memory Peak"
	default n
	help
	  Record physical memory peak for each task.

config KSWAPD_DEBUG
	bool "kswapd debug"
	default n
	help
	  Provide extra log to find why kswapd is running frequently.

config REFAULT_IO_VMSCAN
	bool "Refault io vmscan"
	default n
	help
	  This is a new vmscan algorithm to balance anon and file lru reclaim ratio by
	  detect file and anon refault cost. This can more effectivity reclaim memory and
	  decrease totoal refault count and maybe decrease system cost.
```

## platform_source/Kconfig
```kconfig
menu "platform Kernel Configuration"

source "platform_source/cee/Kconfig"
source "platform_source/basicplatform/Kconfig"
source "platform_source/see/Kconfig"
source "platform_source/smart/Kconfig"
source "platform_source/ai/Kconfig"
source "platform_source/maligpu/Kconfig"
source "platform_source/audio/Kconfig"
source "platform_source/camera/Kconfig"
source "platform_source/display/Kconfig"
source "platform_source/isp/Kconfig"
source "platform_source/vcodec/Kconfig"
source "platform_source/hisecally/Kconfig"
endmenu
```

## platform_source/ai/Kconfig
```kconfig
menu "see Kernel Configuration"

source "platform_source/ai/drivers/Kconfig"


endmenu
```

## platform_source/ai/drivers/Kconfig
```kconfig
menu "driver Configuration"
source "platform_source/ai/drivers/npu/Kconfig"

endmenu
```

## platform_source/ai/drivers/npu/Kconfig
```kconfig
menu "NPU Drivers"

menuconfig NPU_DEVDRV
	bool "NPU support"
	default n
	help
	  Say yes here to support npu

if NPU_DEVDRV

source "platform_source/ai/drivers/npu/manager/Kconfig"
source "platform_source/ai/drivers/npu/device/Kconfig"
source "platform_source/ai/drivers/npu/platform/Kconfig"
source "platform_source/ai/drivers/npu/dfx/dbg/Kconfig"
source "platform_source/ai/drivers/npu/dfx/log/Kconfig"
source "platform_source/ai/drivers/npu/dfx/profiling/Kconfig"
source "platform_source/ai/drivers/npu/facility/Kconfig"
source "platform_source/ai/drivers/npu/bbit_debugfs/Kconfig"

endif #NPU_DEVDRV

endmenu
```

## platform_source/ai/drivers/npu/device/Kconfig
```kconfig
config NPU_DEVDRV_DEVDRIVER
	tristate "NPU DEVDRV DEVDRIVER"
	default y
config NPU_DPM_ENABLED
	bool "NPU_DPM_ENABLED depends on DPM_HWMON"
	depends on DPM_HWMON
	default n
	help
	  Driver for npu dpm
```

## platform_source/ai/drivers/npu/platform/Kconfig
```kconfig
config NPU_DEVDRV_DEVPLATFORM
	tristate "DEVDRV_DEVPLATFORM"
	default y
config NPU_DEBUG
    tristate "NPU_DEBUG"
	default n
```

## platform_source/audio/Kconfig
```kconfig
menu "audio Kernel Configuration"

source "platform_source/audio/drivers/Kconfig"
source "platform_source/audio/sound/Kconfig"
endmenu
```

## platform_source/audio/drivers/Kconfig
```kconfig
menu "driver Configuration"

source "platform_source/audio/drivers/codec_bus/Kconfig"
source "platform_source/audio/drivers/da_combine/Kconfig"
source "platform_source/audio/drivers/da_combine_dsp/Kconfig"
source "platform_source/audio/drivers/da_separate/Kconfig"
source "platform_source/audio/drivers/hifi_dsp/Kconfig"
source "platform_source/audio/drivers/hifi_mailbox/Kconfig"
source "platform_source/audio/drivers/soundtrigger/Kconfig"
source "platform_source/audio/drivers/soc_mad/Kconfig"

endmenu
```
