## drivers/staging/android/Kconfig
```kconfig
# SPDX-License-Identifier: GPL-2.0
menu "Android"

if ANDROID

config ASHMEM
	bool "Enable the Anonymous Shared Memory Subsystem"
	depends on SHMEM
	help
	  The ashmem subsystem is a new shared memory allocator, similar to
	  POSIX SHM but with different behavior and sporting a simpler
	  file-based API.

	  It is, in theory, a good memory allocator for low-memory devices,
	  because it can discard shared memory units when under memory pressure.

config ANDROID_LOW_MEMORY_KILLER
	bool "Android Low Memory Killer"
	help
	  Registers processes to be killed when low memory conditions, this is useful
	  as there is no particular swap space on android.

	  The registered process will kill according to the priorities in android init
	  scripts (/init.rc), and it defines priority values with minimum free memory size
	  for each priority.

config ANDROID_LOW_MEMORY_KILLER_AUTODETECT_OOM_ADJ_VALUES
	bool "Android Low Memory Killer: detect oom_adj values"
	depends on ANDROID_LOW_MEMORY_KILLER
	default y
	help
	  Detect oom_adj values written to
	  /sys/module/lowmemorykiller/parameters/adj and convert them
	  to oom_score_adj values.

config ANDROID_LOW_MEMORY_KILLER_DAEMON
	bool "Android Low Memory Killer Daemon"
	depends on !ANDROID_LOW_MEMORY_KILLER
	default n
	help
	  This is a userspace daemon process used to kill processes in low-memory situations.
	  ANDROID_LOW_MEMORY_KILLER_DAEMON and ANDROID_LOW_MEMORY_KILLER can only choose one.
config DEBUG_KINFO
	bool "Debug Kernel Information Support"
	depends on KALLSYMS
	help
	  This supports kernel information backup for bootloader usage.
	  Specifics:
	   - The kallsyms symbols for unwind_backtrace
	   - Page directory pointer
	   - UTS_RELEASE
	   - BUILD_INFO(ro.build.fingerprint)

config HUAWEI_RCC
	tristate "RAM Compress and Clean"
	depends on SYSFS && SWAP
	default n
	help
	  Creates background thread for compress and clean used RAM
	  dynamiclly,enabled by write 1 to /sys/kernel/rcc/enable.

config HUAWEI_RCC_DEBUG
	bool "RAM Compress and Clean debug support"
	depends on HUAWEI_RCC
	default n
	help
	  This option adds additional debugging code to the
	  RAM Compress and Clean module.

config MM_SMART_RECLAIM
    bool "Enable smart reclaim"
    default y
    depends on PROCESS_RECLAIM
    help
      When enabled, memory pages of background processes will be reclaimed.
      Depending on if the process is an application or service.
      In case of service, advise kernel to reclaim file backed pages
      of background processes(file tpyes .dex, .jar and/or .apk).
      This triggered by writting soft to /proc/<pid>/reclaim from user space.

source "drivers/staging/android/ion/Kconfig"

source "drivers/staging/android/hwlogger/Kconfig"

endif # if ANDROID

endmenu
```

## drivers/staging/android/ion/Kconfig
```kconfig
menuconfig ION
	bool "Ion Memory Manager"
	depends on HAS_DMA && MMU
	select GENERIC_ALLOCATOR
	select DMA_SHARED_BUFFER
	help
	  Chose this option to enable the ION Memory Manager,
	  used by Android to efficiently allocate buffers
	  from userspace that can be shared between drivers.
	  If you're not using Android its probably safe to
	  say N here.

config ION_SYSTEM_HEAP
	bool "Ion system heap"
	depends on ION
	help
	  Choose this option to enable the Ion system heap. The system heap
	  is backed by pages from the buddy allocator. If in doubt, say Y.

config ION_CARVEOUT_HEAP
	bool "Ion carveout heap support"
	depends on ION
	help
	  Choose this option to enable carveout heaps with Ion. Carveout heaps
	  are backed by memory reserved from the system. Allocation times are
	  typically faster at the cost of memory not being used. Unless you
	  know your system has these regions, you should say N here.

config ION_CHUNK_HEAP
	bool "Ion chunk heap support"
	depends on ION
	help
          Choose this option to enable chunk heaps with Ion. This heap is
	  similar in function the carveout heap but memory is broken down
	  into smaller chunk sizes, typically corresponding to a TLB size.
	  Unless you know your system has these regions, you should say N here.

config ION_CMA_HEAP
	bool "Ion CMA heap support"
	depends on ION && DMA_CMA
	help
	  Choose this option to enable CMA heaps with Ion. This heap is backed
	  by the Contiguous Memory Allocator (CMA). If your system has these
	  regions, you should say Y here.

config ION_MM
	tristate "Ion for MM"
	depends on ION
	select ION_OF
	help
	  Choose this option if you wish to use ion on H_MM Platform.

config ION_MM_CMA_HEAP
	bool "MM ION cma heap support"
	depends on ION_MM && ION_CMA_HEAP
	default n
	help
	  if you want to use mm_ion cma heap, you should select this.

config MM_ION_SECSG_DEBUG
	bool "MM ION secsg heap debug support"
	depends on ION_MM_SECSG
	default n
	help
	  if you want to debug ion secsg, you should select this.

config ION_MM_SECSG
	bool "MM ION secsg heap support"
	depends on ION_MM
	help
	 if you want to use secsg heap, you should select this.

config NEED_CHANGE_MAPPING
	bool "Need change secure memory's mapping prot"
	depends on ION_MM_SECSG
	help
	  This config exists for secure memory. If you need to change the mapping
	  prot of the memory to ensure that it will not be speculatively accessed
	  by the CPU, you need make it to be Y.

config SECMEM_TEST
	bool "sec memory alloc test"
	depends on ION_MM_SECSG
	help
	  Only for sec memory alloc test in develop version.

config ION_MM_CPA
	bool "MM ION cpa heap support"
	depends on ION_MM
	default n
	help
	  if you want to use cpa heap, you should select this.

config ION_MM_DMA_POOL
	bool "MM ION DMA pool heap support"
	depends on ION_MM
	help
	  if you want to use DMA pool heap, you should select this.

config ION_MM_SECCM
	bool "MM ION seccm heap support"
	depends on ION_MM
	help
	 if you want to use seccm heap, you should select this.

config ION_MM_SUPPORT_4GPLUS
	bool "MM ION can support allocation above 4G"
	depends on ION
	default n
```

## drivers/video/Kconfig
```kconfig
# SPDX-License-Identifier: GPL-2.0-only
#
# Video configuration
#

menu "Graphics support"

if HAS_IOMEM

config HAVE_FB_ATMEL
	bool

source "drivers/char/agp/Kconfig"

source "drivers/gpu/vga/Kconfig"

source "drivers/gpu/host1x/Kconfig"
source "drivers/gpu/ipu-v3/Kconfig"

source "drivers/gpu/drm/Kconfig"

menu "Frame buffer Devices"
source "drivers/video/fbdev/Kconfig"
endmenu

menu "Display Process Units"
config DKMD
	bool "Enable new display kernel mode drivers"
	default n
if DKMD
	source "drivers/video/fbdev/dkmd/Kconfig"
endif
config DKMD_OLD_ARCH
	bool "Enable display dkmd old arch drivers"
	default n
if DKMD_OLD_ARCH
	source "drivers/video/fbdev/hisi/Kconfig"
endif
if !DKMD && !DKMD_OLD_ARCH
	source "drivers/video/fbdev/dkmd/dpu/azalea/Kconfig"
	source "drivers/video/fbdev/dkmd/mdfx/Kconfig"
endif
endmenu

source "drivers/video/backlight/Kconfig"

config VGASTATE
	tristate
	default n

config VIDEOMODE_HELPERS
	bool

config HDMI
	bool

endif # HAS_IOMEM

if VT
	source "drivers/video/console/Kconfig"
endif

if FB || SGI_NEWPORT_CONSOLE
	source "drivers/video/logo/Kconfig"

endif


endmenu
```

## drivers/video/fbdev/dkmd/backlight/Kconfig
```kconfig
config DKMD_BACKLIGHT
	bool "DKMD support backlight driver"
	default n
	help
	  This feature driver supports DKMD config by backlight.
```

## drivers/video/fbdev/dkmd/dpu/azalea/ace/vbe/Kconfig
```kconfig
config DPU_CDC_ACE
	tristate "display software virtualization support"
	help
	  This driver support display software virtualization.

config DPU_FB_V510
	tristate "DPU FB V510 Framebuffer support"
	depends on DPU_CDC_ACE
	help
	  This display driver supports DPU V510.

config DPU_FB_ENG_DBG
	tristate "DPU FB ENG DEBUG support"
	depends on DPU_CDC_ACE
	help
	  This config only used in eng version.
```

## drivers/video/fbdev/dkmd/mdfx/Kconfig
```kconfig
config DPU_MDFX
	tristate "DPU multimedia dfx"
	default n
	help
	  This is multimedia module dfx driver
```

## fs/hmfs/Kconfig
```kconfig
config HMFS_FS
	tristate "HMFS filesystem support"
	depends on BLOCK && MAS_UNISTORE_PRESERVE
	select CRYPTO
	select CRYPTO_CRC32
	select HMFS_FS_XATTR if FS_ENCRYPTION
	select FS_ENCRYPTION_ALGS if FS_ENCRYPTION
	help
	  HMFS is based on Log-structured File System (LFS), which supports
	  versatile "flash-friendly" features. The design has been focused on
	  addressing the fundamental issues in LFS, which are snowball effect
	  of wandering tree and high cleaning overhead.

	  Since flash-based storages show different characteristics according to
	  the internal geometry or flash memory management schemes aka FTL, HMFS
	  and tools support various parameters not only for configuring on-disk
	  layout, but also for selecting allocation and cleaning algorithms.

	  If unsure, say N.

config HMFS_STAT_FS
	bool "HMFS Status Information"
	depends on HMFS_FS && DEBUG_FS
	default y
	help
	  /sys/kernel/debug/hmfs/ contains information about all the partitions
	  mounted as hmfs. Each file shows the whole hmfs information.

	  /sys/kernel/debug/hmfs/status includes:
	    - major filesystem information managed by hmfs currently
	    - average SIT information about whole segments
	    - current memory footprint consumed by hmfs.

config HMFS_FS_XATTR
	bool "HMFS extended attributes"
	depends on HMFS_FS
	default y
	help
	  Extended attributes are name:value pairs associated with inodes by
	  the kernel or by users (see the attr(5) manual page, or visit
	  <http://acl.bestbits.at/> for details).

	  If unsure, say N.

config HMFS_FS_POSIX_ACL
	bool "HMFS Access Control Lists"
	depends on HMFS_FS_XATTR
	select FS_POSIX_ACL
	default y
	help
	  Posix Access Control Lists (ACLs) support permissions for users and
	  groups beyond the owner/group/world scheme.

	  To learn more about Access Control Lists, visit the POSIX ACLs for
	  Linux website <http://acl.bestbits.at/>.

	  If you don't know what Access Control Lists are, say N

config HMFS_FS_SECURITY
	bool "HMFS Security Labels"
	depends on HMFS_FS_XATTR
	help
	  Security labels provide an access control facility to support Linux
	  Security Models (LSMs) accepted by AppArmor, SELinux, Smack and TOMOYO
	  Linux. This option enables an extended attribute handler for file
	  security labels in the hmfs filesystem, so that it requires enabling
	  the extended attribute support in advance.

	  If you are not using a security module, say N.

config HMFS_CHECK_FS
	bool "HMFS consistency checking feature"
	depends on HMFS_FS
	help
	  Enables BUG_ONs which check the filesystem consistency in runtime.

	  If you want to improve the performance, say N.

config HMFS_IO_TRACE
	bool "HMFS IO tracer"
	depends on HMFS_FS
	depends on FUNCTION_TRACER
	help
	  HMFS IO trace is based on a function trace, which gathers process
	  information and block IO patterns in the filesystem level.

	  If unsure, say N.

config HUAWEI_HMFS_DSM
	bool "Listen hmfs kernel err"
	default n
	help
		use huawei fs log radar

config HMFS_FAULT_INJECTION
	bool "HMFS fault injection facility"
	depends on HMFS_FS
	help
	  Test HMFS to inject faults such as ENOMEM, ENOSPC, and so on.

	  If unsure, say N.
config HISI_HMFS_MTIME
	bool "reduce freq to update mtime"
	default n
	help
		reduce freq to update mtime

config HMFS_JOURNAL_APPEND
	bool "HMFS append sit and nat journal size"
	depends on HMFS_FS
	default n
	help
	  append 2 blocks for sit and nat journal

config HMFS_GRADING_SSR
	bool "HMFS grading ssr"
	depends on HMFS_FS
	default n
	help
	  use grading ssr to improve the end performance

config HMFS_FS_COMPRESSION
	bool "HMFS compression feature"
	depends on HMFS_FS
	help
	  Enable filesystem-level compression on f2fs regular files,
	  multiple back-end compression algorithms are supported.

config HMFS_FS_LZO
	bool "LZO compression support"
	depends on HMFS_FS_COMPRESSION
	select LZO_COMPRESS
	select LZO_DECOMPRESS
	default y
	help
	  Support LZO compress algorithm, if unsure, say Y.

config HMFS_FS_LZ4
	bool "LZ4 compression support"
	depends on HMFS_FS_COMPRESSION
	select LZ4_COMPRESS
	select LZ4_DECOMPRESS
	default y
	help
	  Support LZ4 compress algorithm, if unsure, say Y.

config HMFS_FS_ZSTD
	bool "ZSTD compression support"
	depends on HMFS_FS_COMPRESSION
	select ZSTD_COMPRESS
	select ZSTD_DECOMPRESS
	default y
	help
	  Support ZSTD compress algorithm, if unsure, say Y.

config HMFS_KIRIN_ENCRYPTION
	bool "enable hmfs encryption features about kirin platform"
	depends on HMFS_FS
	default n
	help
		enable hmfs encryption features about kirin platform

config HMFS_CHIP_QCOM
	bool "enable hmfs features about qcom platform"
	depends on HMFS_FS
	default n
	help
	  enable hmfs features about qcom platform
```
