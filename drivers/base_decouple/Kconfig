## drivers/base_decouple/Kconfig
```kconfig
config HISI_AP_CP_DECOUPL
    bool "decouple the ap && cp for kernel"
    default n
    help
        Say 'Y' if you support decoupling
        Say 'N' if you do not

config HISI_INC_MODEM_CONFIG
        bool "whether or not to include modem config for kernel"
        default n
        help
          Say 'Y' if you want to include modem config.
              so kernel modem can be compiled.
          Say 'N' if you don't want to include modem config,
              so skip modem config check in check_menuconfig.
          Suggestion is to say 'N' in kernel config and "Y' in modem.

config HISI_CMDLINE_PARSE
	bool "cmdline parse"
	default n
	help
	  Say 'Y' here if you want to support the cmdline parse
	  on platform

config HISI_CORE_CTRL
	bool "core control"
	default n
	help
	  This option enables the core control functionality in
	  the scheduler. Core control automatically isolate and
	  unisolate cores based on cpu load and utilization.

config HISI_RPROC
    bool "ipc kernel API"
    default n
    help
        ipc kernel API about remote processor communication

config HISI_BB
	bool "kernel run data recorder"
	depends on SYSFS
	default n
	help
	  This module can record some data about kernel internal info.
	  Include:
	  the task switch,
	  interrupts switch,
	  arm exception info,
	  etc ...
```

## drivers/devfreq/ddr_devfreq/Kconfig
```kconfig
config DDR_DEVFREQ
	tristate "DDR DEVFREQ Driver"
	depends on ARCH_PLATFORM && PM_DEVFREQ
	select PM_OPP
	select DEVFREQ_GOV_PM_QOS
	help
	  This enables the DDR devfreq driver.

config DDR_DEVFREQ_PLATFORM
	tristate "DDR DEVFREQ PLATFORM Driver"
	depends on ARCH_PLATFORM && PM_DEVFREQ
	select PM_OPP
	select DEVFREQ_GOV_PLATFORM_QOS
	help
	  This enables the DDR devfreq platform driver.

config DEVFREQ_GOV_PM_QOS
	bool "PM QOS"
	help
	  Sets the frequency based on pm_qos throughput constraints.

config DEVFREQ_GOV_PLATFORM_QOS
	bool "PLATFORM QOS"
	help
	  Sets the frequency based on platform_qos throughput constraints.

config DEVFREQ_L1BUS_LATENCY
	bool "PM QOS L1BUS"
	depends on DEVFREQ_GOV_PM_QOS
	help
	  Sets the l1bus frequency based on pm_qos throughput constraints.

config DEVFREQ_L1BUS_LATENCY_PLATFORM
	bool "PLATFORM QOS L1BUS"
	depends on DEVFREQ_GOV_PLATFORM_QOS
	help
	  Sets the l1bus frequency based on platform_qos throughput constraints.

config DDR_HW_VOTE_15BITS
	bool "ddr dfs hardware vote 15 bits"
	depends on DDR_DEVFREQ || DDR_DEVFREQ_PLATFORM
	default n
	help
	  ddr dfs "hardware vote 15 bits" enbale.

config DDR_FREQ_BACKUP
        bool "ddr freq buckup vote for s4"
        depends on DDR_DEVFREQ || DDR_DEVFREQ_PLATFORM
        default n
        help
          ddr dfs "ddr freq buckup vote for s4" enbale.

config DDR_MEM_PERF_SCENE_AWARE
	bool "ddr memory perf scene aware"
	help
	  Provide interface to select multiple perf scenes

config DDR_DEVFREQ_DFX
	bool "DDR devfreq dfx info"
	depends on DDR_DEVFREQ || DDR_DEVFREQ_PLATFORM
	default n
	help
	  Record and print ddr devfreq dfx info record and print.
```

## drivers/devkit/audiokit/adsp_misc/Kconfig
```kconfig
config HUAWEI_ADSP_MISC
    bool "audio dsp driver for ipi adapter"
    default n
    help
    Say Y to enable adsp misc driver support

config ADSP_HUAWEI_SHARED_MEM
    bool "mtk shared mem between ap and adsp for huawei params"
    depends on HUAWEI_ADSP_MISC
    default n
    help
    Say Y to enable shared mem driver support
```

## drivers/devkit/audiokit/audio_gpio_ctl/Kconfig
```kconfig
config AUDIO_GPIO_CTL
	tristate "tdd gpio driver"
	default n
	help
		Say Y to enable device boxid driver support
```

## drivers/devkit/audiokit/trace/Kconfig
```kconfig
config AUDIO_TRACE
	bool "huawei audio trace driver"
	default n
	help
	  Enable this option to trace audio.
```

## drivers/dubai/Kconfig
```kconfig
menu "Device Usage Big-data Analytics Initiative Support"

config POWER_DUBAI
	bool "Device Usage Big-data Analytics Initiative Support"
	default n
	select HUAWEI_DUBAI
	help
	  This driver provides DUBAI feature

config HUAWEI_DUBAI
	bool "Device Usage Big-data Analytics Initiative Support"
	default n
	help
	  This driver provides DUBAI feature

config POWER_DUBAI_TASK_CPU_POWER
	bool "DUBAI Task CPU Power"
	default n
	depends on POWER_DUBAI && (CPU_FREQ_POWER_STAT || ARCH_MSM)
	help
	  Get task cpu power

config POWER_DUBAI_RGB_STATS
	bool "DUBAI Rgb Stats"
	default n
	depends on POWER_DUBAI && FB
	help
	  Get Rgb Stats

endmenu
```

## drivers/edac/lpedac/Kconfig
```kconfig
config CPU_EDAC_ARM64
	depends on ARM64
	tristate "CPU L1/L2/L3/SCU Caches"
	help
	   Support for error detection and correction on the CPUs.
	   Reports errors caught by ECC mechanism.
	   For debugging issues having to do with stability and overall system
	   health, you should probably say 'Y' here.

config RAS_EDAC
	depends on ARM64 && !CPU_EDAC_ARM64 && !DFX_L3CACHE_ECC
	tristate "RAS EDAC"
	help
	   Support for error detection and correction on the CPUs.
	   Reports errors caught by ECC mechanism.
	   For debugging issues having to do with stability and overall system
	   health, you should probably say 'Y' here.

config RAS_EDAC_DEBUG
	depends on ARM64 && DFX_DEBUG_FS
	tristate "RAS EDAC DEBUG"
	help
	   Support for error detection and correction on the CPUs.
	   Reports errors caught by ECC mechanism.
	   For debugging issues having to do with stability and overall system
	   health, you should probably say 'Y' here.


config CPU_EDAC_ARM64_DEBUG
	depends on CPU_EDAC_ARM64
	bool "Debug for CPU EDAC ECC"
	help
	   For debug edac ecc, you should probably say 'Y' here.
```

## drivers/gpu/arm/valhall-r34p0-01eac0-cdc/platform/hisilicon/Kconfig
```kconfig
#
# Copyright (c) Huawei Technologies Co., Ltd. 2014-2021. All rights reserved.
# Description: This file describe GPU hardware related features
# Create: 2014-2-24
#
# This program is free software and is provided to you under the terms of the
# GNU General Public License version 2 as published by the Free Software
# Foundation, and any use by you of this program is subject to the terms
# of such GNU licence.
#
# A copy of the licence is included with the program, and can also be obtained
# from Free Software Foundation, Inc., 51 Franklin Street, Fifth Floor,
# Boston, MA  02110-1301, USA.
#
#

config MALI_GPU_BUG_ON
	bool "Bug on for gpu steadiness"
	depends on MALI_MIDGARD && MALI_EXPERT
	default n
	help
	  Open bug on in mali driver for gpu steadiness.

config MALI_MIDGARD_RT_PM
	bool "Enable Runtime power management"
	depends on MALI_MIDGARD
	depends on PM_RUNTIME || PM
	default n
	help
	  Choose this option to enable runtime power management in the Mali Midgard DDK.

config GPU_CORE_HOTPLUG
	bool "Enable gpu core hotplug if high temperature scenario"
	depends on MALI_MIDGARD && MALI_EXPERT
	default n
	help
	  enable some cores shutdown if the thermal need reduce gpu power consumption

config GPU_SHADER_PRESENT_CFG
	bool "Enable shader present configuration"
	depends on MALI_MIDGARD && MALI_EXPERT
	default n
	help
	  enable shader present configuration
```

## drivers/hisi/tzdriver/Kconfig
```kconfig
menu "TEE OS"

config TZDRIVER
	tristate "Secure Execution Communicator driver"
	default n
	help
	  Provides a communication interface between userspace and
	  TrustZone Operating Environment.

config SECBOOT_IMG
	bool "tzdriver split secboot img into modem and ap"
	default n
	depends on KERNEL_CLIENT
	help
	  Macro defined for splitting modem and ap img

config SECBOOT_IMG_V2
	bool "tzdriver split modem and ap for v2"
	default n
	depends on KERNEL_CLIENT
	help
	  Macro defined for splitting modem and ap img v2

config ASAN_DEBUG
	bool "ASAN debug version"
	default n
	help
	  Macro defined for ASAN debug version

source  "drivers/platform_drivers/tzdriver/auth/Kconfig"
source  "drivers/platform_drivers/tzdriver/core/Kconfig"
source  "drivers/platform_drivers/tzdriver/ion/Kconfig"
source  "drivers/platform_drivers/tzdriver/tlogger/Kconfig"
source  "drivers/platform_drivers/tzdriver/tui/Kconfig"
source  "drivers/platform_drivers/tzdriver/agent_rpmb/Kconfig"
endmenu
```

## drivers/hisi/tzdriver/ca_antiroot/Kconfig
```kconfig
#
# tee root scan client configuration
#

config TEE_ANTIROOT_CLIENT
        bool "A client to scan root status"
#        depends on HW_ROOT_SCAN
        default n
        help
           this is a TEE root scan client,
	   that use huawei root scan engine
	   to gather kernel info, and send to
	   TEE to verify kernel.


config HUAWEI_ROOT_SCAN_DUMMY_API
	bool "dummy api for test of TEE_ANTIROOT_CLIENT"
	depends on TEE_ANTIROOT_CLIENT
	default n
	help
	   this is dummy api for test of TEE_ANTIROOT_CLIENT.
	   It mimics the API of HW_ROOT_SCAN, so we
	   can test antiroot CA/TA.
	   SHOULD turn off this when HW_ROOT_SCAN is on.

config TEE_ANTIROOT_CLIENT_ENG_DEBUG
	bool "TEE ANTIROOT CLIENT for engineering mode debug"
	depends on TEE_ANTIROOT_CLIENT
	default n
	help
	   This option should only be enabled for engineering mode & debug test.

config HW_ROOT_SCAN_RODATA_MEASUREMENT_API
	bool "this api enable part of rodata measurement in kernel"
	depends on TEE_ANTIROOT_CLIENT
	default n
	help
	  this api enable part of rodata measurement in kernel, cooperate with
	  TEE_RODATA_MEASUREMENT in ANTIROOT TA will enable rodata measurement
	  and verify result in ANTIROOT TA.
```

## drivers/hisi/tzdriver/tlogger/Kconfig
```kconfig
config TEELOG
	bool "Secure Execution Log Driver"
	default n
	depends on TZDRIVER
	help
	  TEEOS log

config TEE_LOG_ACHIVE_PATH
	string "Tee log achive path"
	default "/data/log/tee/last_teemsg"
	depends on TEELOG
	help
	  Last tee msg log path

config TEE_KTRACE
	bool "TEEOS Kernel Event Log Driver"
	default n
	depends on TEELOG
	help
	  TEEOS event trace

config TEE_LOG_EXCEPTION
	bool "Log Exception Info to Imonitor"
	default n
	depends on TEELOG
	help
	  Log exception info to imonitor

choice
	prompt "Register tee log Mem"
	default PAGES_MEM
	depends on TEELOG

config RDR_MEM
	bool "Register rdr log mem"
	depends on DFX_BB
	help
	  Register rdr log mem

config BBOX_MEM
	bool "Register bbox log mem"
	depends on MNTN
	help
	  Register bbox log mem

config PAGES_MEM
	bool "Register pages log mem"
	help
	  Register pages log mem

endchoice
```

## drivers/huawei_platform/hw_fan/Kconfig
```kconfig
#
# huawei pwm fan driver configuration
#

config HW_PWM_FAN
	bool "huawei pwm fan"
	default n
	help
	  If you say yes here you get support for huawei pwm fan.
```

## drivers/huawei_platform/hw_led/Kconfig
```kconfig
#
#led config driver configuration
#
menuconfig HW_LED_CONFIG
	bool "led config driver"
	default n
	help
	Say yes here to support for led config driver.

config LEDS_LIGHT_RING
	bool "leds config light ring driver"
	default n
	help
		This allows LEDs to be controlled by leds activity.
		If unsure, say n.
```

## drivers/huawei_platform/hw_oled_spi/Kconfig
```kconfig
config HUAWEI_OLED_SPI
	bool "huawei oled spi display"
	default n
	help
	  Say Y here to enable oled spi dispaly driver.
	  This driver works on robot.
```

## drivers/huawei_platform/hw_peripheral/Kconfig
```kconfig
source "drivers/huawei_platform/hw_peripheral/sw/Kconfig"
source "drivers/huawei_platform/hw_peripheral/plc/Kconfig"
```

## drivers/huawei_platform/hw_peripheral/plc/Kconfig
```kconfig
#
# huawei PLC detection and reset drivers
#

config HW_GPIO_PLC
	tristate "Detect and reset PLC driver"
	default n
	help
	  Detect and reset PLC driver.
```

## drivers/huawei_platform/inputhub/Kconfig
```kconfig
menuconfig INPUTHUB
	bool "InputHub feature support"
	default n
	help
	Say yes here to support inputhub feature.

menuconfig INPUTHUB_20
	bool "InputHub feature2.0 support"
	default n
	help
	Say yes here to support inputhub2.0 feature.

menuconfig CYPRESS_PSOC4000
	bool "cypress capsense support"
	default n
	help
	Say yes here if you want to configure cypress capsense

config INPUTHUB_20_710
	bool "INPUTHUB_20_710"
	depends on INPUTHUB_20 && !INPUTHUB_30
	default n
	help
	Say yes here if you want to configure INPUTHUB_20 version

config INPUTHUB_20_970
	bool "INPUTHUB_20_970"
	depends on INPUTHUB_20 && !INPUTHUB_30
	default n
	help
	Say yes here if you want to configure INPUTHUB_20 version

config CONTEXTHUB_IDLE_32K
	bool "CONTEXTHUB_IDLE_32K"
	depends on INPUTHUB || INPUTHUB_20
	default n
	help
	Say yes here if you want to configure CONTEXTHUB_IDLE_32K

config IOM3_RECOVERY
	bool "iom3 recovery feature support"
	depends on INPUTHUB
	default n
	help
	Say yes here to support the cmdline parse

config INPUTHUB_VIBRATOR_CHANNEL
	bool "inputhub vibrator channel support"
	depends on INPUTHUB || INPUTHUB_20
	default n
	help
	Say yes here to support the cmdline parse
```

## drivers/huawei_platform/nfc/nfc_tags/Kconfig
```kconfig
config NFC_TAGS
	tristate "nfc tags"
	depends on I2C
	default n
	help
	   NFC controller core driver.
```

## drivers/huawei_platform/piezo_key/Kconfig
```kconfig
#
# piezo key driver configuration
#
menuconfig PIEZO_KEY
	bool "piezo key driver"
	default n
	help
	Say yes here to support for piezo key.
```

## drivers/huawei_platform/power/battery/battery_ct/nations/Kconfig
```kconfig
# SPDX-License-Identifier: GPL-2.0
# Nations Technologies Inc NS3300 drivers

config BATTCT_NS3300
	bool
	prompt "Support NS3300 as certification IC."
	depends on HUAWEI_BATTERY_INFORMATION
	default n
	help
	Say Y here to enable NS3300 ic driver
```

## drivers/huawei_platform/recovery_key/Kconfig
```kconfig
#
# huawei gpio key recovery driver
#

config HW_GPIO_KEY_RECOVERY
	bool "hw gpio key recovery driver"
	default n
	help
	  gpio key recovery driver.
```
