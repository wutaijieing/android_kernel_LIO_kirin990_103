## drivers/huawei_platform/robot_mcu/Kconfig
```kconfig
config HUAWEI_ROBOT_MCU
	bool "huawei robot mcu control"
	default n
	help
		Huawei robot mcu contol: ap reset mcu, mcu wakeup ap, and so on.
```

## drivers/huawei_platform/sensor/privacy_mask/Kconfig
```kconfig
#
# huawei privacy mask driver
#

config KERNEL_CAMERA_SYH702DFC
	tristate "SYH702DFC privacy mask driver"
	default n
	help
	  SYH702DFC privacy mask driver
```

## drivers/huawei_platform/usb/pd/Kconfig
```kconfig
source "drivers/huawei_platform/usb/pd/richtek/Kconfig"

config TYPEC_CAP_CUSTOM_SRC2
        bool "Support Double 22/10k Pullup Function"
        default n
        help
          Say Y to enable

config RT_USB_PD
        bool "Support richtek usb pd"
        default n
        help
          Say Y to enable

config FSC_USB_PD
        bool "Support fsc usb pd"
        default n
        help
          Say Y to enable

config DEV_USB_PD
        bool "Support develop usb pd"
        default n
        help
          Say Y to enable
```

## drivers/hwpower/cc_accessory/Kconfig
```kconfig
# SPDX-License-Identifier: GPL-2.0
#
# huawei lightstrap drivers
#

config WIRELESS_LIGHTSTRAP
	bool "wireless lightstrap"
	default n
	help
	  Say Y here to enable lightstrap driver.
```

## drivers/hwpower/cc_battery/battery_1s2p/Kconfig
```kconfig
# SPDX-License-Identifier: GPL-2.0
#
# huawei parallel connection of two batteries driver
#

config HUAWEI_BATTERY_1S2P
	bool "huawei parallel connection of two batteries driver"
	default n
	help
	  Say Y here to enable huawei parallel connection of two batteries driver.
	  It monitor dual battery infomation and provid dual battery power supply.
	  It merge dual battery infomation for battery power supply.
```

## drivers/hwpower/cc_charger/Kconfig
```kconfig
# SPDX-License-Identifier: GPL-2.0

config CHARGE_MANAGER
	bool "charge manager"
	default n
```

## drivers/hwpower/cc_common_module/power_debug/Kconfig
```kconfig
# SPDX-License-Identifier: GPL-2.0
#
# huawei power debug drivers
#

config HUAWEI_POWER_DEBUG
	bool "huawei power debug module"
	default n
	help
	  Say Y here to enable power debug driver.
```

## drivers/hwpower/cc_common_module/power_firmware/Kconfig
```kconfig
# SPDX-License-Identifier: GPL-2.0
#
# huawei power firmware drivers
#

config HUAWEI_POWER_FIRMWARE
	bool "huawei power firmware module"
	default n
	help
	  Say Y here to enable power firmware driver.
```

## drivers/hwpower/cc_common_module/power_supply/Kconfig
```kconfig
# SPDX-License-Identifier: GPL-2.0
#
# huawei power supply drivers
#

config HUAWEI_POWER_SUPPLY
	bool "huawei power supply"
	depends on POWER_SUPPLY
	default n
	help
	  Say Y here to enable power supply drivers.

config HUAWEI_POWER_SUPPLY_APPLICATION
	bool "huawei power supply application"
	depends on POWER_SUPPLY
	default n
	help
	  Say Y here to enable power supply application drivers.
```

## drivers/hwpower/cc_hardware_channel/Kconfig
```kconfig
# SPDX-License-Identifier: GPL-2.0
#
# huawei hardware channel drivers
#

source "drivers/hwpower/cc_hardware_channel/wired_channel_switch/Kconfig"
source "drivers/hwpower/cc_hardware_channel/vbus_channel/Kconfig"
source "drivers/hwpower/cc_hardware_channel/charger_channel/Kconfig"
```

## drivers/hwpower/cc_hardware_channel/charger_channel/Kconfig
```kconfig
# SPDX-License-Identifier: GPL-2.0
#
# huawei charger channel drivers
#

config CHARGER_CHANNEL
	bool "charger channel"
	default n
	help
	  Say Y here to enable charger channel driver.
	  This driver provides a unified interface for choosing charger channel
	  Currently supported usbin channel and wlsin channel
	  as a charger channel function.
```

## drivers/hwpower/cc_hardware_ic/charge_pump/Kconfig
```kconfig
# SPDX-License-Identifier: GPL-2.0
#
# charge_pump drivers
#

config CHARGE_PUMP
	bool "charge pump"
	default n
	help
	  Say Y here to enable charge pump driver.
	  This driver provides a unified interface to charge pump.
	  This driver is in logic layer.

config CHARGE_PUMP_HL1506
	bool "charge pump hl1506"
	depends on CHARGE_PUMP
	default n
	help
	  Say Y here to enable hl1506 driver.
	  The hl1506 is an soc for charge-pump converter.
	  It is fully compliant with the latest receiver to make
	  the input current to be half the current delivered to the output.

config CHARGE_PUMP_SY6510
	bool "charge pump sy6510"
	depends on CHARGE_PUMP
	default n
	help
	  Say Y here to enable sy6510 driver.
	  The sy6510 is an soc for charge-pump converter.
	  It is fully compliant with the latest receiver to make
	  the input current to be half the current delivered to the output.

config CHARGE_PUMP_PCA9488
	bool "charge pump pca9488"
	depends on CHARGE_PUMP
	default n
	help
	  Say Y here to enable pca9488 driver.
	  The PCA9488 is a highly-integrated switched-capacitor converter
	  with a dual-input, targeted to provide a doubled output current
	  for a fast charging application.
	  It is fully compliant with the latest receiver to make
	  the input current to be half the current delivered to the output.

config CHARGE_PUMP_HL1512
	bool "charge pump hl1512"
	depends on CHARGE_PUMP
	default n
	help
	  Say Y here to enable hl1512 driver.
	  The hl1512 is an soc for charge-pump converter.
	  It is fully compliant with the latest receiver to make
	  the input current to be half the current delivered to the output.

config CHARGE_PUMP_SC8502
	bool "charge pump sc8502"
	depends on CHARGE_PUMP
	default n
	help
	  Say Y here to enable sc8502 driver.
	  The sc8502 is an soc for charge-pump converter.
	  It is fully compliant with the latest receiver to make
	  the input current to be half the current delivered to the output.

config CHARGE_PUMP_RT9758
	bool "charge pump rt9758"
	depends on CHARGE_PUMP
	default n
	help
	  Say Y here to enable rt9758 driver.
	  The rt9758 is an soc for charge-pump converter.
	  It is fully compliant with the latest receiver to make
	  the input current to be half the current delivered to the output.

config CHARGE_PUMP_SY6512
	bool "charge pump sy6512"
	depends on CHARGE_PUMP
	default n
	help
	  Say Y here to enable sy6512 driver.
	  The sy6512 is an soc for charge-pump converter.
	  It is fully compliant with the latest receiver to make
	  the input current to be half the current delivered to the output.
```

## drivers/hwpower/cc_hardware_ic/fuel_gauge/Kconfig
```kconfig
# SPDX-License-Identifier: GPL-2.0
#
# fuel gauge ic drivers
#

config FUEL_GAUGE
	bool "fuel gauge"
	default n
	help
	  Say Y here to enable fuel gauge.
	  This driver provides a unified interface to the coul.
	  Currently supported coul as below.
	  rt9426
	  cw2217
	  bq27z561
	  bq40z50

config RT9426_FUEL_GAUGE
	bool "rt9426 fuel gauge"
	depends on FUEL_GAUGE
	default n
	help
	  Say Y here to enable rt9426 fuel gauge driver.
	  this driver provides some interfaces to the coul.
	  also support a few high accuracy battery elements.
	  for example current and voltage.

config CW2217_FUEL_GAUGE
	bool "cw2217 fuel gauge"
	depends on FUEL_GAUGE
	default n
	help
	  Say Y here to enable cw2217 fuel gauge driver.
	  this driver provides some interfaces to the coul.
	  also support a few high accuracy battery elements.
	  for example current and voltage.

config BQ27Z561_FUEL_GAUGE
	bool "bq27z561 fuel gauge"
	depends on FUEL_GAUGE
	default n
	help
	  Say Y here to enable bq27z561 fuel gauge driver.
	  this driver provides some interfaces to the coul.
	  also support a few high accuracy battery elements.
	  for example current and voltage.

config BQ40Z50_FUEL_GAUGE
	bool "bq40z50 fuel gauge"
	depends on FUEL_GAUGE
	default n
	help
	  Say Y here to enable bq40z50 fuel gauge driver.
	  this driver provides some interfaces to the coul.
	  also support a few high accuracy battery elements.
	  for example current and voltage.
```

## drivers/hwpower/cc_hardware_ic/protocol_ic/Kconfig
```kconfig
# SPDX-License-Identifier: GPL-2.0
#
# protocol ic drivers
#

config PROTOCOL_IC_SC200X
	bool "sc200x protocol ic"
	depends on ADAPTER_PROTOCOL
	default n
	help
	  Say Y here to enable sc200x protocol ic driver.
	  the sc200x protocol ic is used to communicate between a master device
	  and a single device over a singe wire bus. it is support SCP/FCP
	  fast charging protocol and type protocol.
	  This driver is to be used to configure, contorl and read status of
	  a slave device.

config PROTOCOL_IC_STM32G031
	bool "stm32g031 protocol ic"
	depends on ADAPTER_PROTOCOL
	default n
	help
	  Say Y here to enable stm32g031 protocol ic driver.
	  the stm32g031 protocol ic is used to communicate between a master device
	  and a single device over a singe wire bus. it is support SCP/FCP
	  fast charging protocol and type protocol.
	  This driver is to be used to configure, contorl and read status of
	  a slave device.

config PROTOCOL_IC_HC32L110
	bool "hc32l110 protocol ic"
	depends on ADAPTER_PROTOCOL
	default n
	help
	  Say Y here to enable hc32l110 protocol ic driver.
	  the hc32l110 protocol ic is used to communicate between a master device
	  and a single device over a singe wire bus. it is support SCP/FCP
	  fast charging protocol and type protocol.
	  This driver is to be used to configure, contorl and read status of
	  a slave device.
```

## drivers/hwpower/cc_hardware_ic/wireless_charge_ic/Kconfig
```kconfig
# SPDX-License-Identifier: GPL-2.0
#
# wireless charge ic driver
#

config WIRELESS_NU1619
	bool "wireless nu1619"
	depends on WIRELESS_CHARGER
	default n
	help
	  Say Y here to enable nu1619 driver.
	  The nu1619 is an soc for magnetic induction
	  based wireless power receiver. it is fully compliant
	  with latest WPC Qi specification of BPP and EPP
	  and also supports various proprietary fast charging
	  protocols used by major smart phone OEM.

config WIRELESS_STWLC68
	bool "wireless stwlc68"
	depends on WIRELESS_CHARGER
	default n
	help
	  Say Y here to enable stwlc68 driver.
	  The stwlc68 is an soc for magnetic induction
	  based wireless power receiver. it is fully compliant
	  with latest WPC Qi specification of BPP and EPP
	  and also supports various proprietary fast charging
	  protocols used by major smart phone OEM.

config WIRELESS_CPS7181
	bool "wireless cps7181"
	depends on WIRELESS_CHARGER
	default n
	help
	  Say Y here to enable cps7181 driver.
	  The cps7181 is an soc for magnetic induction
	  based wireless power receiver. it is fully compliant
	  with latest WPC Qi specification of BPP and EPP
	  and also supports various proprietary fast charging
	  protocols used by major smart phone OEM.

config WIRELESS_CPS4029
	bool "wireless cps4029"
	depends on WIRELESS_CHARGER
	default n
	help
	  Say Y here to enable cps4029 driver.
	  The cps4029 is an soc for magnetic induction
	  based wireless power receiver. it is fully compliant
	  with latest WPC Qi specification of BPP and EPP
	  and also supports various proprietary fast charging
	  protocols used by major smart phone OEM.

config WIRELESS_CPS4057
	bool "wireless cps4057"
	depends on WIRELESS_CHARGER
	default n
	help
	  Say Y here to enable cps4057 driver.
	  The cps4057 is an soc for magnetic induction
	  based wireless power receiver. it is fully compliant
	  with latest WPC Qi specification of BPP and EPP
	  and also supports various proprietary fast charging
	  protocols used by major smart phone OEM.

config WIRELESS_STWLC88
	bool "wireless stwlc88"
	depends on WIRELESS_CHARGER
	default n
	help
	  Say Y here to enable stwlc88 driver.
	  The stwlc68 is an soc for magnetic induction
	  based wireless power receiver. it is fully compliant
	  with latest WPC Qi specification of BPP and EPP
	  and also supports various proprietary fast charging
	  protocols used by major smart phone OEM.

config WIRELESS_MT5735
	bool "wireless mt5735"
	depends on WIRELESS_CHARGER
	default n
	help
	  Say Y here to enable mt5735 driver.
	  The mt5735 is an soc for magnetic induction
	  based wireless power receiver. it is fully compliant
	  with latest WPC Qi specification of BPP and EPP
	  and also supports various proprietary fast charging
	  protocols used by major smart phone OEM.

config WIRELESS_MT5727
	bool "wireless mt5727"
	depends on WIRELESS_CHARGER
	default n
	help
	  Say Y here to enable mt5727 driver.
	  The mt5727 is an soc for magnetic induction
	  based wireless power receiver. it is fully compliant
	  with latest WPC Qi specification of BPP and EPP
	  and also supports various proprietary fast charging
	  protocols used by major smart phone OEM.

config WIRELESS_STWLC33
	bool "wireless stwlc33"
	depends on WIRELESS_CHARGER
	default n
	help
	  Say Y here to enable stwlc33 driver.
	  The stwlc33 is an soc for magnetic induction
	  based wireless power receiver. it is fully compliant
	  with latest WPC Qi specification of BPP and EPP
	  and also supports various proprietary fast charging
	  protocols used by major smart phone OEM.

config WIRELESS_CPS4067
	bool "wireless cps4067"
	depends on WIRELESS_CHARGER
	default n
	help
	  Say Y here to enable cps4067 driver.
	  The cps4067 is an soc for magnetic induction
	  based wireless power receiver. it is fully compliant
	  with latest WPC Qi specification of BPP and EPP
	  and also supports various proprietary fast charging
	  protocols used by major smart phone OEM.

config WIRELESS_MT5785
	bool "wireless mt5785"
	depends on WIRELESS_CHARGER
	default n
	help
	  Say Y here to enable mt5785 driver.
	  The mt5785 is an soc for magnetic induction
	  based wireless power receiver. it is fully compliant
	  with latest WPC Qi specification of BPP and EPP
	  and also supports various proprietary fast charging
	  protocols used by major smart phone OEM.

config WIRELESS_IDTP9415
	bool "wireless idt9415"
	depends on WIRELESS_CHARGER
	default n
	help
	  Say Y here to enable idtp9415 driver.
	  The idtp9415 is an soc for magnetic induction
	  based wireless power receiver. it is fully compliant
	  with latest WPC Qi specification of BPP and EPP
	  and also supports various proprietary fast charging
	  protocols used by major smart phone OEM.
```

## drivers/hwpower/cc_hardware_monitor/acr_detect/Kconfig
```kconfig
# SPDX-License-Identifier: GPL-2.0
#
# acr abnormal monitor drivers
#

config HUAWEI_BATT_ACR_DETECT
	bool "huawei batt acr detect"
	default n
	help
	  Say Y here to enable acr abnormal monitor driver.
```

## drivers/hwpower/cc_hardware_monitor/lga_check/Kconfig
```kconfig
# SPDX-License-Identifier: GPL-2.0
#
# lga board abnormal monitor drivers
#

config HUAWEI_LGA_CHECK
	bool "lga board abnormal monitor"
	default n
	help
	  Say Y here to enable lga board abnormal monitor driver.
```

## drivers/hwpower/cc_hardware_monitor/vbus_monitor/Kconfig
```kconfig
# SPDX-License-Identifier: GPL-2.0
#
# vbus monitor drivers
#

config HUAWEI_VBUS_MONITOR
	bool "vbus monitor"
	default n
	help
	  Say Y here to enable vbus monitor driver.
```

## drivers/platform_drivers/Kconfig
```kconfig
menu "Hisilicon platform"

config ARCH_PLATFORM
	bool "arch soc platform"
	help
	  This enables support for arch soc platform

config AB_APCP_NEW_INTERFACE
        bool "ap cp with new interface"
        help
          This enables support for ap cp with new interface

menuconfig HISILICON_PLATFORM
	bool "Hisilicon platform support"
	default n
	help
	 Say yes here to support the hisilicon platform

if HISILICON_PLATFORM

if INC_MODEM_CONFIG || HISI_INC_MODEM_CONFIG
if AB_APCP_NEW_INTERFACE
-source "drivers/platform_drivers/modem/Kconfig"
endif
if !AB_APCP_NEW_INTERFACE
-source "drivers/hisi/modem/Kconfig"
endif
endif

source "drivers/platform_drivers/tzdriver/Kconfig"
source "drivers/platform_drivers/drg/Kconfig"
source "drivers/platform_drivers/audio/Kconfig"
endif #HISILICON_PLATFORM

endmenu
```
