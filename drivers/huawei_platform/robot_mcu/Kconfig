## drivers/platform_drivers/audio/rdr/Kconfig
```kconfig
config HIFI_BB
	bool "hifi bbox"
	depends on  DFX_BB
	default n
	help
	  This module can record some data about hifi info.
	  Include:
	  hifi exception,
	  etc

config ASP_WATCHDOG_V500
	tristate "Support asp watchdog v500"
	default n
	help
	  Enables the asp watchdog v500.

config AUDIO_SOC_SHARED_IRQ
	tristate "Support audio soc shared irq"
	default n
	help
	  Enables audio soc shared irq.
```

## drivers/platform_drivers/tzdriver/auth/Kconfig
```kconfig
# Auth Configuration
config CLIENT_AUTH
	bool "Client Application Hash Auth"
	default n
	depends on TZDRIVER
	help
	  TEEOS CA code hash auth

config ANDROID_HIDL
	bool "Android Hidl Adapt"
	default n
	depends on CLIENT_AUTH
	help
	  TEEOS hidl proc auth
```

## drivers/power/platform/Kconfig
```kconfig
config BATTERY_DATA
	bool "battery data"
	default n

config BCI_BATTERY
        bool "bci battery"
        default n

config CHARGE_TIME
        bool "Calculate the remaining time of charging"
        default n

config BATTERY_ISCD
        bool "battery iscd module"
        default n

config BATTERY_SYSFS
	bool "battery power sysfs control"
	default n

-source "drivers/power/platform/charger/Kconfig"
source "drivers/power/platform/coul/Kconfig"
-source "drivers/power/platform/soh/Kconfig"
-source "drivers/power/platform/eis/Kconfig"
-source "drivers/power/platform/polar/Kconfig"
```

## drivers/power/platform/charger/Kconfig
```kconfig
config SCHARGER
	bool "scharger driver"
	default n
	help
	  Compiling the platform/charger.
config SCHARGER_ARCH
	bool "scharger arch"
	default n
	help
	  enable scharger core.
config SCHARGER_V200
	bool "schargerV200"
	default n
config SCHARGER_V300
	bool "schargerV300"
	default n
config SCHARGER_V600
	bool "schargerV600"
	default n
config CHARGER_SYS_WDG
	bool "pmic charger sys watchdog"
	default n
config CHARGER_WDG
	bool "pmic charger watchdog"
	default n
config SCHARGER_SCP_PROTOCOL
	bool "scharger scp protocol"
	default n
```

## drivers/power/platform/coul/Kconfig
```kconfig
config COUL_DRV
        bool "pmic coul"
        default n
config COUL_PMIC6X21V500
        bool "pmic6x21v500 coul"
        default n
config COUL_PMIC6X21V600
	bool "pmic6x21v600 coul"
	default n
config COUL_PMIC6X55V100
        bool "pmic6x55v100 coul"
        default n
config COUL_PMIC6X55V200
        bool "pmic6x55v200 coul"
        default n
config COUL_PMIC6X21V700
	bool "pmic6x21v700 coul"
	default n
config COUL_PMIC6X21V800
	bool "pmic6x21V800 coul"
	default n
config COUL_PMIC6X55V300
	bool "pmic6x55V300 coul"
	default n
config COUL_PMIC6X55V500
	bool "pmic6x55V500 coul"
	default n
config COUL_PMIC6X21V900
	bool "pmic6x21v900 coul"
	default n
config COUL_TEST
        bool "coul test"
        default n
```
