## platform_source/basicplatform/drivers/qic/Kconfig
```kconfig
config DFX_SEC_QIC
	depends on DFX_BB
	bool "Support Secure QIC"
	default n
	help
	  This driver supports xxx secure QIC,
	  including qic driver
config DFX_SEC_QIC_MODID_REGISTER
	depends on DFX_SEC_QIC
	bool "Support Secure QIC modid register"
	default n
	help
	  Support Secure QIC modid register
```

## platform_source/basicplatform/drivers/regulator/Kconfig
```kconfig
config DRV_IP_REGULATOR
	tristate "system interior bus mtcmos control"
	depends on MFD_IP_CORE
	help
	 This driver provides system interior bus switch support for the IP regulator on the system.

config FREQ_AUTODOWN
	tristate "Support Bus automatic frequency reduction"
	depends on OF
	help
	  Bus automatic frequency reduction is a method for reducing power consumption
	  of the chip is proposed, through the bus load automatically reduced frequency.

config IP_REGULATOR_IPC
	tristate "system interior bus mtcmos IPC control"
	depends on IPC_MAILBOX
	help
	 This driver provides system interior bus switch support for the IP regulator IPC on the system.

config ATLA_IP_PLATFORM
        tristate "ATLA system interior bus control platform switch"
        depends on MFD_IP_CORE
        help
          This driver provides system interior bus switch for the IP regulator on the ATLA system.

config BOST_IP_PLATFORM
	tristate "system interior bus control platform switch"
	depends on MFD_IP_CORE
	help
	  This driver provides system interior bus switch for the IP regulator on the system.

config MIA_IP_PLATFORM
	tristate "MIA system interior bus control platform switch"
	depends on MFD_IP_CORE
	help
	  This driver provides system interior bus switch for the IP regulator on the MIA system.

config PHOE_IP_PLATFORM
    tristate "PHOE system interior bus control platform switch"
    depends on MFD_IP_CORE
    help
        This driver provides system interior bus switch for the IP regulator on the PHOE system.

config BALT_IP_PLATFORM
    tristate "BALT system interior bus control platform switch"
    depends on MFD_IP_CORE
    help
        This driver provides system interior bus switch for the IP regulator on the BALT system.

config BURB_IP_PLATFORM
    tristate "BBK system interior bus control platform switch"
    depends on MFD_IP_CORE
    help
        This driver provides system interior bus switch for the IP regulator on the BBK system.

config CHAR_IP_PLATFORM
    tristate "CHAR system interior bus control platform switch"
    depends on MFD_IP_CORE
    help
        This driver provides system interior bus switch for the IP regulator on the CHAR system.

config LEX_IP_PLATFORM
    tristate "LEX system interior bus control platform switch"
    depends on MFD_IP_CORE
    help
        This driver provides system interior bus switch for the IP regulator on the LEX system.

config NA_IP_PLATFORM
    tristate "NA system interior bus control platform switch"
    depends on MFD_IP_CORE
    help
        This driver provides system interior bus switch for the IP regulator on the NA system.

config CHARPRO_IP_PLATFORM
	tristate "CHARPRO system interior bus control platform switch"
	depends on MFD_IP_CORE
	help
	  This driver provides system interior bus switch for the IP regulator on the CHARPRO system.

config ATHT_IP_PLATFORM
	tristate "ATHT system interior bus control platform switch"
	depends on MFD_IP_CORE
	help
	  This driver provides system interior bus switch for the IP regulator on the ATHT system.

config LPM_MEDIA_REGULATOR
	tristate "LPM media regulator feature"
	depends on MFD_IP_CORE
	help
	 This Feature provides support for LPM media regulator.

config IP_PLATFORM_COMMON
	tristate "COMMON system interior bus control platform switch"
	depends on MFD_IP_CORE
	help
	 This driver provides system interior bus switch for the IP regulator after ORLA AND PHON system.

config DRV_REGULATOR_DEBUG
        tristate "regulator debug info"
        help
          This driver provides support for regulator control info.

config REGULATOR_PLATFORM
	tristate "PMIC regulators from platform device"
        help
          This driver provides support for the voltage regulators on the
          PMU / Codec IC.

config REGULATOR_SUB_PMU_SPMI
        tristate "SUB PMIC regulators from spmi device"
        depends on PMIC_SUB_PMU_SPMI
        help
          This driver provides support for the voltage regulators on the
          SUB PMU / Codec IC.

config REGULATOR_SMARTPA
        tristate "SMARTPA regulators from platform device"
        help
          This driver provides support for the voltage regulators on the
          PMU / Codec IC.

config PMIC_PLATFORM_DEBUG
        depends on DEBUG_FS
        bool "regulator and ip driver debug"
        default n

config REGULATOR_TRACE
        tristate "Regulator Debug driver for REGULATOR TRACE"
        depends on DRV_REGULATOR_DEBUG
        help
          provides support for regulator trace.
```

## platform_source/basicplatform/drivers/rtc/Kconfig
```kconfig
# SPDX-License-Identifier: GPL-2.0

config PMU_RTC_READCOUNT
    bool "Set the interface pmu_rtc_readcount exposed"
    default n
    help
          If you say yes here, the system time (wall clock) will be set using
          the value read from a specified RTC device. This is useful to avoid
          unnecessary fsck runs at boot time, and to network better.

config RTC_DRV_PMIC_SPMI
	tristate "PMIC RTC SPMI"
	depends on SPMI_PLATFORM
	help
	  If you say yes here you get support for PMIC
	  RTC functions. If an interrupt is associated with the device,
	  the alarm functionality is supported.

	  This driver can also be built as a module. If so, the module
	  will be called rtc-pmic-spmi.

config RTC_LOG
	tristate "PMIC RTC LOG"
	depends on RTC_DRV_PMIC_SPMI
	help
	  add logs.

config RTC_V500
	tristate "RTC V500"
	depends on RTC_DRV_PMIC_SPMI
	help
	  rtc v500 driver.

config RTC_SECURE_FEATURE
	tristate "PMIC RTC SECURE FEATURE"
	depends on RTC_DRV_PMIC_SPMI
	help
	  pmu rtc secure feature.

config RTC_TEST
        tristate "PMIC RTC TEST FEATURE"
        depends on RTC_DRV_PMIC_SPMI
        help
          pmu rtc test feature
```

## platform_source/basicplatform/drivers/spi/Kconfig
```kconfig
# SPDX-License-Identifier: GPL-2.0-only

config SPI_V400
	bool "Using spi_pl022 extra added code"

config SPI_V500_MASTER
	tristate "SPI_V500 controller"
	help
	  If you say yes to this option,support will be inclued for spi
	  controller on v500.
```

## platform_source/basicplatform/drivers/spmi_platform/Kconfig
```kconfig
#
# SPMI driver configuration
#


config SPMI_PLATFORM
	tristate "SPMI Controller"
	help
	  enabel spmi

config SPMI_PLATFORM_DEBUG_FS
	tristate "SPMI Controller Debug"
	depends on SPMI_PLATFORM
	depends on DFX_DEBUG_FS
	help
	  enable spmi debug fs
```

## platform_source/basicplatform/drivers/tty/serial/Kconfig
```kconfig
# SPDX-License-Identifier: GPL-2.0-only

config BUS_AMBA_PL011
	bool "uart mntn for amba_pl011"
	default n

config BUS_UART_OVERSAMPLING
	bool "uart oversampling"
	select BUS_AMBA_PL011
	default n

config BUS_NEED_SG_DMA_LENGTH
	bool "need sg dma length"
	select BUS_AMBA_PL011
	default n

config SERIAL_UART_V500
	tristate "UART v500 serial port support"
	select SERIAL_CORE
	help
	  This selects the UART v500.
	  If unsure, say N.

config SERIAL_UART_V500_CONSOLE
	bool "Support for console on UART v500 serial port"
	depends on SERIAL_UART_V500=y
	select SERIAL_CORE_CONSOLE
	select SERIAL_EARLYCON
	help
	  Say Y here if you wish to use an UART v500 as the system console (the
	  system console is the device which receives all kernel messages and
	  warnings and which allows logins in single user mode).

	  Even if you say Y here, the currently visible framebuffer console
	  (/dev/tty0) will still be used as the system console by default, but
	  you can alter that using a kernel command line option such as
	  "console=ttyHW0". (Try "man bootparam" or see the documentation of
	  your boot loader (lilo or loadlin) about how to pass options to the
	  kernel at boot time.)
```

## platform_source/basicplatform/drivers/usb/Kconfig
```kconfig
# SPDX-License-Identifier: GPL-2.0
#
# USB device configuration
#

source "platform_source/basicplatform/drivers/usb/chip-usb/Kconfig"
source "platform_source/basicplatform/drivers/usb/chip-usb-debug/Kconfig"
source "platform_source/basicplatform/drivers/usb/core/Kconfig"
source "platform_source/basicplatform/drivers/usb/dwc3/Kconfig"
source "platform_source/basicplatform/drivers/usb/gadget/Kconfig"
source "platform_source/basicplatform/drivers/usb/hisi-usb-vbus/Kconfig"
source "platform_source/basicplatform/drivers/usb/hiusbc/Kconfig"
source "platform_source/basicplatform/drivers/usb/host/Kconfig"
source "platform_source/basicplatform/drivers/usb/misc/Kconfig"
source "platform_source/basicplatform/drivers/usb/proxy-hcd/Kconfig"
source "platform_source/basicplatform/drivers/usb/usb-typec/Kconfig"
```

## platform_source/basicplatform/drivers/usb/chip-usb-debug/Kconfig
```kconfig
#
# USB drivers for platforms
#
config CHIP_USB_LOG
	bool "Chip USB Log"
	help
	  This option adds support for USB Log.

config CHIP_USB_DEBUG_MODULE
	bool "USB Debug MODULE"
	help
	This option adds support for Usb Driver Debug MODULE.
```

## platform_source/basicplatform/drivers/usb/chip-usb/Kconfig
```kconfig
#
# USB drivers for platforms
#
config CHIP_USB_REG_CFG
	tristate "Register config for USB module"
	select MFD_SYSCON
	help
	  Enable this to support the register config for USB.
	  To compile this driver as a module, choose M here.

config CHIP_USB_HELPER
	tristate "Helper functions for USB module"
	help
	  Enable this to support the helper functions for USB.
	  To compile this driver as a module, choose M here.

config CHIP_USB_MISC_CTRL
	tristate "Misc Ctrl for USB module"
	select CHIP_USB_REG_CFG
	select CHIP_USB_HELPER
	help
	  Enable this to support the misc ctrl for  USB.
	  To compile this driver as a module, choose M here.
```

## platform_source/basicplatform/drivers/usb/core/Kconfig
```kconfig
# SPDX-License-Identifier: GPL-2.0
#
# USB Core configuration
#

config USB_DOCK_HEADSET_QUIRK
	bool "Compatibility problem of VENDOR DOCK and TypeC Headset"
	depends on USB_SUPPORT
	help
	  Compatibility problem of VENDOR DOCK and TypeC Headset.

config USB_AUTOSUSPEND_DELAY_QUIRK
	bool "VENDOR USB do not set autosuspend_delay in hub_probe"
	depends on USB
	help
	  Do not set autosuspend_delay in hub_probe, but in usb_suspend_device.

config USB_PM_NO_RESET_RESUM
	bool "VENDOR USB NO_RESET_RESUM in PM route"
	depends on USB
	help
	  Allow no reset_resume in PM route for VENDOR USB.

config USB_DEVICE_READ_USE_TRYLOCK
	bool "VENDOR USB use trylock in usb_device_read"
	depends on USB
	help
	  Use trylock in usb_deivce_read for VENDOR USB.

config USB_SKIP_RESUME
	bool "VENDOR USB support skip resume"
	depends on USB
	default n
	help
	  This option adds support for PM control of USB module
	  in vendor platforms.

config USB_WAIT_FOR_CONNECTED_ACCURATELY
	bool "Wait timeout in function wait_for_connected using timer"
	depends on USB
	help
	  This option adds support for timeout using timer
	  in function wait_for_connected.
```

## platform_source/basicplatform/drivers/usb/dwc3/Kconfig
```kconfig
# SPDX-License-Identifier: GPL-2.0

source "platform_source/basicplatform/drivers/usb/dwc3/chip/Kconfig"
```

## platform_source/basicplatform/drivers/usb/dwc3/chip/Kconfig
```kconfig
config USB_DWC3_CHIP
	tristate "Platforms"
	default USB_DWC3
	select CHIP_USB_HELPER
	select CHIP_USB_REG_CFG
	help
	  Support of USB2/3 functionality in platforms,
	  Say 'Y' or 'M' here if you have one such device.

if USB_DWC3_CHIP

config USB_DWC3_NOV
       tristate "Platforms NOV USB"
       default n
       help
         Support of USB2 functionality in platforms,
         Say 'Y' or 'M' here if you have one such device.

config USB_DWC3_OCT
       tristate "Platforms OCT USB"
       default n
       help
         Support of USB2 functionality in platforms,
         Say 'Y' or 'M' here if you have one such device.

config USB_DWC3_SEP
       tristate "Platforms SEP USB"
       default n
       help
         Support of USB2 functionality in platforms,
         Say 'Y' or 'M' here if you have one such device.

config USB_DWC3_AUG
       tristate "Platforms AUG USB"
       default n
       help
         Support of USB2 functionality in platforms,
         Say 'Y' or 'M' here if you have one such device.

config USB_DWC3_APR
	tristate "Platforms APR USB"
	select CHIP_USB_XHCI_HUB_PORT_DIS
	default n
	select CHIP_USB_REG_CFG
	help
	  Support of USB2/3/3.1 functionality in platforms,
	  Say 'Y' or 'M' here if you have one such device.

config USB_DWC3_MAR
	tristate "Platforms MAR USB"
	select CHIP_USB_XHCI_HUB_PORT_DIS
	default n
	select CHIP_USB_REG_CFG
	help
	  Support of USB2/3/3.1 functionality in platforms,
	  Say 'Y' or 'M' here if you have one such device.

config USB_DWC3_FEB
	tristate "Platforms FEB USB"
	select CHIP_USB_XHCI_HUB_PORT_DIS
	default n
	select CHIP_USB_REG_CFG
	help
	  Support of USB2/3 functionality in platforms,
	  Say 'Y' or 'M' here if you have one such device.

config USB_DWC3_NYET_ABNORMAL
	bool "Enable workaround for receiving NYET bug on dwc3 feb"
	default n
	help
	  There is a Bug that receiving NYET in control transfer
	  can cause controller abnormal on dwc3 feb.

config CONTEXTHUB_PD
	bool "Sensor CONTEXTHUB PD driver"
	default n
	help
	  Say yes here if you want to use contexthub pd function

if CONTEXTHUB_PD
config CHIP_COMBOPHY
	tristate "Platforms MAR USB"
	default n
	help
	  Support of USB2/3/3.1 functionality in platforms,
	  Say 'Y' or 'M' here if you have one such device.
endif # CONTEXTHUB_PD

config CHIP_USB_NEW_FRAME
       tristate "USB new hardware config frame for Platforms"
       default n
       help
         Support for new usb phy and controller config frame for USB
         Say 'Y' or 'M' here if you have one such device.

config VENDOR_USB_CLASS_NAME
       string "VENDOR USB CLASS NAME"
       default "soc_usb_class"
       help
         Chip usb for usb_class_name.

config VENDOR_USB_DEV_NAME
       string "VENDOR USB DEV NAME"
       default "soc_usb_dev"
       help
         Chip usb for usb_dev_name.

config PD_NOTIFY_TEMPORARY
       tristate "Q release branch temporary use for device"
       default n
       help
         Say yes here set the device on as the default for USB.

endif # USB_DWC3_CHIP
```

## platform_source/basicplatform/drivers/usb/gadget/Kconfig
```kconfig
# SPDX-License-Identifier: GPL-2.0
#
#

config USB_F_SOURCESINK_EXT
	tristate

config USB_F_MTP
	tristate

config USB_F_PTP
        tristate

config USB_F_MODEM_ACM
	bool "USB F MODEM ACM"

config USB_MASS_STORAGE_SUPPORT_MAC
	bool "Mass Storage support MAC system"
	depends on USB_F_MASS_STORAGE
	help
	  Mass Storage support MAC system.

config USB_MIRRORLINK_SUPPORT
	bool "USB MIRRORLINK SUPPORT"
	depends on USB_CONFIGFS_NCM
	help
	  USB MIRRORLINK SUPPORT

config USB_HICAR_SUPPORT
	bool "USB HICAR SUPPORT"
	help
	  USB HICAR SUPPORT

config USB_CONFIGFS_F_SOURCESINK_EXT
	bool "sourcesink_ext function (for testing)"
	depends on USB_CONFIGFS
	select USB_F_SOURCESINK_EXT
	help
	  Sourcesink_ext function either sinks and sources bulk/intr/isoc data.
	  It also implements control requests, for "chapter 9" conformance.

config USB_CONFIGFS_F_MTP
	bool "MTP gadget"
	depends on USB_CONFIGFS
	select USB_F_MTP
	help
	  USB gadget MTP support

config USB_CONFIGFS_F_PTP
	bool "PTP gadget"
	depends on USB_CONFIGFS && USB_CONFIGFS_F_MTP
	select USB_F_PTP
	help
	  USB gadget PTP support

config USB_CONFIGFS_MODEM_ACM
	bool "USB CONFIGFS MODEM ACM"
	depends on USB_CONFIGFS
	select USB_F_MODEM_ACM
	help
	  ACM function used for Modem

config CHIP_USB_CONFIGFS
	bool "USB Gadget set up through configfs in platforms"
	depends on USB_CONFIGFS
	help
	  USB Gadget set up through configfs in platforms.
```
