## platform_source/basicplatform/drivers/usb/hisi-usb-vbus/Kconfig
```kconfig
config USB_VBUS_SPMI
	tristate "Hisilicon Platforms USB VBUS usb spmi drv intf"
	depends on SPMI_PLATFORM
	default n
	help
	  Use spmi bus register usb insert/pull-out interrupt.
```

## platform_source/basicplatform/drivers/usb/hiusbc/Kconfig
```kconfig
config USB_HIUSBC
	bool "Self-developed USB Controller Driver"
	help
	  Say Y to enable Self-developed USB Controller Driver
```

## platform_source/basicplatform/drivers/usb/host/Kconfig
```kconfig
# SPDX-License-Identifier: GPL-2.0
#
# USB Host Controller Drivers
#

config CHIP_USB_XHCI_HUB_PORT_DIS
	bool
	help
	  Work around the bug which hub port maybe is abnomal, disable it after reset
```

## platform_source/basicplatform/drivers/usb/misc/Kconfig
```kconfig
# SPDX-License-Identifier: GPL-2.0
#
# USB Miscellaneous driver configuration
#

config USB_DFU
	tristate "Common driver for DFU(device firmware update)"
	help
	Say Y here if you want to update device firmware via DFU procotol.

config USB_SOURCESINK
	tristate "Client driver for sourcesink device"
	depends on DFX_DEBUG_FS
	help
	Say Y here if you want to connect f_sourcesink device.

config USB_MODE_INIT
	bool "chip usb mode init driver"
	help
	Say Y here if you want to set chip usb mode init as device or host.

config USB_SOURCESINK_EXT
	tristate "Client driver for sourcesink_ext device"
	depends on DFX_DEBUG_FS
	help
	Say Y here if you want to connect f_sourcesink_ext device.
```

## platform_source/basicplatform/drivers/usb/usb-typec/Kconfig
```kconfig
config VENDOR_USB_TYPEC
	bool "Hisilicon USB Typei-C Driver"
	help
	  Say Y to enable Hisilicon USB Typec Driver

config HISI_USB_TYPEC_DBG
	bool "Hisilicon USB Type-C driver verbost debug infomation."
	depends on VENDOR_USB_TYPEC
	help
	  Say Y here if you want verbost debug infomation. If unsure, say N.

source "platform_source/basicplatform/drivers/usb/usb-typec/hisi-tcpc/Kconfig"
```

## platform_source/basicplatform/drivers/usb_phy_chip/Kconfig
```kconfig
config USB_PHY_CHIP
	bool "usb phy chip driver"
	default n
	help
	  usb phy chip driver

config CHIP_USB_PHY_DRIVER
	bool "usb phy device driver"
	depends on (USB_PHY_CHIP)
	default n
	help
	  usb phy device driver

config CHIP_USB_PHY_EFUSE
	bool "usb phy chip efuse driver"
	depends on (USB_PHY_CHIP)
	default n
	help
	  usb phy chip efuse driver

config USB_PHY_CHIP_FIX_BC_DETECT
	bool "usb phy chip fix bc detect problem"
	depends on (USB_PHY_CHIP)
	help
	  usb phy chip fix bc detect problem
```

## platform_source/basicplatform/drivers/watchdog/Kconfig
```kconfig
# platform software watchdog
config DFX_SR_AP_WATCHDOG
	tristate "suspend and resume to be monitored by the watchdog"
	depends on DFX_SP805_WATCHDOG || WATCHDOG_V500
	help
	  In the case of hung during the suspend and resume process,
	  it needs to be monitored by the watchdog.

config DFX_SP805_WATCHDOG
	tristate "platform software SP805 Watchdog"
	depends on (ARM || ARM64) && ARM_AMBA
	select WATCHDOG_CORE
	help
	  platform software SP805 Watchdog Based on ARM SP805 Watchdog.

config WATCHDOG_V500
	tristate "HISI V500 Watchdog"
	depends on (ARM || ARM64)
	select WATCHDOG_CORE
	help
	  Hisi V500 Watchdog Was Self-developed Watchdog.

config MNTN_VWATCHDOG
	tristate "Mntn vWatchdog"
	depends on (ARM || ARM64)
	select WATCHDOG_CORE
	help
	  Mntn vWatchdog Based on ARM Watchdog.
```

## platform_source/basicplatform/drivers/watchpoint/Kconfig
```kconfig
config DFX_WATCHPOINT_CB
	bool "watchpoint callback support"
	depends on HAVE_HW_BREAKPOINT && DEBUG_FS && HAVE_HW_BREAKPOINT_ADDR_MASK
	default n
	help
	  Say yes here to support the watchpoint callback module 
```

## platform_source/camera/Kconfig
```kconfig
menu "camera Kernel Configuration"

source "platform_source/camera/drivers/Kconfig"

endmenu
```

## platform_source/camera/drivers/Kconfig
```kconfig
menu "driver Configuration"

source "platform_source/camera/drivers/ivp/Kconfig"
source "platform_source/camera/drivers/arpp/Kconfig"

if MEDIA_NATIVE_SUPPORT
source "platform_source/camera/drivers/media/native/Kconfig"
endif

endmenu
```

## platform_source/camera/drivers/arpp/Kconfig
```kconfig
# SPDX-License-Identifier: GPL-2.0
#
# ARPP device configuration
#

menu "ARPP"

config ARPP
	bool "ARPP Drivers"
	default n
	help
		ARPP drivers

config ARPP_V100
	bool "ARPP Drivers for V100"
	depends on ARPP
	default n
	help
		ARPP drivers for V100
endmenu
```

## platform_source/camera/drivers/media/native/Kconfig
```kconfig
comment "Native Multimedia"

menuconfig KERNEL_CAMERA
    bool "Native camera and video capture support"
    default y
    select ION
    select MEDIA_CONTROLLER
    select VIDEOBUF2_CORE
    select VIDEO_V4L2
    select VIDEOBUF2_MEMOPS
    select VIDEOBUF2_VMALLOC
    help
        Say Y here to enable selecting the video adapters for
        Native camera

menuconfig ION_FOR_EMULATOR
     bool "Native camera and video support for emulator"
     default n
     select ION
     help
        Say Y here to enable selecting the video adapters for
        Native camera emulator

config USE_CAMERA3_ARCH
    tristate "Support Camera3 driver"
    depends on KERNEL_CAMERA
    default n
    help
        Native camera3 driver.

if KERNEL_CAMERA
source "platform_source/camera/drivers/media/native/camera/Kconfig"
source "platform_source/camera/drivers/media/native/igscam/Kconfig"
endif
```
