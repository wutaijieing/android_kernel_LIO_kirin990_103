## platform_source/basicplatform/drivers/mntn/blackbox/Kconfig
```kconfig
menu "RDR - Running data recorder menu"

config DFX_BB
	bool "kernel run data recorder"
	depends on SYSFS
	default n
	help
	  This module can record some data about kernel internal info.
	  Include:
	  the task switch,
	  interrupts switch,
	  arm exception info,
	  etc ...

config DFX_BB_DEBUG
	bool "test unit for kernel run data recorder"
	depends on SYSFS && DFX_BB
	default n
	help
	  This module can test RDR function ...
	  Include:
	  dataabort,
	  etc

# need_other_module_clear
config DFX_MNTN_SP
	bool "ap core register sp record"
	depends on  LPMCU_BB
	default n
	help
	  This module can record some data about sp info.
	  Include:
	  sp,
	  etc


config LPMCU_BB
	bool "lpmcu bbox"
	depends on  DFX_BB
	default n
	help
	  This module can record some data about lpmcu info.
	  Include:
	  lpmcu exception,
	  etc

# need_other_module_clear
config HISP_RDR
	bool "hisp rdr"
	depends on DFX_BB
	default n
	help
	  This module can record isp rdr info.
	  Include:
	  isp,
	  etc

config DFX_MEM_TRACE
	bool "mem trace"
	depends on DFX_BB
	default n
	help
	  This module used to record mem trace info.
	  Include:
	  mem trace,
	  etc

config DFX_CORE
	bool "dfx core"
	depends on DFX_BB
	default n
	help
	  This module can record some data to dfx partition.
	  Include:
	  dfx,
	  etc

config DFX_MNTN_ESUBTYPE
	bool "exception subtype"
	depends on DFX_BB
	default n
	help
	  This module can record exception subtype.
	  Include:
	  exception subtype,
	  etc

config DFX_BB_DIAGINFO
	bool "diaginfo"
	depends on DFX_BB
	default n
	help
	  This module used to record nonreset exception.
	  Include:
	  nonreset exception,
	  etc

config DFX_HW_DIAG
	bool "hareware diaginfo record"
	depends on DFX_BB_DIAGINFO
	default n
	help
	  This module record diaginfo to judge hardware fault.
	  Include:
	  hardware fault,
	  etc
config DFX_MNTN_GT_WATCH_SUPPORT
	bool "mntn support GT watch"
	default n
	help
	Say 'Y' here if you wat to support GT watch

config DFX_BB_SHUTDOWN_REASON
	bool "shutdown reason record"
	depends on DFX_BB
	default n
	help
	  This module used to record shutdown reason

config MNTN_DIAGINFO_SERVER
	bool "diaginfo vsock server"
	depends on DFX_BB_DIAGINFO
	default n
	help
	  This module used to create diaginfo vsock server.

source "platform_source/basicplatform/drivers/mntn/blackbox/platform_ap/Kconfig"
endmenu
```

## platform_source/basicplatform/drivers/mntn/blackbox/platform_ap/Kconfig
```kconfig
config DFX_IRQ_REGISTER
	bool "record irq register"
	depends on DFX_BB
	default n
	help
	  This module can record irq register.

config DFX_REENTRANT_EXCEPTION
	bool "reentrant exception"
	depends on DFX_BB
	default n
	help
	  this module deal with reentrant exception.

config DFX_TIME_HOOK
	bool "support print time call trace "
	depends on DFX_BB
	default n
	help
	  Say 'Y' here if you want to print time call trace.
```

## platform_source/basicplatform/drivers/mntn/dmsspt/Kconfig
```kconfig
config DDR_DMSS_PT
    bool "dmss pattern trace module support"
    depends on DFX_DEBUG_FS
    default n
    help
      Say yes here to support the dmss pattern trace module.

config DDR_QICE_PT
    bool "qice pattern trace module support"
    depends on DFX_DEBUG_FS
    default n
    help
      Say yes here to support the dmss pattern trace module.
```

## platform_source/basicplatform/drivers/mntn/ecall/Kconfig
```kconfig
config PLATFORM_DFX_EASYSHELL
	bool "Support Easy Shell"
	default n
	help
	  This driver supports XXX SOC,
	  including easy shell, etc.
```

## platform_source/basicplatform/drivers/mntn/general_see/Kconfig
```kconfig
config GENERAL_SEE_MNTN
    bool "general_see mntn module support"
    default n
    help
      Say yes here to support the general_see mntn module.

config GENERAL_SEE_MNTN_TEST
    bool "general_see mntn test"
    default n
    help
      Say yes here to support the general_see mntn test.

config GENERAL_SEE_NVMFORMAT_TEST
    bool "general_see nvm format"
    default n
    help
      Say yes here to support the general_see nvm format.

config MNTN_CHECKMISC
    bool "chech misc ver"
    default n
    help
      Say yes here to support checking misc version.
```

## platform_source/basicplatform/drivers/mntn/hm_klog/Kconfig
```kconfig
config MNTN_HM_KLOG
    bool "mntn hongmeng kev&kbox log module support"
    depends on DFX_BB
    default n
    help
      Say yes here to support the mntn hongmeng kev&kbox log module.
```

## platform_source/basicplatform/drivers/mntn/l3cache_ecc/Kconfig
```kconfig
config DFX_L3CACHE_ECC
        bool "platform l3cache ecc driver"
        depends on !CPU_EDAC_ARM64
        default n
        help
           Say 'Y' here if you want to support l3cache ecc.

config DFX_L3CACHE_ECC_DEBUG
        bool "platform l3cache ecc debug"
        depends on DFX_L3CACHE_ECC
        default n
        help
           Say 'Y' here if you want to support l3cache ecc debug.
```

## platform_source/basicplatform/drivers/noc/Kconfig
```kconfig
config DFX_NOC
	depends on DFX_BB
	bool "Support NOC"
	default n
	help
	  This driver supports XXX NOC,
	  including noc driver

config DFX_NOC_DBG
	depends on DFX_NOC && DFX_DEBUG_FS
	bool "Support NOC Dbg node"
	default n
	help
	  Support NOC Dbg node
config DFX_NOC_MODID_REGISTER
	depends on DFX_NOC
	bool "Support NOC modid register"
	default n
	help
	  Support NOC modid register
config DFX_QIC
	depends on DFX_BB
	bool "Support QIC"
	default n
	help
	  This driver supports XXX QIC
config DFX_QIC_MODID_REGISTER
        depends on DFX_QIC
        bool "Support QIC modid register"
        default n
        help
          Support QIC modid register
```

## platform_source/basicplatform/drivers/nve/Kconfig
```kconfig
config NVE_AP_KERNEL
	tristate "Direct char device access to NVE devices"
	help
	  This provides a character device for NVE device present in
	  the system, allowing the user to read and write directly to the
	  memory chips, and also use ioctl() to obtain information about
	  the device, or to erase parts of it.

config NVE_AP_KERNEL_WHITELIST
	bool "NVE whitelist"
	depends on NVE_AP_KERNEL
	help
	  This provides protect for valuable NV entries.

config NVE_BASE_PLATFORM
	bool "NVE partition header name of base platform"
	depends on NVE_AP_KERNEL
	help
	  This macro is for base platform, where the nve partition header
	  name is different.
```

## platform_source/basicplatform/drivers/partition/Kconfig
```kconfig
config PARTITION_TABLE
	bool "partition ptable"
	default n

config PARTITION_ARMPC
	bool "armpc partition"
	depends on PARTITION_TABLE
	default n
	help
	  config partition for armpc platform

config PRODUCT_CDC
	bool "cdc partition"
	depends on PARTITION_TABLE
	default n
	help
	  config partition for cdc platform

config PRODUCT_CDC_ACE
	bool "cdc ace partition"
	depends on PARTITION_TABLE
	default n
	help
	  config partition for cdc ace platform
```

## platform_source/basicplatform/drivers/pci/host/Kconfig
```kconfig
#
# Vendor PCIe driver configuration
#

config PCIE_KPORT
	bool "Kport PCIe controller"
	depends on PCI
	depends on PCI_MSI_IRQ_DOMAIN
	select PCIEPORTBUS
	select PCIE_DW_HOST
	help
	  Say Y here to enable PCIe controller support on Kport SoCs.
	  The PCIe controller uses DesignWare core.

config PCIE_KPORT_V1
	bool "Kport PCIe V1"
	depends on PCIE_KPORT
	help
	  Say Y here to enable Kport PCIe V1.

config PCIE_KPORT_TEST
	tristate "kport PCIe test"
	depends on PCIE_KPORT
	help
	  Say Y here if you want to use testcases for PCIe controller on kport SoC

config PCIE_KPORT_SLT
	tristate "kport PCIe SLT"
	depends on PCIE_KPORT
	help
	  Say Y here if you want to use SLT Func for PCIe on kport SoC

config PCIE_KPORT_SLT_DEVICE
	tristate "kport PCIe SLT test with device"
	depends on PCIE_KPORT_SLT
	help
	  Say Y here if you want to use SLT Func for kport PCIe with device

config PCIE_KIRIN_SLT_HI110X
	tristate "kport PCIe SLT connected with wifi"
	depends on PCIE_KPORT_SLT
	help
	  Say Y here if you want to use SLT Func for kport PCIe with device wifi

config PCIE_KPORT_MNTN
	tristate "kport PCIe mntn log"
	depends on PCIE_KPORT
	help
	  Say Y here if you want PCIe controller support on kport SoC

config PCIE_KPORT_FEB
	tristate "kport PCIe RC-Feb"
	select PCIE_KPORT

config PCIE_KPORT_MAR
	tristate "kport PCIe RC-Mar"
	select PCIE_KPORT

config PCIE_KPORT_APR
	tristate "kport PCIe RC-Apr"
	select PCIE_KPORT
	select PCIE_KPORT_AXI_TIMEOUT

config PCIE_KPORT_MAY
	tristate "kport PCIe RC-May"
	select PCIE_KPORT
	select PCIE_KPORT_AXI_TIMEOUT

config PCIE_KPORT_SEP
	tristate "kport PCIe RC-Sep"
	select PCIE_KPORT
	select PCIE_KPORT_AXI_TIMEOUT

config PCIE_KPORT_BURB
	tristate "kport PCIe RC-Burb"
	select PCIE_KPORT
	select PCIE_KPORT_AXI_TIMEOUT

config PCIE_KPORT_JUN
	tristate "kport PCIe RC-Jun"
	select PCIE_KPORT
	select PCIE_KPORT_AXI_TIMEOUT

config PCIE_KPORT_LEXI
	tristate "kport PCIe RC-Lexi"
	select PCIE_KPORT
	select PCIE_KPORT_AXI_TIMEOUT

config PCIE_KPORT_NAP
	tristate "kport PCIe RC-EP-NAP"
	select PCIE_KPORT
	select PCIE_KPORT_AXI_TIMEOUT

config PCIE_KPORT_AXI_TIMEOUT
	bool
	depends on PCIE_KPORT
	help
	  Say Y here to add axi timeout interrupt on kport SoC

config PCIE_KPORT_IDLE
	bool "kport PCIe L1ss idle"
	depends on PCIE_KPORT
	help
	  Say Y here to enable pcie L1ss idle on kport SOC

config KIRIN_PCIE_L1SS_IDLE_SLEEP
	bool "kport PCIe L1ss idle timeout&wake interrupts"
	depends on PCIE_KPORT_IDLE
	help
	  Say Y here to add L1ss idle timeout&wake interrupts on kport SOC

config PCIE_KPORT_NOC_DBG
	tristate "pcie_kport NOC DEBUG"
	select PCIE_KPORT
	help
	  Say Y here to dump kport pcie host info when PCIe NOC happen

config KIRIN_PCIE_NOC_DBG
	tristate "kport NOC DEBUG"
	select PCIE_KPORT
	help
	  Say Y here if you want dump pcie host info when PCIe NOC happen

config PCIE_KPORT_PHY
	tristate "kport PCIe PHY"
	select PCIE_KPORT
	help
	  Say Y here if you want select kport pcie phy

config PCIE_KPORT_PHY_XW
	tristate "kport PCIe PHY-XW"
	select PCIE_KPORT
	help
	  Say Y here if you want select kport pcie phy-xw

config PCIE_KPORT_PHY_KPHY
	tristate "kport PCIe PHY-KPHY"
	select PCIE_KPORT
	help
	  Say Y here if you want select kport pcie phy-kphy

config PCIE_KPORT_DBI_SPLT
	tristate "kport PCIe dbi splt"
	select PCIE_KPORT
	help
	  Say Y here if need support PCIe dbi ep memory split

config PCIE_KPORT_PC
	bool "kport Phoenix PC use this"
	default n

config PCIE_KPORT_EP_FPGA_VERIFY
	tristate "kport PCIe FPGA EP"
	select PCIE_KPORT
	help
	  Say Y here if you want to compile 'FPGA+FPGA' or 'UDP+FPGA' Version.
```

## platform_source/basicplatform/drivers/phy/Kconfig
```kconfig
# SPDX-License-Identifier: GPL-2.0-only
#
# PHY
#

source "platform_source/basicplatform/drivers/phy/hisilicon/Kconfig"

config PHY_HISI_USB2_T5
	tristate "USB2 PHY T5 support"
	select GENERIC_PHY
	select MFD_SYSCON
	help
	  Enable this to support the HISILICON USB2 T5 PHY.

	  To compile this driver as a module, choose M here.
```

## platform_source/basicplatform/drivers/phy/hisilicon/Kconfig
```kconfig
# SPDX-License-Identifier: GPL-2.0-only
#
# Phy drivers for Hisilicon platforms
#

config PHY_HISI_USB2_ULPI
	tristate "Hisilicon USB2 PHY ULPI support"
	depends on (ARCH_HISI && ARM64) || COMPILE_TEST
	select GENERIC_PHY
	select MFD_SYSCON
	help
	  Enable this to support the HISILICON USB2 ULPI PHY.

	  To compile this driver as a module, choose M here.

config PHY_HISI_COMBOPHY
	tristate "Hisilicon ComboPHY support"
	depends on (ARCH_HISI && ARM64 && CHIP_COMBOPHY) || COMPILE_TEST
	select GENERIC_PHY
	select MFD_SYSCON
	help
	  Enable this to support the HISILICON ComboPHY.

	  To compile this driver as a module, choose M here.
```

## platform_source/basicplatform/drivers/pinctrl/Kconfig
```kconfig
# SPDX-License-Identifier: GPL-2.0

config PINCTRL_V500
	tristate "pinctrl V500 driver"
	depends on OF
	select GENERIC_PINCTRL_GROUPS
	select GENERIC_PINMUX_FUNCTIONS
	select GENERIC_PINCONF
	help
	  This selects pinctrl driver for pinctrl v500.

config PINCTRL_HI6502
	tristate "hi6502 pinctrl driver"
	depends on PINCTRL_SINGLE
	help
	  This depends pinctrl single driver.

config PINCTRL_DEBUG
	tristate "pinctrl debug"
	depends on DEBUG_FS && (PINCTRL_V500 || PINCTRL_SINGLE)
	help
	  Test pinctrl and gpio.
```

## platform_source/basicplatform/drivers/pwm/Kconfig
```kconfig
# SPDX-License-Identifier: GPL-2.0

config PWM_HISI
	bool "hisilicon kirin pwm"
	default n
```
