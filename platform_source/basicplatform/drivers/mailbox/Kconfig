## platform_source/basicplatform/drivers/mailbox/Kconfig
```kconfig
config PLATFORM_IPC_MAILBOX
	bool "PLATFORM IPC MAILBOX"
	default n

if PLATFORM_IPC_MAILBOX
source "platform_source/basicplatform/drivers/mailbox/ipc_mailbox/Kconfig"
endif
```

## platform_source/basicplatform/drivers/mailbox/ipc_mailbox/Kconfig
```kconfig
comment "ipc MailBox driver"
config IPC_MAILBOX
	bool "ipc MailBox driver"
	default n
	help
	  ipc MailBox driver

comment "ipc mailboxes debugfs user"
config IPC_MAILBOX_DEBUGFS
	bool "ipc mailboxes debugfs user"
	depends on (IPC_MAILBOX) && DEBUG_FS
	default n
	help
	  HiIPCV230 ipc mailboxes debugfs user

comment "ipc MailBox driver performance debug"
config IPC_MAILBOX_PERFORMANCE_DEBUG
	bool "ipc MailBox driver performance debug"
	depends on (IPC_MAILBOX)
	default n
	help
	  Print tts of sending task, if config is set y

comment "ipc kernel API about remote processor communication"
config IPC_RPROC
	bool "ipc kernel API"
	default n
	help
	  ipc kernel API about remote processor communication

comment "ipc rproc kernel API debugfs"
config IPC_RPROC_TESTFILE
	bool "rproc kernel API test file"
	depends on IPC_RPROC
	default n
	help
	  debug for ipc_rproc

comment "bsp_reset_core_notify to support modem compile"
config BSP_RESET_CORE_NOTIFY
	bool "bsp_reset_core_notify"
	default n
	help
	  to support modem compile

comment "ipc Mailbox Vmware driver"
config IPC_MAILBOX_VM
	bool "rproc kernel API test file"
	depends on IPC_MAILBOX
	default n
	help
	  ipc Mailbox Vmware driver
```

## platform_source/basicplatform/drivers/memory_dump/Kconfig
```kconfig
config DFX_PLATFORM_KERNELDUMP
	bool "Support KERNELDUMP"
	default n
	help
	  This driver supports XXX KERNELDUMP,
	  including kerneldump driver.

config DFX_KERNELDUMP
	bool "Support KERNELDUMP"
	default n
	help
	  This driver supports KERNELDUMP,
	  including kerneldump driver.

config KERNELDUMP_KO_DBG
	bool "Support ko mem dump"
	depends on DFX_KERNELDUMP
	default n
	help
	  This driver supports XXX ko dump,
	  including ko dump driver.
```

## platform_source/basicplatform/drivers/mfd/Kconfig
```kconfig
config MFD_IP_CORE
	tristate "Control system interior area Bus on and off"
	depends on OF
	help
	  This driver control system interior area power management from atf.

config PMIC_SPMI
	tristate "PMU/Codec IC and use spmi passageway"
	depends on OF
	depends on SPMI_PLATFORM
	help
	  This driver supports power management and codec IC,
	  including regulators, codec, ADCs, Coulomb counter, etc. Memory
	  mapped I/O ports are the way of communication with it. and use spmi
	  passageway read pmu address.

config PMIC_I2C
	tristate "pmic PMU/Codec IC and use i2c passageway"
	help
	  This driver supports power management and codec IC,
	  including regulators, codec, ADCs, Coulomb counter, etc. Memory
	  mapped I/O ports are the way of communication with it. and use i2c
	  passageway read pmu address.

config PMIC_SUB_PMU_SPMI
	tristate "SUB PMU/Codec IC and use spmi passageway"
	depends on OF
	depends on SPMI_PLATFORM
	help
	  This driver supports power management and codec IC,
	  including regulators, codec, ADCs, Coulomb counter, etc. Memory
	  mapped I/O ports are the way of communication with it. and use spmi
	  passageway read sub pmu address.

config PMIC_DRV_DCXO
        tristate "PMU DCXO cali"
        depends on OF
        depends on PMIC_SPMI
        help
           put PMU dcxo c1 c2 calibration in fastboot.
           Earlier, modem do this in kernel init process, which can cause pmu's clock unstable.

config PMIC_AP_DCXO
        tristate "PMU DCXO AP cali"
        depends on OF
        depends on PMIC_SPMI
        help
           For platform later than bal, we put PMU dcxo ap c1 c2 calibration in fastboot.
           Earlier, factory ap do this in kernel init process, which can cause pmu's clock unstable.

config PMIC_56V100_PMU
        tristate "pmic56v100 IC"
        depends on OF
        help
           discriminate pmu ic for pmussi passageway.

config PMIC_55V500_PMU
        tristate "pmic55v500 IC"
        depends on OF
        help
           discriminate pmu ic for pmussi passageway.

config PMIC_21V900_PMU
        tristate "pmic21v900 IC"
        depends on OF
        help
           discriminate pmu ic for pmussi passageway.

config PMIC_21V800_PMU
        tristate "pmic21v800 IC"
        depends on OF
        help
	   discriminate pmu ic for pmussi passageway.

config PMIC_55V300_PMU
        tristate "pmic55v300 IC"
        depends on OF
        help
          discriminate pmu ic for pmussi passageway.


config PMIC_21V700_PMU
        tristate "pmic21v700 IC"
        depends on OF
        help
          discriminate pmu ic for pmussi passageway.

config PMIC_55V200_PMU
        tristate "pmic55v200 IC"
        depends on OF
        help
          discriminate pmu ic for 6555v200 passageway.

config PMIC_21V600_PMU
	tristate "pmic21v600 IC"
	depends on OF
	help
	  discriminate pmu ic for pmussi passageway.

config PMIC_MNTN
	tristate "Pmic Mntn"
	depends on OF
	help
	  This driver supports power management and codec IC,
	  including regulators, codec, ADCs, Coulomb counter, etc. Memory
	  mapped I/O ports are the way of communication with it.

config PMIC_MNTN_SPMI
	tristate "spmi pmic mntn"
	depends on OF
	depends on PMIC_SPMI
	help
	  This driver supports power management and codec IC,
	  which passage is spmi,including regulators, codec, ADCs, Coulomb counter, etc.
	  Memory mapped I/O ports are the way of communication with it.

config HISI_VBAT_DROP_PRT
    tristate "HiSilicon vbat drop protect"
    depends on OF
    depends on PMIC_SPMI
    help
      This driver supports HiSilicon battery vol drop protect by auto reducing
        cpu core frequency.

config HISI_VBAT_DROP_PRT_ATLA
	tristate "HiSilicon platform ATLA vbat drop protect"
	depends on OF
	depends on PMIC_SPMI
	help
	  This driver supports HiSilicon platform ATLA battery vol drop protect by auto reducing
	    cpu core frequency.

config HISI_VBAT_DROP_PRT_PHON
	tristate "HiSilicon platform PHON vbat drop protect"
	depends on OF
	depends on PMIC_SPMI
	help
	  This driver supports HiSilicon platform PHON battery vol drop protect by auto reducing
	    cpu core frequency.

config HISI_VBAT_DROP_PRT_ORL
	tristate "HiSilicon platform ORL vbat drop protect"
	depends on OF
	depends on PMIC_SPMI
	help
	  This driver supports HiSilicon platform ORL battery vol drop protect by auto reducing
	    cpu core frequency.

config HISI_VBAT_DROP_PRT_BAL
	tristate "HiSilicon platform BAL vbat drop protect"
	depends on OF
	depends on PMIC_SPMI
	help
	  This driver supports HiSilicon platform BAL battery vol drop protect by auto reducing
	    cpu core frequency.

config HISI_VBAT_DROP_PRT_DENV
	tristate "HiSilicon platform DENV vbat drop protect"
	depends on OF
	depends on PMIC_SPMI
	help
	  This driver supports HiSilicon platform DENV battery vol drop protect by auto reducing
	    cpu core frequency.

config HISI_VBAT_DROP_PRT_CHAR
        tristate "HiSilicon platform CHAR vbat drop protect"
        depends on OF
        depends on PMIC_SPMI
        help
          This driver supports HiSilicon platform CHAR battery vol drop protect by auto reducing
            cpu core frequency.

source "platform_source/basicplatform/drivers/mfd/pmic62_mipi/Kconfig"
source "platform_source/basicplatform/drivers/mfd/pmic_vm/Kconfig"
```

## platform_source/basicplatform/drivers/mfd/pmic62_mipi/Kconfig
```kconfig
config PMIC_62_PMIC_MIPI
	tristate "platform pmu62 pmic mipi"
	depends on OF
	help
	  This driver supports platform pmu62 power to control TOF cameras.
```

## platform_source/basicplatform/drivers/mfd/pmic_vm/Kconfig
```kconfig
config PMIC_VM_DRV
	tristate "platform pmic vmware"
	depends on OF
	help
	  This driver supports platform pmic driver by vmware.
```

## platform_source/basicplatform/drivers/mm_lb/Kconfig
```kconfig
config MM_LB
	bool "last buffer"
	help
	  Enable last buffer.

	  If unsure, say N here.

config MM_LB_DEBUG
	bool "Lb debug"
	depends on MM_LB
	help
	  Enable last buffer debug.

	  If unsure, say N here.

config MM_LB_ENG_DEBUG
	bool "Lb eng debug"
	depends on MM_LB
	help
	  Enable last buffer eng debug.

	  If unsure, say N here.

config MM_LB_TST
	bool "Lb ip test"
	depends on MM_LB
	help
	  Enable last buffer ip test
	  and need disable lb debug

	  if unsure, say N here

config MM_LB_PMU
	bool "Lb pmu"
	depends on MM_LB
	help
	  Enable last buffer ip test
	  and need disable lb debug

	  if unsure, say N here

config MM_LB_GEMINI
	bool "Lb gemini"
	depends on MM_LB
	help
	  Enable last buffer debug.

	  If unsure, say N here.

config MM_LB_L3_EXTENSION
	bool "Lb l3 extension"
	depends on MM_LB
	help
	  Enable last buffer debug.

	  If unsure, say N here.

config MM_LB_ION
	bool "Lb ion"
	depends on MM_LB
	help
	  Enable last buffer debug.

	  If unsure, say N here.

config MM_LB_REMAP
	bool "Lb remap"
	depends on MM_LB
	help
	  Enable last buffer remap.

	  If unsure, say N here.
```

## platform_source/basicplatform/drivers/mntn/Kconfig
```kconfig
config DFX_PLATFORM_MAINTAIN
	bool "platform maintain module support"
	default n
	help
	  Say yes here to support the platform maintain module

config DFX_MNTN_PC
	bool "pc platform"
	default n
	help
	  Say yes here to support the pc platform

config DFX_PSTORE
	tristate "Save persistent store log support"
	default n
	depends on PSTORE
	help
	  This option enables generic access to platform level
	   persistent storage via "pstore" filesystem that can
	   be adding Maintenance and Test Logs(eg. pstore.bin).
	   If you don't have a platform persistent store driver,
	   say N.

source "platform_source/basicplatform/drivers/mntn/blackbox/Kconfig"
source "platform_source/basicplatform/drivers/mntn/code_protect/Kconfig"
source "platform_source/basicplatform/drivers/mntn/general_see/Kconfig"
source "platform_source/basicplatform/drivers/mntn/bl31/Kconfig"
source "platform_source/basicplatform/drivers/mntn/dmsspt/Kconfig"
source "platform_source/basicplatform/drivers/mntn/subpmu/Kconfig"
source "platform_source/basicplatform/drivers/mntn/l3cache_ecc/Kconfig"
source "platform_source/basicplatform/drivers/mntn/hm_klog/Kconfig"
source "platform_source/basicplatform/drivers/mntn/ecall/Kconfig"

config DFX_VIRT_TO_PHYS
	bool "support converting virtual address to physical address"
	default n
	help
	  Say 'Y' here if you want to support virtual address to physical address enable.

config DFX_BOOT_TIME
	bool "support print all boot slice"
	default n
	help
	  Say 'Y' here if you want to print all boot slice.

config DFX_BB_SYSCALL
	bool "support print system call trace "
	default n
	help
	  Say 'Y' here if you want to print system call trace.

config DFX_POWER_OFF
	bool "platform power off and reset driver"
	default n
	help
	  Power off and reset support for the boards.

config DFX_FIQ
	bool "platform fiq dump driver"
	default n
	help
	   Say 'Y' here if you want to support fiq dump.

config DFX_MNTNDUMP
        bool "platform mntn dump driver"
        default n
        help
           Say 'Y' here if you want to support mntn dump.

config HISI_DEBUG_FS
	bool "platform debugfs"
	depends on DEBUG_FS
	help
		debugfs disable by self

config DFX_DEBUG_FS
    bool "dfx platform debugfs"
    depends on DEBUG_FS
    help
        debugfs disable by self


config DFX_RECORD_SP
        bool "platform mntn record sp"
		depends on FUNCTION_TRACER
		default n
        help
           Say 'Y' here if you want to support record sp.

config DFX_HW_SP
        bool "platform hw sp"
        default n
        help
           Say 'Y' here if you want to support hw sp.

config DFX_CLANG
        bool "clang compiler auxiliary for kernel"
        default n
        help
           Say 'Y' here if you want to support clang.

config DFX_MNTN_FACTORY
        bool "debug mntn for factory test"
        depends on DFX_BB
        default n
        help
           Say 'Y' here if you want to use enable mntn factory debug

config DFX_HEALTH_GRADE
        bool "health grade driver"
        default n
        help
           Say 'Y' here if you want to use enable health grade

config DFX_MNTN_SWITCH
        bool "mntn switch debug driver"
        depends on DFX_BB
        default n
        help
           Say 'Y' here if you want to use mntn switch debug
config DFX_EARLY_PANIC
        bool "early ap panic save log buf"
        depends on DFX_BB
        default n
        help
           Say 'Y' here if you want to use enable early log buf
config BBOX_SPLIT
        bool "bbox memory split"
        depends on DFX_BB
        default n
        help
           Say 'Y' here if you want to split bbox memory
config DFX_REBOOT_REASON_SEC
        bool "secure reboot reason"
        default n
        help
          Say 'Y' here to set reboot reason and subtype through secure way
config MNTN_ALOADER_LOG
        bool "enable aloader log"
        default n
        help
           Say 'Y' here if you want to enable aloader log
config MNTN_BBOX_LOG
        bool "save bbox log"
        depends on DFX_BB
        default n
        help
           This module used to save bbox log
config MNTN_BBOX_LOG_MAP
        bool "get bbox log addr by map"
        depends on MNTN_BBOX_LOG
        default n
        help
           Say 'Y' here to get bbox log addr through map
config DFX_PAGE_TABLE_DUMP
        bool "save kernel page table"
        depends on DFX_DEBUG_FS
        default n
        help
           Say 'Y' here to save kernel page table
```

## platform_source/basicplatform/drivers/mntn/bl31/Kconfig
```kconfig
config DFX_BL31_MNTN
    bool "bl31 mntn module support"
    default n
    help
      Say yes here to support the bl31 mntn module.
config DISABLE_DMSS_INT
    bool "DISABLE DMSS INT when acpu reset"
    default n
    help
      Support disable dmss int when acpu reset
config MNTN_SPI_ROUTE
    bool "kernel mntn deal spi from bl31 support"
    default n
    help
      Support deal spi from bl31.
```
