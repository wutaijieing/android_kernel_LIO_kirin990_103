## platform_source/display/drivers/video/dkmd/dpu/azalea/Kconfig
```kconfig
config DPU_FB_MEDIACOMMON
	tristate
	depends on FB
	default n
	help
	Enable mediacommon hardware support for chipset

	This will allow for allocating new framebuffer to provide more
	interfaces such as ispif, precompose copybit etc.

config DPU_FB_ALSC
	tristate "alsc support"
	depends on FB
	default n
	help
	Enable ALSC hardware support

config DPU_FB_FAKE
	tristate "Framebuffer Fake support"
	depends on FB
	select FB_CFB_FILLRECT
	select FB_SYS_FOPS
	select FB_CFB_COPYAREA
	select FB_CFB_IMAGEBLIT
	select REGMAP
	help
	  This framebuffer driver supports DPU FB Fake.

config DPU_FB_V410
	tristate "DPU FB V410 Framebuffer support"
	depends on FB
	select FB_CFB_FILLRECT
	select FB_SYS_FOPS
	select FB_CFB_COPYAREA
	select FB_CFB_IMAGEBLIT
	select DPU_FB_MEDIACOMMON
	select REGMAP
	select REGMAP_I2C
	help
	  This framebuffer driver supports DPU V410 FB.

config DPU_FB_V501
	tristate "DPU FB V501 Framebuffer support"
	depends on FB
	select FB_CFB_FILLRECT
	select FB_SYS_FOPS
	select FB_CFB_COPYAREA
	select FB_CFB_IMAGEBLIT
	select DPU_FB_MEDIACOMMON
	select REGMAP
	select REGMAP_I2C
	help
	  This framebuffer driver supports DPU V501 FB.

config DPU_FB_V510
	tristate "DPU FB V510 Framebuffer support"
	depends on FB
	select FB_CFB_FILLRECT
	select FB_SYS_FOPS
	select FB_CFB_COPYAREA
	select FB_CFB_IMAGEBLIT
	select DPU_DPP_CMDLIST
	select REGMAP
	select REGMAP_I2C
	help
	  This framebuffer driver supports DPU V510 FB.

config DPU_FB_V600
	tristate "DPU FB V600 Framebuffer support"
	depends on FB
	depends on DMA_CMA
	select FB_CFB_FILLRECT
	select FB_SYS_FOPS
	select FB_CFB_COPYAREA
	select FB_CFB_IMAGEBLIT
	select DPU_FB_MEDIACOMMON
	select DPU_DPP_CMDLIST
	select REGMAP
	select REGMAP_I2C
	help
	  This framebuffer driver supports DPU V600 FB.

config DPU_FB_V700
	tristate "DPU FB V700 Framebuffer support"
	depends on FB
	depends on DMA_CMA
	select FB_CFB_FILLRECT
	select FB_SYS_FOPS
	select FB_CFB_COPYAREA
	select FB_CFB_IMAGEBLIT
	select DPU_FB_MEDIACOMMON
	select DPU_FB_ALSC
	select REGMAP
	select REGMAP_I2C
	help
	  This framebuffer driver supports DPU V700 FB.

config DPU_FB_V360
	tristate "DPU FB V360 Framebuffer support"
	depends on FB
	depends on DMA_CMA
	select FB_CFB_FILLRECT
	select FB_SYS_FOPS
	select FB_CFB_COPYAREA
	select FB_CFB_IMAGEBLIT
	select REGMAP
	select REGMAP_I2C
	help
	  This framebuffer driver supports DPU V360 FB.

config DPU_FB_V320
	tristate "DPU FB V320 Framebuffer support"
	depends on FB
	select FB_CFB_FILLRECT
	select FB_SYS_FOPS
	select FB_CFB_COPYAREA
	select FB_CFB_IMAGEBLIT
	select REGMAP
	select REGMAP_I2C
	help
	  This framebuffer driver supports DPU V320 FB.

config DPU_FB_AOD
	tristate "DPU aod support"
	depends on FB
	select FB_CFB_FILLRECT
	select FB_SYS_FOPS
	select FB_CFB_COPYAREA
	select FB_CFB_IMAGEBLIT
	select REGMAP
	help
	  This framebuffer driver supports aod.

config DPU_DP_EN
	tristate "DPU dp support"
	depends on FB
	help
	  This framebuffer driver supports dp.

config DPU_FB_AP_AOD
	tristate "DPU ap aod support"
	depends on FB
	select FB_CFB_FILLRECT
	select FB_SYS_FOPS
	select FB_CFB_COPYAREA
	select FB_CFB_IMAGEBLIT
	select REGMAP
	help
	  This framebuffer driver supports dpu ap aod.

config DPU_FB_V330
	tristate "DPU FB V330 Framebuffer support"
	depends on FB
	select FB_CFB_FILLRECT
	select FB_SYS_FOPS
	select FB_CFB_COPYAREA
	select FB_CFB_IMAGEBLIT
	select REGMAP
	select REGMAP_I2C
	help
	  This framebuffer driver supports DPU V330 FB.

config DPU_FB_V350
	tristate "DPU FB V350 Framebuffer support"
	depends on FB
	select FB_CFB_FILLRECT
	select FB_SYS_FOPS
	select FB_CFB_COPYAREA
	select FB_CFB_IMAGEBLIT
	select REGMAP
	select REGMAP_I2C
	help
	  This framebuffer driver supports DPU V350 FB.

config DPU_FB_V345
	tristate "DPU FB V345 Framebuffer support"
	depends on FB
	select FB_CFB_FILLRECT
	select FB_SYS_FOPS
	select FB_CFB_COPYAREA
	select FB_CFB_IMAGEBLIT
	select REGMAP
	select REGMAP_I2C
	help
	  This framebuffer driver supports DPU V345 FB.

config DPU_FB_V346
	tristate "DPU FB V346 Framebuffer support"
	depends on FB
	select FB_CFB_FILLRECT
	select FB_SYS_FOPS
	select FB_CFB_COPYAREA
	select FB_CFB_IMAGEBLIT
	select REGMAP
	select REGMAP_I2C
	help
	  This framebuffer driver supports DPU V346 FB.

config DSS_SMMU_V3
	tristate "DPU FB smmu v3 support"
	depends on MM_SMMU_V3
	help
	  This framebuffer driver supports smmu v3.

config DPU_FB_ENG_DBG
	tristate "DPU FB ENG DEBUG support"
	depends on FB
	help
	  This config only used in eng version.

config FASTBOOT_DISP_ENABLE
	tristate "DPU fastboot display enable support"
	depends on FB
	help
	  Display system have already initialized in fastboot.

config DPU_DISPLAY_DFR
	tristate "DPU FB dynamic frame adaptation support"
	depends on FB
	help
	  This framebuffer driver supports dynamic frame adaptation.

config DPU_DPM
	tristate "DPU DPM(digital power monitor) support"
	depends on FB
	depends on DPM_HWMON
	help
	  This framebuffer driver supports dpm function.

config DPU_DPP_CMDLIST
	tristate "DPU DPP cmdlist support"
	depends on FB
	help
	  This framebuffer driver supports dpp cmdlist function.

config EFFECT_HIACE
	tristate "effect hiace support"
	depends on FB
	help
	  This framebuffer driver supports effect hiace.

config DPU_EFFECT_HIHDR
	tristate "DPU HiHDR support"
	depends on FB
	help
	  This framebuffer driver supports HiHDR related functions.

config EFFECT_TERMINAL_API
	tristate "terminal API support"
	depends on FB
	help
	  This framebuffer driver supports terminal APIs.

config HW_DSS_BOOST
	tristate "boost support"
	depends on DPU_FB_V501 || DPU_FB_V510 || DPU_FB_V350 || DPU_FB_V345 || DPU_FB_V346 || DPU_FB_V600
	default y
	help
	  support boosting.

config DEVICE_ATTRS
	tristate "device attrs support"
	depends on FB
	help
	  This framebuffer driver supports device attrs function.

config VIDEO_IDLE
	tristate "video idle support"
	depends on FB
	help
	  This framebuffer driver supports video idle function.

config ASYNCHRONOUS_PLAY
	tristate "asynchronous play support"
	depends on FB
	help
	  This framebuffer driver supports asynchronous play function.

config RCH_CLD
	tristate "rch cld support"
	depends on FB
	help
	  This framebuffer driver supports rch cld function.

config DP_HDCP
	tristate "dp hdcp support"
	depends on FB
	help
	  This framebuffer driver supports dp hdcp function.

config VR_DISPLAY
	tristate "vr display support"
	depends on FB
	help
	  This framebuffer driver supports vr display function.

config FOLD_DISPLAY
	tristate "fold display support"
	depends on FB
	help
	  This framebuffer driver supports fold display function.

config CDC_MULTI_DISPLAY
	tristate "CDC support multi-screen"
	depends on DPU_FB_V510
	select ASYNCHRONOUS_PLAY
	default n
	help
	  This framebuffer driver supports CDC multi-screen.

config DP_CDC
	tristate "CDC support DP"
	depends on DPU_FB_V510
	default n
	help
	  This framebuffer driver supports CDC DP.

config DPU_ULTR_LOW_CLK_RATE
	tristate "ultra low power"
	depends on DPU_FB_V320
	help
	  ultra low power for watch

config DPU_CDC_ACE
	tristate "ace display"
	depends on FB
	help
	  This framebuffer driver supports CDC ACE.

config X1_CARBU_EDITION_V10_ENABLE_MIPI_FAKE
	bool "X1_CARBU_EDITION_V10 support MIPI_FAKE"
	default n
	help
	  This framebuffer driver supports CDC X1.
```

## platform_source/display/drivers/video/hisi/Kconfig
```kconfig
config DKMD_DPU_V720
	bool "dkmd dpuv720 support"
	default n
	depends on DKMD_OLD_ARCH
	help
	  This feature supports dpuv720 display driver.

config DPP_SCENE0
	bool "enable scene0"
	default n
	depends on DKMD_OLD_ARCH
	help
	  This feature supports scene0.

config DKMD_DPU_DEBUG
	bool "enable display debug feature"
	default n
	depends on DKMD_OLD_ARCH
	help
	  This feature supports display driver debug.
```

## platform_source/hisecally/Kconfig
```kconfig
menu "hisecally Kernel Configuration"

source "platform_source/hisecally/fuzz/Kconfig"

endmenu
```

## platform_source/hisecally/fuzz/Kconfig
```kconfig
menu "fuzz Kernel Configuration"

source "platform_source/hisecally/fuzz/atf_fuzz/Kconfig"

endmenu
```

## platform_source/hisecally/fuzz/atf_fuzz/Kconfig
```kconfig
config ATF_FUZZ
        tristate "Config for ATF FUZZ"
	help
	  enable te support for ATF FUZZ
```

## platform_source/isp/Kconfig
```kconfig
menu "isp Kernel Configuration"

source "platform_source/isp/drivers/Kconfig"

endmenu
```

## platform_source/isp/drivers/Kconfig
```kconfig
menu "driver Configuration"

source "platform_source/isp/drivers/isp/Kconfig"
source "platform_source/isp/drivers/ipp/Kconfig"  

endmenu
```

## platform_source/isp/drivers/ipp/Kconfig
```kconfig
menu "HISP IPP"

config HISPIPP
	bool "HISP IPP Drivers"
	depends on IOMMU_API
	default n
	help
		HISP IPP drivers.

config HISPIPP_CDC
	bool "HISP IPP Drivers for CDC"
	depends on HISPIPP
	default n
	help
		ippcdc

config HISPIPP_V250
	bool "HISP IPP Drivers for V250"
	depends on HISPIPP
	default n
	help
		HISP IPP Drivers for V250

config HISPIPP_V300
	bool "HISP IPP Drivers for V300"
	depends on HISPIPP
	default n
	help
		HISP IPP Drivers for V300

config HISPIPP_V320
	bool "HISP IPP Drivers for V320"
	depends on HISPIPP
	default n
	help
		HISP IPP Drivers for V320

config HISPIPP_V350
    bool "HISP IPP Drivers for V350"
    depends on HISPIPP
    default n
    help
        HISP IPP Drivers for V350

config RELEASE_IPP_V320
    bool "RELEASE IPP Drivers for V320"
    depends on HISPIPP
    default n
    help
        RELEASE IPP Drivers for V320
endmenu
```

## platform_source/isp/drivers/isp/Kconfig
```kconfig
config ISP
    tristate "Histar ISP device"
    depends on REMOTEPROC
    depends on RPMSG
    depends on ARCH_HISI

config HISP_DEBUG
	bool "hisp debug"
	default n
	help
		Say yes here to support hisp debug.

config HISP_DPM
	tristate "HISP DPM(digital power monitor) support"
	depends on DPM_HWMON
	default n
	help
		This framebuffer driver supports dpm function.

config HISP_EXCLUDE_NOC_DEBUG
	bool "hisp exclude noc modid debug"
	default n
	help
		Say yes here to not support hisp noc modid debug.
```

## platform_source/maligpu/Kconfig
```kconfig
menu "maligpu Kernel Configuration"

source "platform_source/maligpu/drivers/Kconfig"

endmenu
```

## platform_source/maligpu/drivers/gpu/arm/bifrost-r18p0-01rel0-cdc/platform/hisilicon/Kconfig
```kconfig
#
# Copyright (c) Huawei Technologies Co., Ltd. 2014-2019. All rights reserved.
# Description: This file describe HISI GPU hardware related features
# Author: Huawei Technologies Co., Ltd.
# Create: 2014-2-24
#
# This program is free software and is provided to you under the terms of the
# GNU General Public License version 2 as published by the Free Software
# Foundation, and any use by you of this program is subject to the terms
# of such GNU licence.
#
# A copy of the licence is included with the program, and can also be obtained
# from Free Software Foundation, Inc., 51 Franklin Street, Fifth Floor,
# Boston, MA  02110-1301, USA.
#
#

config MALI_PM_DEMAND
	bool "Switch power policy"
	depends on MALI_MIDGARD && MALI_EXPERT
	default n
	help
	  switch policy for different platform, fpga or chip

config REPORT_VSYNC
	bool "Enabel REPORT_VSYNC"
	depends on MALI_MIDGARD && MALI_EXPERT
	default y
	help
	  Enable REPORT_VSYNC
config HW_VOTE_GPU_FREQ
	bool "Enable hardware vote gpu freq feature"
	depends on PM_DEVFREQ && HW_VOTE
	default n
	help
	  enable hardware vote gpu freq feature
config GPU_CORE_HOTPLUG
	bool "Enable gpu core hotplug if high temperature scenario"
	depends on MALI_MIDGARD && MALI_EXPERT
	default n
	help
	  enable some cores shutdown if the thermal need reduce gpu power consumption
```

## platform_source/maligpu/drivers/gpu/arm/valhall-r27p0-01eac0-base/platform/reference/Kconfig
```kconfig
#
# (C) COPYRIGHT 2012-2013, 2017 ARM Limited. All rights reserved.
#
# This program is free software and is provided to you under the terms of the
# GNU General Public License version 2 as published by the Free Software
# Foundation, and any use by you of this program is subject to the terms
# of such GNU licence.
#
# A copy of the licence is included with the program, and can also be obtained
# from Free Software Foundation, Inc., 51 Franklin Street, Fifth Floor,
# Boston, MA  02110-1301, USA.
#
#

config MALI_PM_DEMAND
	bool "Switch power policy"
	depends on MALI_MIDGARD && MALI_EXPERT
	default n
	help
	  switch policy for different platform, fpga or chip

config HW_VOTE_GPU_FREQ
	bool "Enable hardware vote gpu freq feature"
	depends on PM_DEVFREQ && HW_VOTE
	default n
	help
	  enable hardware vote gpu freq feature

config MALI_MIDGARD_RT_PM
	bool "Enable Runtime power management"
	depends on MALI_MIDGARD
	depends on PM_RUNTIME || PM
	default n
	help
	  Choose this option to enable runtime power management in the Mali Midgard DDK.
```

## platform_source/see/Kconfig
```kconfig
menu "see Kernel Configuration"

source "platform_source/see/drivers/Kconfig"


endmenu
```

## platform_source/see/drivers/Kconfig
```kconfig
menu "driver Configuration"

source "platform_source/see/drivers/bl2_log/Kconfig"
source "platform_source/see/drivers/bl31_hibernate/Kconfig"
source "platform_source/see/drivers/bl31_log/Kconfig"
source "platform_source/see/drivers/cpusec_test/Kconfig"
source "platform_source/see/drivers/crypto_core/Kconfig"
source "platform_source/see/drivers/crypto_enhance/Kconfig"
source "platform_source/see/drivers/efuse/Kconfig"
source "platform_source/see/drivers/general_see/Kconfig"
source "platform_source/see/drivers/harden/Kconfig"
source "platform_source/see/drivers/thee/Kconfig"
source "platform_source/see/drivers/kernel_harden_test/Kconfig"
source "platform_source/see/drivers/load_image/Kconfig"
source "platform_source/see/drivers/security_info/Kconfig"
source "platform_source/see/drivers/hhee/Kconfig"
source "platform_source/see/drivers/uapp/Kconfig"
source "platform_source/see/drivers/cust_atf_shmem/Kconfig"
source "platform_source/see/drivers/secboot/Kconfig"


endmenu
```

## platform_source/see/drivers/cpusec_test/Kconfig
```kconfig
config EL3_PA_TEST
	bool "El3 PA Restriction feature test support"
	depends on HAVE_ARM_SMCCC
	default n
	help
	  El3 PA Restriction test function
```

## platform_source/see/drivers/crypto_core/Kconfig
```kconfig
config CRYPTO_CORE
	bool "crypto core "
	default n
	help
	  crypto core driver

config CRYPTO_CORE_MNTN_RESET_IRQ_SEPARATE
        depends on CRYPTO_CORE
        bool "crypto_core reset use separate interrupts."
        default n
        help
          whether crypto_core reset support separate interrupts feature

config CRYPTO_CORE_SUPPORT_DCS
        depends on CRYPTO_CORE
	bool "Support for Dynamic Binaries upgrade"
        default n
        help
	  whether to support dynamic binaries upgrade in crypto_core

config CRYPTO_CORE_DISABLE_KEY
	depends on CRYPTO_CORE
	bool "crypto_core disable open and close key."
	default n
	help
	  whether crypto_core support disable open and close key

config CRYPTO_CORE_PINCODE
	depends on CRYPTO_CORE
	bool "crypto_core support pincode."
	default n
	help
	  whether crypto_core support pincode
```

## platform_source/see/drivers/crypto_enhance/Kconfig
```kconfig
config CRYPTO_ENHANCE
	bool "crypto_enhance"
	default n
	help
	  crypto_enhance driver

config CRYPTO_ENHANCE_SMX_ATCMD
	bool "crypto_enhance set/get smx"
	depends on CRYPTO_ENHANCE
	default n
	help
	  crypto_enhance driver set/get smx

config CRYPTO_ENHANCE_WITHOUT_CPU
	bool "crypto_enhance without cpu"
	depends on CRYPTO_ENHANCE
	default n
	help
	  crypto_enhance driver without cpu

config CRYPTO_ENHANCE_POWERON_WITH_SMMU
	bool "crypto_enhance poweron with smmu"
	depends on CRYPTO_ENHANCE
	default n
	help
	  crypto_enhance driver poweron with smmu
```
