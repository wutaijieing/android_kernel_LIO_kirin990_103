## platform_source/audio/drivers/da_combine_dsp/Kconfig
```kconfig
config CODEC_DSP_MISC
     tristate "codec dsp misc device support"
     default n
     help
	codec dsp misc driver

config HISI_HIFI_BB
	bool "hifi bbox"
	depends on  DFX_BB
	default n
	help
	  This module can record some data about hifi info.
	  Include:
	  hifi exception,
	  etc
```

## platform_source/audio/drivers/hifi_mailbox/Kconfig
```kconfig
source "platform_source/audio/drivers/hifi_mailbox/mailbox/Kconfig"
source "platform_source/audio/drivers/hifi_mailbox/ipcm/Kconfig"
```

## platform_source/basicplatform/Kconfig
```kconfig
menu "basicplatform Kernel Configuration"

source "platform_source/basicplatform/drivers/Kconfig"
source "platform_source/basicplatform/block/Kconfig"


endmenu
```

## platform_source/basicplatform/block/Kconfig
```kconfig
menu "mas_block_Configuration"

config MAS_BLK
	bool "MAS Block feature"
	depends on BLOCK
	default n
	help
		MAS Block feature

config MAS_DEBUG_FS
	bool "mas debug fs"
	depends on MAS_BLK
	default n

config MAS_BLK_DEBUG
	bool "MAS_BLK_DEBUG"
	depends on MAS_BLK
	default n
	help
		MAS block debug, need to be removed!

config MAS_BKOPS
	bool "MAS BKOPS"
	depends on MAS_BLK
	default n
	help
	MAS BKOPS feature

config MAS_QOS_MQ
	bool "MAS QoS MQ IO scheduler"
	depends on MAS_BLK && HUFS_HC_CORE_UTR
	default n
	help
	MAS QoS MQ IO scheduler

config MAS_STORAGE
	bool "MAS Storage related change"
	default n
	help
		MAS Storage related change of Linux source code

config MAS_BLK_BW_OPTIMIZE
	bool "Enlarge async inflight when dirty page flashing"
	depends on MAS_BLK
	default n

config MMC_BLOCK_IOMMU_64BIT
	bool "Block bounce limit"
	depends on BLOCK
	default n
	help
		Blk-setting will use address >4G for IOMMU.

choice
	prompt "Select IO classify method"
	depends on MAS_BLK

config MAS_IO_CLASSIFY_FG
	bool "use iaware FG classification"
config MAS_IO_CLASSIFY_SCHED_TUNE
	bool "use AI sched tune"
	depends on SCHED_TUNE
endchoice

config MAS_MQ_USING_CP
	bool "MAS UFS Command Priority"
	depends on MAS_BLK
	default n
	help
		MAS UFS Command Priority, good for foreground APP's IO performance

config MAS_ORDER_PRESERVE
	bool "MAS UFS Order Preserving"
	depends on MAS_BLK
	default n
	help
		MAS UFS Order Preserving, good for SQL's IO performance

config MAS_UNISTORE_PRESERVE
	bool "MAS BLK Unistorage Preserving"
	depends on MAS_BLK
	default n
	help
		mas unistorage preserving in block layer

config MAS_IO_TRACE
	bool "MAS_IO_TRACE"
	depends on MAS_DEBUG_FS
	default n
	help
		MAS io trace event, as supplement to block_rq_issue and block_rq_complete

config MAS_IO_DEBUG_TRACE
	bool "MAS_IO_DEBUG_TRACE"
	depends on MAS_IO_TRACE
	default n
	help
		MAS io debug trace event
endmenu
```

## platform_source/basicplatform/drivers/Kconfig
```kconfig
menu "driver Configuration"

source "platform_source/basicplatform/drivers/spmi_platform/Kconfig"
source "platform_source/basicplatform/drivers/bootdevice/Kconfig"
source "platform_source/basicplatform/drivers/mfd/Kconfig"
source "platform_source/basicplatform/drivers/clk/Kconfig"
source "platform_source/basicplatform/drivers/regulator/Kconfig"
source "platform_source/basicplatform/drivers/gpio/Kconfig"
source "platform_source/basicplatform/drivers/pinctrl/Kconfig"
source "platform_source/basicplatform/drivers/hwspinlock/Kconfig"
source "platform_source/basicplatform/drivers/pwm/Kconfig"
source "platform_source/basicplatform/drivers/rtc/Kconfig"
source "platform_source/basicplatform/drivers/i2c/Kconfig"
source "platform_source/basicplatform/drivers/i3c/Kconfig"
source "platform_source/basicplatform/drivers/cmdline/Kconfig"
source "platform_source/basicplatform/drivers/mailbox/Kconfig"
source "platform_source/basicplatform/drivers/mm_lb/Kconfig"
source "platform_source/basicplatform/drivers/modem_decoupl/Kconfig"
source "platform_source/basicplatform/drivers/noc/Kconfig"
source "platform_source/basicplatform/drivers/hisi_dummy_ko/Kconfig"
source "platform_source/basicplatform/drivers/qic/Kconfig"
source "platform_source/basicplatform/drivers/rpmb/Kconfig"
source "platform_source/basicplatform/drivers/usb_phy_chip/Kconfig"
source "platform_source/basicplatform/drivers/phy/Kconfig"
source "platform_source/basicplatform/drivers/usb/Kconfig"
source "platform_source/basicplatform/drivers/memory_dump/Kconfig"
source "platform_source/basicplatform/drivers/watchpoint/Kconfig"
source "platform_source/basicplatform/drivers/mntn/Kconfig"
source "platform_source/basicplatform/drivers/hwtracing/dfx_coresight/Kconfig"
source "platform_source/basicplatform/drivers/watchdog/Kconfig"
source "platform_source/basicplatform/drivers/dieid/Kconfig"
source "platform_source/basicplatform/drivers/timekeeper/Kconfig"
source "platform_source/basicplatform/drivers/hisi_lmk/Kconfig"
source "platform_source/basicplatform/drivers/hck/Kconfig"
source "platform_source/basicplatform/drivers/dma/Kconfig"
source "platform_source/basicplatform/drivers/spi/Kconfig"
source "platform_source/basicplatform/drivers/tty/serial/Kconfig"
source "platform_source/basicplatform/drivers/pci/Kconfig"
source "platform_source/basicplatform/drivers/leds/Kconfig"
source "platform_source/basicplatform/drivers/input/keyboard/Kconfig"
source "platform_source/basicplatform/drivers/input/misc/Kconfig"
source "platform_source/basicplatform/drivers/bootctrl/Kconfig"
source "platform_source/basicplatform/drivers/nve/Kconfig"
source "platform_source/basicplatform/drivers/partition/Kconfig"

endmenu
```

## platform_source/basicplatform/drivers/bootctrl/Kconfig
```kconfig
config AB_PARTITION_TABLE
	bool "AB partition support"
	default n
	help
	  Say Y here if support ab partition.
```

## platform_source/basicplatform/drivers/clk/Kconfig
```kconfig
# SPDX-License-Identifier: GPL-2.0

config PLAT_CLK
	bool "clock driver of Soc"
	default n

config ARCH_CLK_EXTREME
	bool "Clock extreme boot driver for ARM Reference designs"
	help
	 Clock extreme boot driver for ARM Reference designs.

source "platform_source/basicplatform/drivers/clk/extreme/Kconfig"
source "platform_source/basicplatform/drivers/clk/normal/Kconfig"
```

## platform_source/basicplatform/drivers/clk/extreme/Kconfig
```kconfig
config CLK_ALWAYS_ON
	bool "all clocks of Soc are always on"
	default n

config CLK_PM_MONITOR
	bool "clock pm_monitor spec"
	default n

config VM_CLK
	depends on PLAT_CLK
	bool "clk driver support vm"
	default n

config CLK_MAILBOX_SUPPORT
	depends on PLAT_CLK
	depends on IPC_MAILBOX
	bool "clk driver support mailbox communication"
	default n

config CKM_MODULE
	depends on PLAT_CLK
	bool "clk monitor driver"
	default n

config CLK_SMC_SUPPORT
	depends on PLAT_CLK
	bool "clk SMC handler"
	default n

config PLL_LOCK_RETRY
	depends on PLAT_CLK
	bool "clk pll lock retry"
	default n

config MCLK_SUPPORT
	depends on CLK_MAILBOX_SUPPORT
	bool "mclk support in phoe CDC"
	default n

config PLL_UNLOCK_DETECT
	depends on PLAT_CLK
	bool "pll clk unlock detect"

config CLK_BUCK13_DVS
	bool "buck13 dvs feature"
	default n

config PLL_VOTE_SEC
	depends on PLAT_CLK
	bool "clk pll vote sec"
	default n

config CLK_WAIT_DONE
	depends on PLAT_CLK
	bool "clk wait div done"
	default n

config FSM_PPLL_VOTE
	depends on PLAT_CLK
	bool "clk ppll fsm vote"
	default n

source "platform_source/basicplatform/drivers/clk/extreme/dvfs/Kconfig"
source "platform_source/basicplatform/drivers/clk/extreme/debug/Kconfig"
```

## platform_source/basicplatform/drivers/clk/normal/Kconfig
```kconfig
config CLK_ALWAYS_ON
	bool "all clocks of Soc are always on"
	default n

config CLK_PM_MONITOR
	bool "clock pm_monitor spec"
	default n

config CLK_MAILBOX_SUPPORT
	depends on PLAT_CLK
	depends on IPC_MAILBOX
	bool "clk driver support mailbox communication"
	default n

config CKM_MODULE
	depends on PLAT_CLK
	bool "clk monitor driver"
	default n

config CLK_SMC_SUPPORT
	depends on PLAT_CLK
	bool "clk SMC handler"
	default n

config PLL_LOCK_RETRY
	depends on PLAT_CLK
	bool "clk pll lock retry"
	default n

config CLK_WAIT_DONE
	depends on PLAT_CLK
	bool "clk wait div done"
	default n

source "platform_source/basicplatform/drivers/clk/normal/dvfs/Kconfig"
source "platform_source/basicplatform/drivers/clk/normal/debug/Kconfig"
```

## platform_source/basicplatform/drivers/clk/normal/debug/Kconfig
```kconfig
config CLK_DEBUG
	bool "Clock Debug driver for ARM Reference designs"
	default n

config CLK_TRACE
	bool "Clock Debug driver for CLK TRACE"
	default n
```

## platform_source/basicplatform/drivers/clk/normal/dvfs/Kconfig
```kconfig
config PERI_DVFS
	bool "PERI_DVFS"
	default n
config CLK_LOW_TEMPERATURE_JUDGE_BY_VOLT
	depends on PERI_DVFS
	bool "CLK LOW TEMPERATURE PROPERTY JUDGE BY VOLTAGE"
	default n
config PERI_FAST_AVS
	depends on PERI_DVFS
	depends on IPC_MAILBOX
	bool "PERI FAST AVS"
	default n
config PERI_AVS_IPC_NOTIFY
	depends on PERI_DVFS
	depends on IPC_MAILBOX
	bool "PERI AVS IPC NOTIFY"
	default n
config PERI_VOLT_HW_VOTE
	depends on PERI_DVFS
	bool "PERI VOLT HW VOTE"
	default n
config HW_PERI_DVS
	depends on PERI_DVFS
	bool "HW PERI DVS"
	default n
```

## platform_source/basicplatform/drivers/cmdline/Kconfig
```kconfig
config CMDLINE_PARSE
       bool "cmdline parse"
       default n
       help
          Say 'Y' here if you want to support the cmdline parse
	  on platform

config SOC_CHIP_LEVEL
       bool "soc chip level"
       default n
       help
          Say 'Y' here if you want to support the soc chip level
```

## platform_source/basicplatform/drivers/dieid/Kconfig
```kconfig
config PLATFORM_DIEID
	bool "Support Platform DIEID driver"
	default n
	help
	Say yes here if you want to use platform dieid
```

## platform_source/basicplatform/drivers/dma/Kconfig
```kconfig
# SPDX-License-Identifier: GPL-2.0

config PERI_DMA
	tristate "peri DMA support"
	depends on ARCH_HISI
	select DMA_ENGINE
	select DMA_VIRTUAL_CHANNELS
	help
	  Support the DMA engine for some platform
	  devices.

config PERI_DMA_NO_CCI
	bool "peri DMA CCI support"
	depends on (PERI_DMA)
	help
	  peri DMA CCI switch

config PERI_DMA_PM_RUNTIME
	bool "peri DMA pm runtime support"
	depends on (PERI_DMA && PM_RUNTIME)
	help
	  peri DMA pm runtime switch.
```

## platform_source/basicplatform/drivers/gpio/Kconfig
```kconfig
# SPDX-License-Identifier: GPL-2.0

config GPIO_HIV500
	bool "PrimeCell HIV500 GPIO support"
	depends on ARM_AMBA
	select IRQ_DOMAIN
	select GPIOLIB_IRQCHIP
	help
	  Say yes here to support the PrimeCell HIV500 GPIO device

config GPIO_HI6502
	bool "HI6502 GPIO support"
	depends on GPIO_PL061
	help
	  Say yes here to support the HI6502 GPIO device

config GPIO_PL061_VM
	bool "HI Virtual GPIO support"
	depends on GPIO_PL061
	default n
	help
	  Say yes here to support the virtual gpio
```

## platform_source/basicplatform/drivers/hck/Kconfig
```kconfig
# SPDX-License-Identifier: GPL-2.0
menu "Hck"

config HCK
	bool "Hck Drivers"
	help
	  Enable support for various drivers needed on the HiSilicon Common Kernel

if HCK

config HCK_VENDOR_HOOKS
	bool "Hck Vendor Hooks"
	depends on TRACEPOINTS
	help
	  Enable vendor hooks implemented as tracepoints

	  Allow vendor modules to attach to tracepoint "hooks" defined via
	  DECLARE_HCK_HOOK DECLARE_HCK_RESTRICTED_HOOK DECLARE_PUB_HOOK or DECLARE_PUB_RESTRICTED_HOOK.
endif # if HCK

endmenu
```

## platform_source/basicplatform/drivers/hitest/Kconfig
```kconfig
config HISILICON_PLATFORM_HITEST
	bool "platform hitest module support"
	depends on DFX_DEBUG_FS
	default y
	help
	  Say yes here to support the hisilicon platform hitest module
```

## platform_source/basicplatform/drivers/hwspinlock/Kconfig
```kconfig
# SPDX-License-Identifier: GPL-2.0

config VENDOR_HWSPINLOCK
	tristate "HISI Hardware Spinlock device"
	depends on HWSPINLOCK
	default n
	help
	  Say y here to support the HI3XXX Hardware Spinlock device.

	  If unsure, say N.

config VENDOR_HWSPINLOCK_DEBUG
	tristate "HISI Hardware Spinlock device"
	default n
	help
	  Say y here to support the HI3XXX Hardware Spinlock device.

	  If unsure, say N.
```

## platform_source/basicplatform/drivers/i2c/Kconfig
```kconfig
# SPDX-License-Identifier: GPL-2.0

config I2C_V300_DESIGNWARE
	tristate "Synopsys DesignWare I2C_V300"
	depends on HAVE_CLK
	select I2C_DESIGNWARE_CORE
	help
	  If you say yes to this option, support will be included for the
	  Synopsys DesignWare I2C adapter on some plat.
	  Only master mode is supported.


config I2C_V400_MASTER
	tristate "I2C_V400 MASTR"
	depends on HAVE_CLK
	help
	  If you say yes to this option, support will be included for the
	  I2C adapter on some plat.
```

## platform_source/basicplatform/drivers/i3c/Kconfig
```kconfig
# SPDX-License-Identifier: GPL-2.0-only
config I3C_V100_DESIGNWARE
	tristate "Synopsys DesignWare of i3c"
	depends on HAVE_CLK
	select DW_I3C_MASTER
	help
	  If you say yes to this option, support will be included for the
	  Synopsys DesignWare I3C master on platform.
	  Only master mode is supported.
```

## platform_source/basicplatform/drivers/input/keyboard/Kconfig
```kconfig
# SPDX-License-Identifier: GPL-2.0

config KEYBOARD_CORE
	tristate "key core support"
	help
	  Say Y here to enable the key support for platform soft.

	  To compile this driver as a module, choose M here: the
	  module will be called keypad.

config KEYBOARD_GPIO_VOLUME_KEY
	bool "gpio key support volume-up and volume-down"
	depends on KEYBOARD_CORE
	help
	  Say Y here to enable the power key support for volume key.

config KEYBOARD_PMIC_VOLUME_KEY
	tristate "pmic gpio key support,use to realize volume-up and volume-down"
	depends on SPMI_PLATFORM && PMIC_SPMI
	help
	  Say Y here to enable the volume key support for common platform.

	  To compile this driver as a module, choose M here: the
	  module will be called pmic_gpio_key.

config KEYBOARD_GPIO_FUNC_KEY
	bool "Func key support, depends on key core support"
	depends on KEYBOARD_CORE
	help
	  Say Y here to enable the power key support for func key.

config KEY_MASK
	bool "key mask support, depends on key core support"
	depends on KEYBOARD_CORE || KEYBOARD_PMIC_VOLUME_KEY
	help
	  Say Y here to enable the volume keymask.

config VOLUMEKEY_COMBINATION
	bool "volume combination support, depends on key core support"
	depends on KEYBOARD_CORE || KEYBOARD_PMIC_VOLUME_KEY
	help
	  Say Y here to enable the volume key combination function.
```

## platform_source/basicplatform/drivers/input/misc/Kconfig
```kconfig
# SPDX-License-Identifier: GPL-2.0

config FLAT_VIBRATOR
	bool "Led classdev vibrator flat driver"
	depends on LEDS_TRIGGERS && LEDS_TRIGGER_TRANSIENT
	default n
	help
	  Say Y to enable support for the flat vibrator driver.

	  To compile this driver as a module, choose M here: the module will be
	  called flat vibrator driver.

config LINEAR_VIBRATOR
	bool "Led classdev pmic_vibrator linear driver"
	depends on LEDS_TRIGGERS && LEDS_TRIGGER_TRANSIENT
	default n
	help
	  Say Y to enable support for the Linear PMIC vibrator driver.

	  To compile this driver as a module, choose M here: the module will be
	  called linear vibrator driver.

config LINEAR_VIBRATOR_DEBUG
	bool "Led classdev pmic_vibrator driver debug"
	depends on LINEAR_VIBRATOR
	default n

config POWERKEY_SPMI
	tristate "PMIC SPMI ONKEY support"
	depends on SPMI_PLATFORM && PMIC_SPMI
	help
	  Say Y to enable support for PMIC ONKEY.

	  To compile this driver as a module, choose M here: the
	  module will be called powerkey.

config POWERKEY_DEBUG
	bool "powerkey driver debug"
	depends on DEBUG_FS
	default n

config SUPPORT_SIM1_HPD_KEY_RESTART
	bool "SIM1_HPD support"
	depends on POWERKEY_SPMI
	default n
	help
	  Say Y to enable support for SIM1_HPD key.

	  To compile this driver as a module, choose M here: the
	  module will be called powerkey.
```
