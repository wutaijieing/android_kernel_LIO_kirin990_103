## platform_source/cee/drivers/ddrc/Kconfig
```kconfig
config DDR_PLATFORM_DDRC
	bool "ddr controller support"
	default n
	help
	  Say yes here to support the ddr controller

config DDR_TRACKING
        tristate "DDR Tracking Function"
        default n
        help
                DDR Tracking Function

config DDR_DDRC_FLUX
	bool "ddr bandwith statstic "
	default n

config DDR_DDRC_SEC
	bool "ddr secprotect"
	default n

config DDR_SUBREASON
	bool "ddr subreason"
	default n

config MNTN_DMSS_OPTI
	bool "dmss opti"
	default n

config DDR_AUTO_FSGT
       bool "ddr autofs/autogt"
       default n

config DDR_LACERTA
       bool "ddr lacerta platform"
       default n

config DDR_CETUS
       bool "ddr cetus platform"
       default n

config DDR_PERSEUS
       bool "ddr perseus platform"
       default n

config DDR_URSA
       bool "ddr ursa platform"
       default n

config DDR_CASSIOPEIA
       bool "ddr cassiopeia platform"
       default n

config DDR_CEPHEUS
       bool "ddr cepheus platform"
       default n

config DDR_MONOCEROS
       bool "ddr monoceros platform"
       default n

config DDR_DRACO
       bool "ddr draco platform"
       default n

config DDR_TRIONES
       bool "ddr triones platform"
       default n

config DDR_PISCES
       bool "ddr pisces platform"
       default n

config DDR_CHAMAELEON
       bool "ddr chamaeleon platform"
       default n

config AP_CUST_2G_MEM
       bool "Cust 2G memory support"
       default n
       help
             2G memory Pad, To enable this configure for Pad
	     others disable

config DDR_PERF_CTRL
        tristate "DDR Performance Control Function"
        depends on PERF_CTRL
        default n
        help
	  DDR Performance Control Function
```
