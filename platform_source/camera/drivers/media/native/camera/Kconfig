## platform_source/camera/drivers/media/native/camera/Kconfig
```kconfig
comment "Native Camera"

# source "platform_source/camera/drivers/media/native/camera/isp/Kconfig"
source "platform_source/camera/drivers/media/native/camera/hisp/Kconfig"
source "platform_source/camera/drivers/media/native/camera/sensor/Kconfig"
source "platform_source/camera/drivers/media/native/camera/laser/Kconfig"
source "platform_source/camera/drivers/media/native/camera/fd/Kconfig"
source "platform_source/camera/drivers/media/native/camera/pmic/Kconfig"

source "platform_source/camera/drivers/media/native/camera/platform/Kconfig"

source "platform_source/camera/drivers/media/native/camera/fpga/Kconfig"
source "platform_source/camera/drivers/media/native/camera/driver_ic/Kconfig"
source "platform_source/camera/drivers/media/native/camera/dot/Kconfig"


menuconfig KERNEL_CAMERA_LASER
    bool "Native laser support"
    default n
    help
        Say Y here to enable Laser for native camera

menuconfig KERNEL_CAMERA_FLASH
    bool "Native flash support"
    default n
    help
        Say Y here to enable Flash for native camera
menuconfig KERNEL_CAMERA_FPGA
    bool "Native Camera FPGA support"
    default n
    help
        Say Y here to enable fpga for native camera
menuconfig KERNEL_CAMERA_DRIVER_IC
    bool "Native Camera Driver IC support"
    default n
    help
        Say Y here to enable driver ic for native camera
menuconfig KERNEL_CAMERA_DOT_PROJECTOR
    bool "Native Camera Dot support"
    default n
    help
        Say Y here to enable dot projector for native camera

config KERNEL_CAMERA_ISPV110
    tristate "Support histar ispv110 driver"
    depends on KERNEL_CAMERA
    default n
    help
        chip histar ispv110 driver.

config KERNEL_CAMERA_ISPV150
    tristate "Support histar ispv150 driver"
    depends on KERNEL_CAMERA
    default n
    help
        chip histar ispv150 driver.

config KERNEL_CAMERA_ISPV160
    tristate "Support histar ispv160 driver"
    depends on KERNEL_CAMERA
    default n
    help
        chip histar ispv160 driver.

config KERNEL_CAMERA_ISPV120
    tristate "Support histar ispv120 driver"
    depends on KERNEL_CAMERA
    default n
    help
        chip histar ispv120 driver.

config KERNEL_CAMERA_ISPV130
    tristate "Support histar ispv130 driver"
    depends on KERNEL_CAMERA
    default n
    help
        chip histar ispv130 driver.

config KERNEL_CAMERA_ISPV200
    tristate "Support histar ispv200 driver"
    depends on KERNEL_CAMERA
    default n
    help
        chip histar ispv200 driver.

config KERNEL_CAMERA_ISPV250
    tristate "Support histar ispv250 driver"
    depends on KERNEL_CAMERA
    default n
    help
        chip histar ispv250 driver.

config KERNEL_CAMERA_ISPV210
    tristate "Support histar ispv210 driver"
    depends on KERNEL_CAMERA
    default n
    help
        chip histar ispv210 driver.

config KERNEL_CAMERA_ISPV310
    tristate "Support histar ispv310 driver"
    depends on KERNEL_CAMERA
    default n
    help
        chip histar ispv310 driver.

config KERNEL_CAMERA_ISPV300
    tristate "Support histar ispv300 driver"
    depends on KERNEL_CAMERA
    default n
    help
        chip histar ispv300 driver.

config KERNEL_CAMERA_ISPV350
    tristate "Support histar ispv350 driver"
    depends on KERNEL_CAMERA
    default n
    help
        chip histar ispv350 driver.

config CAMERA_ISPV220
    tristate "Support histar ispv220 driver"
    depends on KERNEL_CAMERA
    default n
    help
        Histar ispv220 driver.

config CAMERA_ISPV230
    tristate "Support histar ispv230 driver"
    depends on KERNEL_CAMERA
    default n
    help
        Histar ispv230 driver.

config KERNEL_CAMERA_ISP_SECURE
    tristate "Support histar isp secure"
    depends on KERNEL_CAMERA
    default n
    help
        chip histar isp secure.
config KERNEL_CAMERA_PMIC
    tristate "Support Camera PMIC"
    depends on KERNEL_CAMERA
    default n
    help
        Support Camera PMIC chip

config KERNEL_CAMERA_BUCK
    tristate "Support Camera BUCK"
    depends on KERNEL_CAMERA
    default n
    help
        Support Camera BUCK chip
```

## platform_source/camera/drivers/media/native/camera/dot/Kconfig
```kconfig
if KERNEL_CAMERA_DOT_PROJECTOR

config KERNEL_CAMERA_DOT_PROJECTOR_CYC8
    tristate "cyc8 camera dot driver"
    depends on KERNEL_CAMERA_DOT_PROJECTOR
    default n
    help
        cyc8 camera dot driver

endif
```

## platform_source/camera/drivers/media/native/camera/fd/Kconfig
```kconfig
comment "FNFaceDetection"

config USE_FNFD
    tristate "Support FNFaceDetection driver"
    depends on KERNEL_CAMERA
    default n
    help
        FNFaceDetection.
```

## platform_source/camera/drivers/media/native/camera/fpga/Kconfig
```kconfig
if KERNEL_CAMERA_FPGA

config KERNEL_CAMERA_FPGA_ICE40
    tristate "ice40 camera fpga driver"
    depends on KERNEL_CAMERA_FPGA
    default n
    help
        ice40 camera fpga driver

config KERNEL_CAMERA_FPGA_STM32
    tristate "stm32 camera fpga driver"
    depends on KERNEL_CAMERA_FPGA
    default n
    help
        stm32 camera fpga driver
endif
```

## platform_source/camera/drivers/media/native/camera/hisp/Kconfig
```kconfig
comment "MODULE ISP"


if KERNEL_CAMERA_ISPV110
source "platform_source/camera/drivers/media/native/camera/hisp/hisp110/Kconfig"
endif

if KERNEL_CAMERA_ISPV150
source "platform_source/camera/drivers/media/native/camera/hisp/hisp150/Kconfig"
endif

if KERNEL_CAMERA_ISPV160
source "platform_source/camera/drivers/media/native/camera/hisp/hisp160/Kconfig"
endif

if KERNEL_CAMERA_ISPV120 || KERNEL_CAMERA_ISPV130
source "platform_source/camera/drivers/media/native/camera/hisp/hisp120/Kconfig"
endif

if KERNEL_CAMERA_ISPV200
source "platform_source/camera/drivers/media/native/camera/hisp/hisp200/Kconfig"
endif

if KERNEL_CAMERA_ISPV250
source "platform_source/camera/drivers/media/native/camera/hisp/hisp250/Kconfig"
endif

if KERNEL_CAMERA_ISPV210
source "platform_source/camera/drivers/media/native/camera/hisp/hisp210/Kconfig"
endif

if CAMERA_ISPV220 || CAMERA_ISPV230
source "platform_source/camera/drivers/media/native/camera/hisp/hisp220/Kconfig"
endif

if KERNEL_CAMERA_ISPV310
source "platform_source/camera/drivers/media/native/camera/hisp/hisp310/Kconfig"
endif

if KERNEL_CAMERA_ISPV300
source "platform_source/camera/drivers/media/native/camera/hisp/hisp300/Kconfig"
endif

if KERNEL_CAMERA_ISPV350
source "platform_source/camera/drivers/media/native/camera/hisp/hisp350/Kconfig"
endif
```

## platform_source/camera/drivers/media/native/camera/hisp/hisp110/Kconfig
```kconfig
comment "MODULE ISP"

choice
	prompt "HISP Version"
	default KERNEL_CAMERA_USE_HISP110
	depends on KERNEL_CAMERA
	help
        Select ISP version.

config KERNEL_CAMERA_USE_HISP110
	bool "HISP110"
	depends on KERNEL_CAMERA

endchoice
```

## platform_source/camera/drivers/media/native/camera/hisp/hisp120/Kconfig
```kconfig
comment "MODULE ISP"

choice
	prompt "HISP Version"
	default KERNEL_CAMERA_USE_HISP120
	depends on KERNEL_CAMERA
	help
        Select ISP version.

config KERNEL_CAMERA_USE_HISP120
	bool "HISP120"
	depends on KERNEL_CAMERA

endchoice
```

## platform_source/camera/drivers/media/native/camera/hisp/hisp150/Kconfig
```kconfig
comment "MODULE ISP"

choice
	prompt "HISP Version"
	default KERNEL_CAMERA_USE_HISP150
	depends on KERNEL_CAMERA
	help
        Select ISP version.

config KERNEL_CAMERA_USE_HISP150
	bool "HISP150"
	depends on KERNEL_CAMERA

endchoice
```

## platform_source/camera/drivers/media/native/camera/hisp/hisp160/Kconfig
```kconfig
comment "MODULE ISP"

choice
	prompt "HISP Version"
	default KERNEL_CAMERA_USE_HISP160
	depends on KERNEL_CAMERA
	help
        Select ISP version.

config KERNEL_CAMERA_USE_HISP160
	bool "HISP160"
	depends on KERNEL_CAMERA

endchoice
```

## platform_source/camera/drivers/media/native/camera/hisp/hisp200/Kconfig
```kconfig
comment "MODULE ISP"

choice
	prompt "HISP Version"
	default KERNEL_CAMERA_USE_HISP200
	depends on KERNEL_CAMERA
	help
        Select ISP version.

config KERNEL_CAMERA_USE_HISP200
	bool "HISP200"
	depends on KERNEL_CAMERA

endchoice
```

## platform_source/camera/drivers/media/native/camera/hisp/hisp210/Kconfig
```kconfig
comment "MODULE ISP"

choice
	prompt "HISP Version"
	default KERNEL_CAMERA_USE_HISP210
	depends on KERNEL_CAMERA
	help
        Select ISP version.

config KERNEL_CAMERA_USE_HISP210
	bool "HISP210"
	depends on KERNEL_CAMERA

endchoice
```

## platform_source/camera/drivers/media/native/camera/hisp/hisp220/Kconfig
```kconfig
comment "MODULE ISP"

choice
	prompt "HISP Version"
	default CAMERA_USE_HISP220
	depends on KERNEL_CAMERA
	help
        Select ISP version.

config CAMERA_USE_HISP220
	bool "HISP220"
	depends on KERNEL_CAMERA

config CAMERA_USE_HISP230
    bool "HISP230"
    depends on KERNEL_CAMERA
endchoice
```

## platform_source/camera/drivers/media/native/camera/hisp/hisp250/Kconfig
```kconfig
comment "MODULE ISP"

choice
	prompt "HISP Version"
	default KERNEL_CAMERA_USE_HISP250
	depends on KERNEL_CAMERA
	help
        Select ISP version.

config KERNEL_CAMERA_USE_HISP250
	bool "HISP250"
	depends on KERNEL_CAMERA

endchoice
```

## platform_source/camera/drivers/media/native/camera/hisp/hisp300/Kconfig
```kconfig
comment "MODULE ISP"

choice
	prompt "HISP Version"
	default KERNEL_CAMERA_USE_HISP300
	depends on KERNEL_CAMERA
	help
        Select ISP version.

config KERNEL_CAMERA_USE_HISP300
	bool "HISP300"
	depends on KERNEL_CAMERA

endchoice
```

## platform_source/camera/drivers/media/native/camera/hisp/hisp310/Kconfig
```kconfig
comment "MODULE ISP"

choice
	prompt "HISP Version"
	default KERNEL_CAMERA_USE_HISP310
	depends on KERNEL_CAMERA
	help
        Select ISP version.

config KERNEL_CAMERA_USE_HISP310
	bool "HISP310"
	depends on KERNEL_CAMERA

endchoice
```

## platform_source/camera/drivers/media/native/camera/hisp/hisp350/Kconfig
```kconfig
comment "MODULE ISP"

config HISI_HISP350_STUB
	tristate "HISI HISP350 STUB"
	default n
	help
	Open isp350 stub

choice
	prompt "HISP Version"
	default KERNEL_CAMERA_USE_HISP350
	depends on KERNEL_CAMERA
	help
        Select ISP version.

config KERNEL_CAMERA_USE_HISP350
	bool "HISP350"
	depends on KERNEL_CAMERA

endchoice
```

## platform_source/camera/drivers/media/native/camera/sensor/Kconfig
```kconfig
comment "Native Sensor"

source "platform_source/camera/drivers/media/native/camera/sensor/vcm/Kconfig"
source "platform_source/camera/drivers/media/native/camera/sensor/flash/Kconfig"
source "platform_source/camera/drivers/media/native/camera/sensor/ois/Kconfig"
```

## platform_source/camera/drivers/media/native/igscam/Kconfig
```kconfig
config CONTEXTHUB_IGS_CAM
	bool "igs cam driver"
	depends on INPUTHUB_20&&KERNEL_CAMERA
	default n
	help
	Igs driver support camera.
```

## platform_source/cee/Kconfig
```kconfig
menu "cee Kernel Configuration"

source "platform_source/cee/drivers/Kconfig"

endmenu
```

## platform_source/cee/drivers/Kconfig
```kconfig
menu "driver Configuration"

source "platform_source/cee/drivers/l3cache/Kconfig"
source "platform_source/cee/drivers/hw_vote/Kconfig"
source "platform_source/cee/drivers/qos/Kconfig"
source "platform_source/cee/drivers/file_encry/Kconfig"
source "platform_source/cee/drivers/pm/Kconfig"
source "platform_source/cee/drivers/gpufreq/Kconfig"
source "platform_source/cee/drivers/npu_pm/Kconfig"
source "platform_source/cee/drivers/onsys_avs/Kconfig"
source "platform_source/cee/drivers/adc/Kconfig"
source "platform_source/cee/drivers/perfhub/Kconfig"
source "platform_source/cee/drivers/dpm/Kconfig"
source "platform_source/cee/drivers/ddrc/Kconfig"
source "platform_source/cee/drivers/perf_ctrl/Kconfig"
source "platform_source/cee/drivers/lpmcu_debug/Kconfig"
source "platform_source/cee/drivers/hotplug_agent/Kconfig"
source "platform_source/cee/drivers/soc_pg_feature_modem/Kconfig"
source "platform_source/cee/drivers/freqdump/Kconfig"
source "platform_source/cee/drivers/perf_stat/Kconfig"
source "platform_source/cee/drivers/bus_monitor/Kconfig"

endmenu
```

## platform_source/cee/drivers/adc/Kconfig
```kconfig
config LPM_HKADC
	bool "LPM ADC support"
	depends on IPC_MAILBOX
	default n
	help
	  Say yes here to support the LPM ADC device

config HKADC_DEBUG
	tristate "ADC DEBUG"
	help
	  Say yes here to support this lock
```

## platform_source/cee/drivers/cpufreq/lpcpu/Kconfig.arm
```kconfig
config LP_ENABLE_GET_VAL
	bool "Get cpufreq param"
	default n
	help
	  Get cpufreq param.

config LP_ENABLE_HPM_DATA_COLLECT
	bool "Get hpm volt param"
	depends on LP_ENABLE_GET_VAL
	default n
	help
	  Get avs hpm volt param.

config LPCPU_CPUFREQ_DT
	bool "Platform cpufreq-dt enable"
	default n
	help
	  Customized cpufreq-dt enable.

config LPCPU_CPUFREQ_HV
	bool "Lpcpu cpufreq support hwvote"
	depends on !CPUFREQ_DT
	default n
	help
	  This adds the cpufreq driver for cpu supported hwvote

config LPCPU_HW_VOTE_CPU_FREQ
	bool "Cpufreq-hw_vote enable"
	depends on LPCPU_CPUFREQ_DT && HW_VOTE
	default n
	help
	  Cpufreq-hw_vote enable.

config LPCPU_L2_DYNAMIC_RETENTION
	bool "L2 dynamic retention by freq"
	depends on LPCPU_HW_VOTE_CPU_FREQ
	default n
	help
	  L2 dynamic retention.

config LPCPU_FREQ_LINK
	bool "Cpu and devices freq link enable"
	depends on CPU_FREQ && PLATFORM_IPC_MAILBOX
	select PERF_MODE
	default n
	help
	  Cpu and devices freq link enable.

config CPU_FREQ_POWER_STAT
	bool "Estimation of task power consumption"
	depends on CPU_FREQ_STAT
	select CPU_FREQ_TIMES
	default n
	help
	  Keep track of amount of power each task consumes and report power per uid

config CPU_FREQ_GOV_SCHEDUTIL_OPT
	bool "Platform 'schedutil' cpufreq governor optimize"
	depends on CPU_FREQ_GOV_SCHEDUTIL
	default n
	help
	  This extends the functionality of existing schedutil governor.

config LPCPU_CPUFREQ_LOWTEMP
	bool "Low temperature cpu frequency set enable"
	depends on CPU_FREQ
	default n
	help
	  Low temperature cpu frequency set enable.

config LPCPU_CPUFREQ_LOWTEMP_DEBUG
	bool "Low temperature cpu frequency set debug enable"
	depends on LPCPU_CPUFREQ_LOWTEMP && DFX_DEBUG_FS
	default n
	help
	  Low temperature cpu frequency set debug enable.

config FREQ_STATS_COUNTING_IDLE
	bool "time in state seperate active and idle time"
	depends on CPU_FREQ_STAT && CPU_IDLE
	default n
	help
	  Account active and idle time in different frequencies.

config FREQ_IO_LIMIT
	bool "Limit IO boost Freqency"
	depends on CPU_FREQ_GOV_SCHEDUTIL_OPT
	default n
	help
	  limit maximum io-boost frequency
```
