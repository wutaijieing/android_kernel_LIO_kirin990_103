## platform_source/cee/drivers/devfreq/gpu_devfreq/Kconfig
```kconfig
menuconfig GPU_DEVFREQ
	tristate "GPU Devfreq Support"
	default n
	depends on ARCH_PLATFORM && PM_DEVFREQ
	select PM_OPP
	select DEVFREQ

config DEVFREQ_GOV_GPU_SCENE_AWARE
	tristate "GPU Scene Aware"
	select GPU_DEVFREQ

config GPU_RT_DEVFREQ
	bool "force update devfreq when gpu in runtime"
	default n
	depends on DEVFREQ_GOV_GPU_SCENE_AWARE

config GPUFREQ_GOV_POLICY_USING_DTSI
	bool "gpu governor policy using dtsi"
	default n
	depends on DEVFREQ_GOV_GPU_SCENE_AWARE
```

## platform_source/cee/drivers/devfreq/l3p_karma/Kconfig
```kconfig
config L3P_KARMA
		tristate "L3 PREFETCH KARMA DEVFREQ Driver"
		depends on ARCH_PLATFORM && PM_DEVFREQ && KARMA_PMU
		select PM_OPP
	    help
			This enables the l3p karma devfreq driver.

config L3P_KARMA_DEBUG
		tristate "L3P KARMA SYSFS DEBUG"
		depends on L3P_KARMA
		default n
	    help
		  l3p karma devfreq driver sysfs debug
```

## platform_source/cee/drivers/devfreq/npu_devfreq/Kconfig
```kconfig
config DEVFREQ_GOV_NPU_PM_QOS
	tristate "NPU PM QOS"
	depends on ARCH_PLATFORM && PM_DEVFREQ
	select PM_OPP
	select DEVFREQ
```

## platform_source/cee/drivers/devfreq/proxy_devfreq/Kconfig
```kconfig
config PROXY_DEVFREQ
	tristate "Proxy DEVFREQ Driver"
	select DEVFREQ_GOV_SIMPLE_ONDEMAND
	select PM_OPP
	select PM_DEVFREQ
	help
	  This adds the proxy DEVFREQ driver for handling VM frequency scaling.
```

## platform_source/cee/drivers/factory_svfd/Kconfig
```kconfig
config FACTORY_SVFD
	bool "factory svfd data debug driver"
	depends on DFX_BB
	default n
	help
           Say 'Y' here if you want to read the data of factory svfd test
```

## platform_source/cee/drivers/freqdump/Kconfig
```kconfig
#
#Freqdump support.
#
comment "Freqdump FEATURE"
config FREQDUMP
	bool "Freqdump"
	depends on DFX_DEBUG_FS
	default n
	help
	  Driver for kernel freqdump

config FREQDUMP_PLATFORM
	bool "jupiter and after jupiter's freqdump feature"
	default n

config DPM_PLATFORM_JUPITER
	bool "jupiter Digital power monitor(loadmonitor) driver config"
	default n

config DPM_PLATFORM_SATURN
	bool "saturn Digital power monitor(loadmonitor) driver config"
	default n

config DPM_PLATFORM_EARTH
	bool "earth Digital power monitor(loadmonitor) driver config"
	default n

config DPM_PLATFORM_MARS
	bool "mars Digital power monitor(loadmonitor) driver config"
	default n

config DPM_PLATFORM_VENUS
	bool "venus Digital power monitor(loadmonitor) driver config"
	default n

config DPM_PLATFORM_URANUS
	bool "uranus Digital power monitor(loadmonitor) driver config"
	default n

config DPM_PLATFORM_MERCURY
	bool "mercury Digital power monitor(loadmonitor) driver config"
	default n

config FREQDUMP_MERCURY
	bool "mercury freqdump"
	depends on DFX_DEBUG_FS
	default n
	help
	  Driver for kernel mercury freqdump

config FREQDUMP_URANUS
	bool "uranus freqdump"
	depends on DFX_DEBUG_FS
	default n
	help
	  Driver for kernel uranus freqdump

config ENABLE_MIDEA_MONITOR
	bool "enable media1 & media2 loadmonitor"
	default n

config FREQDUMP_PLATFORM_VENUS
	bool "venus freqdump driver config"
	default n

config COMMON_LOADMONITOR_PLATFORM
	bool "Digital power monitor(loadmonitor) platform driver config(from neptune)"
	default n
	help
	  Driver for kernel loadmonitor platform
	  from neptune
	  every new platform need configure .config file
	  eng and user version all need this config

config NEPTUNE_PLATFORM
	bool "Digital power monitor neptune platform driver config"
	default n
	help
	  Driver for kernel freqdump&loadmonitor platform
	  for neptune
	  neptune platform need configure .config file
	  eng and user version all need this config

config COMMON_FREQDUMP_PLATFORM
	bool "Digital power monitor(freqdump) platform driver config(from neptune)"
	default n
	help
	  Driver for kernel freqdump platform
	  every new platform need configure .config file
	  default depens on DEBUG_FS(from neptune)
	  eng version need this config
	  perf version need this config

config DPM_PLATFORM_PLUTO
	bool "pluto Digital power monitor(loadmonitor) driver config"
	default n

config FREQDUMP_PLUTO
	bool "pluto freqdump"
	depends on DFX_DEBUG_FS
	default n
	help
	Driver for kernel pluto freqdump

config DPM_PLATFORM_LUNA
	bool "luna Digital power monitor(loadmonitor) driver config"
	default n

config FREQDUMP_LUNA
	bool "luna freqdump"
	depends on DFX_DEBUG_FS
	default n
	help
	Driver for kernel luna freqdump
```

## platform_source/cee/drivers/gpufreq/Kconfig
```kconfig
menu "GPUFREQ Options"

config GPUFREQ
    tristate "GPUFREQ Driver"
    depends on ARCH_PLATFORM && PM_DEVFREQ
    select PM_OPP
    help
      This enables the gpufreq driver.

config GPUFREQ_INDEPDENT
    tristate "NEW GPUFREQ Driver"
    depends on ARCH_PLATFORM && PM_DEVFREQ
    select PM_OPP
    help
      This enables the gpufreq driver.

config GPUFREQ_HW_VOTE
	bool "Enable hardware vote gpu freq feature"
	depends on GPUFREQ_INDEPDENT && HW_VOTE
	default n
	help
	  enable hardware vote gpu freq feature

config GPU_FHSS
    tristate "GPU Frequency-Hopping Spread Spectrum Driver"
    depends on GPUFREQ
    help
      This enables the Frequency-Hopping Spread Spectrum of GPU feature.

config GPUTOP_FREQ
    tristate "GPUTOP Driver"
    depends on GPUFREQ
    help
      This enables the GPUTOP feature.

config GPUTOP_FREQ_DEBUG
    tristate "GPUTOP Driver debug"
    depends on GPUTOP_FREQ
    help
      This enables the GPUTOP debug feature.

config GPUFREQ_VOTE
    tristate "GPUFREQ Vote Driver"
    depends on GPUFREQ_INDEPDENT
    help
      This enables the GPUFREQ vote drvier feature.

config GPUFREQ_USER_VOTE
    tristate "GPUFREQ Vote User Space interface"
    depends on GPUFREQ_VOTE
    help
      This enables the GPUFREQ vote User Space interface feature.
source "platform_source/cee/drivers/gpufreq/link/Kconfig"
endmenu
```

## platform_source/cee/drivers/gpufreq/link/Kconfig
```kconfig
menu "GPUFLINK Options"

config GPUFLINK
    tristate "GPUFREQ LINK CORE"
    depends on GPUFREQ
    select PERF_MODE
    help
      This enables the gpuflink driver

config DDRLINK_GOV_DEFAULT
    tristate "GPUFREQ LINK DDRFREQ DEFAULT GOVERNOR"
    depends on GPUFLINK
    help
      This enable gpufreq link ddr governor register to gpuflink core

config DDRLINK_QOS_DRV
    tristate "GPUFREQ LINK DDRFREQ QOS DRIVER"
    depends on GPUFLINK && DEVFREQ_GOV_PLATFORM_QOS
    help
      This enable gpufreq link ddr qos driver register to gpuflink core

endmenu
```

## platform_source/cee/drivers/hotplug_agent/Kconfig
```kconfig
config HOTPLUG_AGENT
	bool "hotplug agent"
	default n
	help
	 provide hotplug management service

config HOTPLUG_AGENT_DEBUG
	bool "hotplug agent debug"
	depends on HOTPLUG_AGENT
	default n
	help
	 enable debug interface for hotplug agent
```

## platform_source/cee/drivers/l3cache/Kconfig
```kconfig
menu "L3Cache"
config L3CACHE_EXTENSION
	bool "l3cache extension"
	depends on MM_LB_L3_EXTENSION
	default n
	help
	 support l3cache extension

config L3CACHE_EXTENSION_DSU
	bool "enabled only for arm dsu"
	depends on L3CACHE_EXTENSION
	default n
	help
	 support l3cache extension for arm dsu

config L3CACHE_EXTENSION_DYNAMIC
	bool "l3cache extension dynamic"
	depends on L3CACHE_EXTENSION && !L3CACHE_EXTENSION_DSU
	default n
	help
	 support l3cache extension on/off dynamicly

config L3CACHE_EXTENSION_DEBUG
	bool "l3cache extension debug"
	depends on L3CACHE_EXTENSION
	default n
	help
	 support l3cache extension debug

config L3CACHE_SHARE
	bool "l3cache share"
	default n
	help
	 support l3cache share

config L3CACHE_SHARE_PERF
	bool "l3cache share perf"
	depends on L3CACHE_SHARE && ARM64_DSU_PCTRL_DEVFREQ
	default n
	help
	 support l3cache share perf

config L3CACHE_SHARE_DEBUG
	bool "l3cache share debug"
	depends on L3CACHE_SHARE
	default n
	help
	 support l3cache share debug

config 64BIT_CCSIDR
	bool "64bit CCSIDR"
	default n
	help
	 support 64bit CCSIDR

config L3CACHE_PARTITION_CTRL
	bool "l3cache partition control"
	default n
	help
	 support l3cache partition control

config NAMTSO
	bool "namtso"
	default n
	help
	 support namtso

config NAMTSO_FLUSH_CMO
	bool "namtso flush cmo"
	depends on NAMTSO
	default n
	help
	 support namtso flush cmo

config NONSHAREABLE
	bool "nonshareable access"
	depends on NAMTSO
	default n
	help
	 support nonshareable access mntn

config NAMTSO_DEBUG
	bool "namtso debug"
	depends on NAMTSO
	default n
	help
	 support namtso debug

config L3CACHE_LP_DEBUG
	bool "l3cache lowpower debug"
	default n
	help
	 support l3cache low power debug

endmenu
```

## platform_source/cee/drivers/lpmcu_debug/Kconfig
```kconfig
menu "lpmcu_debug options"

config LPMCU_DEBUG
	depends on IPC_MAILBOX
	bool "LPMCU debug"
	default n
	help
	  lpmcu debug drivers

endmenu
```

## platform_source/cee/drivers/perf/lpcpu/Kconfig
```kconfig
config NAMTSO_PMU
	depends on PERF_EVENTS && NAMTSO
	bool "NAMTSO PMU framework"
	default n
	help
	    Say y if you want to use NAMTSO performance monitors.

config NAMTSO_PMU_DEBUG
	depends on NAMTSO_PMU
	bool "NAMTSO PMU debug"
	default n
	help
	  Say y if you want to use NAMTSO PMU debug function.
```

## platform_source/cee/drivers/perf_stat/Kconfig
```kconfig
config DFX_PERF_STAT
	bool "perf_stat driver 32bit driver"
	default n
	help
	perf_stat driver support
config DFX_PERF_STAT64
	bool "perf_stat driver 64bit driver"
	default n
	help
	perf_stat driver support
config DFX_PERF_STAT_LAT_MON
	bool "perf_stat latency monitor"
	default n
	help
	perf_stat latency monitor support
```

## platform_source/cee/drivers/pm/Kconfig
```kconfig
menu "S/R Configuration Options"
choice
	prompt "Select S/R Architecture"
	default SR_OLD_ARCH
	config SR_NEW_ARCH
		bool "Select the new SR architecture"
	config SR_OLD_ARCH
		bool "Select the old SR architecture"
endchoice

if SR_NEW_ARCH
	source "platform_source/cee/drivers/pm/new/Kconfig"
endif

if SR_OLD_ARCH
	source "platform_source/cee/drivers/pm/old/Kconfig"
endif
endmenu
```

## platform_source/cee/drivers/pm/new/mntn/Kconfig
```kconfig
menu "S/R maintenance options"

config SR_MNTN_AP_WAKE
	bool "SR maintenance: display ap wakeup source"
	default n
	help
	   display ap wakeup source

config SR_MNTN_SYS_WAKE
	bool "SR maintenance: display soc(lpmcu) wakeup source"
	default n
	help
	   display soc(lpmcu) wakeup source

config SR_MNTN_TICKMARK
	bool "SR maintenance: mark ticktime for some key points in SR fllow"
	default n
	help
	   mark ticktime for some key points in SR fllow

config SR_MNTN_PRECHECK
	bool "SR maintenance: check ip(such as clock, regulator) status before enter suspend"
	depends on SR_DEBUG
	default n
	help
	   check ip(such as clock, regulator) status before enter suspend

config SR_MNTN_UART
	bool "SR maintenance: early init uart"
	default n
	help
	   early init uart after system resume

config SR_MNTN_CLOCK
	bool "SR maintenance: display clock status before ap stepin suspend"
	depends on SR_DEBUG
	default n
	help
	   display clock status before ap stepin suspend

config SR_MNTN_PMU
	bool "SR maintenance: display pmu status before ap stepin suspend"
	depends on SR_DEBUG
	default n
	help
	   display pmu status before ap stepin suspend

config SR_MNTN_IO
	bool "SR maintenance: display io status before ap stepin suspend"
	depends on SR_DEBUG
	default n
	help
	   display io status before ap stepin suspend

config SR_MNTN_WDT
	bool "SR maintenance: dump the sr task stack if the watchdog is dead in sr flow"
	default n
	help
	   dump the sr task stack when watchdog is dead in sr flow

config SR_FLOW_TIMEOUT
	int "SR flow timeout in seconds"
	range 1 300
	default 60
	depends on SR_MNTN_WDT

endmenu
```

## platform_source/cee/drivers/qos/Kconfig
```kconfig
menu "platform qos Options"
config PLATFORM_QOS
	bool "platform qos enable"
	default n
	help
	  platform qos enable.

config NETWORK_LATENCY_PLATFORM_QOS
	bool "Network latency switch for Platform QoS"
	default n
	help
	  Enable /dev/network_latency platform qos file to configure network
	  latency by demand.

endmenu
```

## platform_source/cee/drivers/soc_pg_feature_modem/Kconfig
```kconfig
menu "SOC_PG_FEATURE Drivers"

menuconfig SOC_PG_FEATURE_DEVDRV
    bool "SOC_PG_FEATURE support"
    default n
    help
        Say yes here to support soc_pg_feature

source "platform_source/cee/drivers/soc_pg_feature_modem/platform/Kconfig"
endmenu
```

## platform_source/cee/drivers/soc_pg_feature_modem/platform/Kconfig
```kconfig
config SOC_PG_FEATURE_DEVDRV_DEVPLATFORM
    depends on SOC_PG_FEATURE_DEVDRV
    bool "SOC_PG_FEATURE_DEVDRV_DEVPLATFORM"
    default y
    help
    ┆ This driver supports SOC_PG_FEATURE_DEVDRV_DEVPLATFORM,
    ┆ including PG FEATURE driver
```

## platform_source/cee/drivers/tele_mntn/Kconfig
```kconfig
config PLATFORM_TELE_MNTN
	bool "Platform tele_mntn support"
	depends on  LPMCU_BB
	default n
	help
	  Say yes here to support the platform tele_mntn 
```

## platform_source/cee/drivers/thermal_platform/hw_dpm/Kconfig
```kconfig
config DPM_HWMON
	bool "dpm hwmon driver config"
	default n
	help
	  Driver for kernel dpm
config DPM_HWMON_V1
	bool "dpm hwmon first version config"
	depends on DPM_HWMON
	default n
	help
	  First version for kernel dpm
config DPM_HWMON_V2
	bool "dpm hwmon second version config"
	depends on DPM_HWMON
	default n
	help
	  Second version for kernel dpm
config DPM_HWMON_PERIPCR
	bool "dpm hwmon peri pcr config"
	depends on DPM_HWMON_V2
	default n
	help
	  Peri pcr for kernel dpm v2
config DPM_HWMON_V3
	bool "dpm hwmon third version config"
	depends on DPM_HWMON
	default n
	help
	  Third version for kernel dpm
config DPM_HWMON_PWRSTAT
	bool "dpm hwmon powerstat config"
	depends on DPM_HWMON_V3
	default n
	help
	  Powerstat for kernel dpm v3
config DPM_HWMON_DEBUG
	bool "dpm hwmon driver for fitting debug"
	depends on DPM_HWMON
	default n
	help
	  Driver for kernel dpm debug
config MODEM_DPM
	bool "modem dpm hwmon config"
	depends on DPM_HWMON
	default n
	help
	  Driver for modem dpm
```

## platform_source/display/Kconfig
```kconfig
menu "display Kernel Configuration"

source "platform_source/display/drivers/Kconfig"

endmenu
```

## platform_source/display/drivers/Kconfig
```kconfig
menu "driver Configuration"

source "platform_source/display/drivers/drmdriver/Kconfig"
source "platform_source/display/drivers/jpu/Kconfig"

endmenu
```

## platform_source/display/drivers/drmdriver/Kconfig
```kconfig
config DRMDRIVER
    tristate "dpu drm module driver"
    default n
    help
      Provides a secure configuration between kernel and BL31,
	  and drm module driver
```

## platform_source/display/drivers/video/dkmd/Kconfig
```kconfig
config DKMD_ENABLE
	bool "DKMD driver support"
	default n
	help
	  This feature driver supports dkmd driver.

config DKMD_DPU_VERSION
	int "DKMD DPU version"
	depends on DKMD_ENABLE
	help
	  This driver supports DPU version.

source "drivers/video/fbdev/dkmd/backlight/Kconfig"
source "drivers/video/fbdev/dkmd/connector/Kconfig"
source "drivers/video/fbdev/dkmd/cmdlist/Kconfig"
source "drivers/video/fbdev/dkmd/dksm/Kconfig"
source "drivers/video/fbdev/dkmd/dpu/begonia/Kconfig"
```

## platform_source/display/drivers/video/dkmd/dksm/Kconfig
```kconfig
config DKMD_DKSM
	bool "DKMD dksm driver support"
	default n
	help
	  This feature supports dksm driver

config DKMD_DEBUG_ENABLE
	bool "DKMD debug enable"
	default n
	help
	  This feature supports debug config

config DKMD_ASSERT_ENABLE
	bool "DKMD assert enable"
	default n
	help
	  This feature supports assert enable
```
