## platform_source/smart/drivers/Kconfig
```kconfig
config CONTEXTHUB
	bool "Sensor CONTEXTHUB driver"
	default n
	help
	Sensor CONTEXTHUB driver.

config CONTEXTHUB_BOOT_STAT
	bool "sensorhub boot stat"
	depends on CONTEXTHUB
	default n
	help
	Say yes here if you want to record boot stat during sensorhub startup

config CONTEXTHUB_SH_NOCZERO
	bool "Sensor CONTEXTHUB_SH_NOCZERO"
	default n
	help
	Sensor CONTEXTHUB_SH_NOCZERO

config CONTEXTHUB_DFX_NOCMID
	bool "Sensor CONTEXTHUB_DFX_NOCMID"
	default n
	help
	New platform has no MID, So you need to open this Kconfig.

source "platform_source/smart/drivers/bsp/Kconfig"
source "platform_source/smart/drivers/channels/Kconfig"
source "platform_source/smart/drivers/syscounter/Kconfig"
```

## platform_source/smart/drivers/bsp/Kconfig
```kconfig
config INPUTHUB_30
	bool "INPUTHUB_30"
	depends on  CONTEXTHUB
	help
	support INPUTHUB_30.

config SMART_WATCHDOG_V500
	bool "SMART WATCHDOG V500 support"
	depends on CONTEXTHUB
	default n
	help
	Enable support for watchdog v500 driver

config IPC_V5
	bool "IPC_V5"
	depends on  CONTEXTHUB
	help
	support IPC_V5.
```

## platform_source/smart/drivers/channels/Kconfig
```kconfig
config CONTEXTHUB_SHMEM
	bool "Sensor CONTEXTHUB SHMEM driver"
	depends on INPUTHUB || INPUTHUB_20
	default y
	help
	Say yes here if you want to configure contexthub share memory

config CONTEXTHUB_SHELL
	bool "Sensor CONTEXTHUB SHELL DBG driver"
	depends on CONTEXTHUB
	default n
	help
	Say yes here if you want to use contexthub shell dbg function

config CONTEXTHUB_PLAYBACK
	bool "Sensor CONTEXTHUB playback driver"
	depends on CONTEXTHUB
	default n
	help
	Say yes here if you want to use contexthub playback function

config CONTEXTHUB_LOADMONITOR
	bool "Sensor CONTEXTHUB LOADMONITOR driver"
	depends on CONTEXTHUB
	default n
	help
	Say yes here if you want to use contexthub shell dbg function

config CONTEXTHUB_CHRE
	bool "Sensor CONTEXTHUB CHRE driver"
	depends on CONTEXTHUB
	default n
	help
	Say yes here if you want to use contexthub shell dbg function

config INPUTHUB_MOCK_SENSOR
	bool "mock sensor feature support"
	default n
	help
	Say yes here if you want to configure INPUTHUB_MOCK_SENSOR

config CONTEXTHUB_STATUS_CFG
	bool "select contexthub dts cfg"
	default n
	help
	Say yes here if you want to configure by contexthub dts

config CONTEXTHUB_LOG_PATH_VAR
	bool "use sensorhub log path under /var"
	depends on CONTEXTHUB
	default n
	help
	Say yes here if you want to use log path under var directory of root path

config CONTEXTHUB_UDI
	bool "sensorhub udi"
	depends on CONTEXTHUB
	default n
	help
	Say yes here if you want to enable sensorhub udi

config CONTEXTHUB_BLE
	bool "sensorhub ble"
	depends on CONTEXTHUB
	default n
	help
	Say yes here if you want to enable sensorhub ble

config INPUTHUB_STUB
	bool "inputhub stub"
	default n
	help
	Say yes here if you want to remove inputhub code

config SENSORHUB_VERSION
	bool "sensorhub version"
	default n
	help
	Say yes here if you want to enable sensorhub version

config SENSORHUB_NODE
	bool "sensorhub node"
	default n
	help
	provide common channels for multiple services

config SENSORHUB_CHANNEL_BUFFER
	bool "sensorhub channel buffer"
	default n
	help
	provide kernel channel buffer for multiple services

config CONTEXTHUB_DFX_UNI_NOC
	bool "sensorhub CONTEXTHUB_DFX_UNI_NOC"
	depends on CONTEXTHUB
	default n
	help
	CLT\LEX need to open this Kconfig.

source "platform_source/smart/drivers/channels/flp/Kconfig"
source "platform_source/smart/drivers/channels/igs/Kconfig"
source "platform_source/smart/drivers/channels/inputhub_as/Kconfig"
```

## platform_source/smart/drivers/channels/inputhub_as/Kconfig
```kconfig
config INPUTHUB_AS
	bool "INPUTHUB_AS"
	depends on INPUTHUB_30
	default n
	help
	  support all scenario contexthub: channel buffer mechanism,
	  device detect manager, plat debug, logbuff and bus interface.

config INPUTHUB_DEBUG
	bool "INPUTHUB_DEBUG"
	depends on INPUTHUB_30
	default n
	help
	  support all scenario contexthub debug

config INPUTHUB_AS_DMD
	bool "INPUTHUB_AS_DMD"
	depends on INPUTHUB_30
	default n
	help
	  support all scenario contexthub dmd

config CONTEXTHUB_WATCH_FACTORY
	bool "Sensor CONTEXTHUB watch factory"
	depends on INPUTHUB_30
	default n
	help
	  Say yes here if you want to enable watch factory code

source "platform_source/smart/drivers/channels/inputhub_as/device/Kconfig"
source "platform_source/smart/drivers/channels/inputhub_as/sensor_channel/Kconfig"
source "platform_source/smart/drivers/channels/inputhub_as/fingerprint_channel/Kconfig"
```

## platform_source/vcodec/Kconfig
```kconfig
menu "VCODEC DRIVER Configuration"

config VCODEC_PLATFORM_VCODECV200
        tristate "v200 Vcodec configs"
        default n

config VCODEC_PLATFORM_VCODECV210
        tristate "v210 Vcodec configs"
        default n

config VCODEC_PLATFORM_VCODECV300
        tristate "v300 Vcodec configs"
        default n

config VCODEC_PLATFORM_VCODECV310
       tristate "v310 Vcodec configs"
       default n

config VCODEC_PLATFORM_VCODECV320
        tristate "v320 Vcodec configs"
        default n

config VCODEC_PLATFORM_VCODECV500
        tristate "v500 Vcodec configs"
        default n

config VCODEC_PLATFORM_VCODECV520
        tristate "v520 Vcodec configs"
        default n

config VCODEC_PLATFORM_VCODECV600
        tristate "v600 Vcodec configs"
        default n

config VCODEC_PLATFORM_VCODECV700
        tristate "v700 Vcodec configs"
        default n

config VCODEC_PLATFORM_VCODECV720
        tristate "v720 Vcodec configs"
        default n

config VCODEC_DPM_ENABLE
        bool "dpm hwmon second version config"
        depends on DPM_HWMON
        default n
        help
            Second version for kernel dpm
config VCODEC_DEBUG
        bool "Vcodec Debug support"
        depends on VCODEC_VENC || VCODEC_VDEC
        default n
config VCODEC_BYPASS_VENC
        tristate "Vcodec bypass venc config"
        default n
config VCODEC_FREQ_LEVEL
        bool "Vcodec support freq level"
        default n

source "platform_source/vcodec/vdec/Kconfig"
source "platform_source/vcodec/venc/Kconfig"

endmenu
```

## platform_source/vcodec/vdec/Kconfig
```kconfig
menu "video vdec support"
config VCODEC_VDEC
    tristate "video decoder support"
    default n
    help
      This is the decoder driver

config VDEC_TVP_SUPPORT
    bool "Vdec vfmw tvp support"
    depends on VCODEC_VDEC
    default n
endmenu
```

## platform_source/vcodec/venc/Kconfig
```kconfig
menu "video venc support"
config VCODEC_VENC
      #depends on ANDROID_PMEM
      tristate "Support for venc"
      default n
      help
        The decode device provides venc function
config VCODEC_SECURE_VENC
      tristate "Vcodec support secure venc"
      default n
endmenu
```

## sound/soc/codecs/vendor/asp_codec_ana/asp_codec_ana_v7/Kconfig
```kconfig
config SND_SOC_ASP_CODEC_ANA_V7
	tristate "HI Soc Smartstar Codec codec_ana_v7 support"
```

## sound/soc/platforms/Kconfig
```kconfig
menu "SoC Audio support for CODEC"

config SND_DA_SEPARATE_MACHINE
	tristate "da separate machine sound support"
	help
	  Say y to enable sound support for da separate machine

config SND_DA_COMBINE_MACHINE
	tristate "da combine machine sound support"
	help
	  Say y to enable sound support for da combine machine

config SND_ANALOG_LESS_MACHINE
	tristate "analgo less machine sound support"
	help
	  Say y to enable sound support for analog less machine

config SND_SOC_DP_AUDIO
	tristate "SoC Audio support for DP audio"
	help
	  This option enables DP audio.

config AUDIO_FACTORY_MODE
	tristate "audio support factory mode"
	help
	  Say y to enable audio factory mode

config SND_SOC_CDC_PCM
	tristate "support cdc pcm config"
	depends on HIFI_DSP_ONE_TRACK
	default n

source "sound/soc/platforms/pcm_codec/Kconfig"
source "sound/soc/platforms/common_image/Kconfig"
endmenu
```

## sound/soc/platforms/common_image/Kconfig
```kconfig
config AUDIO_COMMON_IMAGE
        tristate "audio common image feature support"
        help
          Say y to enable audio common image feature for audio
```

## sound/soc/platforms/pcm_codec/Kconfig
```kconfig
config SND_SOC_PCM_CODECS
	tristate "SoC Audio support for pcm codec"
	default n

config SND_SOC_CDC_CUSTOM
	tristate "Soc Audio support for cdc custom"
	depends on SND_SOC_PCM_CODECS
	default n

config SND_SOC_ARMPC_CUSTOM
	tristate "Soc Audio support for armpc custom"
	depends on SND_SOC_PCM_CODECS
	default n
```

## sound/usb/hifi/Kconfig
```kconfig
menuconfig USB_AUDIO_DTSI_PROPERTY
	bool "USB audio dtsi property drivers support"
	depends on SND_USB_AUDIO
	default n
	help
	Say yes here to support the USB audio dtsi property module

config USB_AUDIO_DSP
	bool "USB audio dsp drivers support"
	depends on SND_USB_AUDIO
	default y
	help
	Say yes here to support the USB audio dsp module
```

## sound/usb/usbaudio_mailbox/Kconfig
```kconfig
config USB_AUDIO_MAILBOX
	bool "USB audio mailebox drivers support"
	default n
	help
	Say yes here to support the USB audio maixbox module
```
